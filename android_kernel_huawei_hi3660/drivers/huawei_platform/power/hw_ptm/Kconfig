## android_kernel_huawei_hi3660/drivers/huawei_platform/power/hw_ptm/Kconfig
```kconfig
config HW_PTM
    boolean "Huawei Power Thermal Monitor"
    default n
    help
        Huawei PTM, please choose it.

config HW_PTM_K3V5
    boolean "Huawei Power Thermal Monitor For K3V5"
    default n
    help
        Huawei PTM, please choose it for K3V5.

config HW_PTM_K3V6
    boolean "Huawei Power Thermal Monitor For K3V6"
    default n
    help
        Huawei PTM, please choose it for K3V6.

config HW_PTM_K3V7
    boolean "Huawei Power Thermal Monitor For K3V7"
    default n
    help
        Huawei PTM, please choose it for K3V7.
```

## android_kernel_huawei_hi3660/drivers/huawei_platform/power/pid_socket/Kconfig
```kconfig
config HUAWEI_FEATURE_PRINT_PID_NAME
    boolean "print pid and name of the process who used connect function"
    default n
    help
        Huawei pid_socket, please choose it. 
```

## android_kernel_huawei_hi3660/drivers/huawei_platform/power/power_mesg/Kconfig
```kconfig
config HUAWEI_POWER_MESG_INTERFACE
	bool
	prompt "Huawei power message interface."
	default n
	help
		It's for asking and getting HMAC from user space.
```

## android_kernel_huawei_hi3660/drivers/huawei_platform/power/wifi_filter/Kconfig
```kconfig
config DOZE_FILTER
	tristate "Huawei doze wifi filter Support"
	---help---
        the wifi filter when enter doze mode,open it
```

## android_kernel_huawei_hi3660/drivers/huawei_platform/rilsim/Kconfig
```kconfig
config RIL_SIM_NETLINK_MODULE
	tristate "kernel space communicate with user space rild use netlink socket for pin security."
    default n
    help
	  This module adds support for PIN auto verify funtion based on
	  Balong V3R3 chipset.
```

## android_kernel_huawei_hi3660/drivers/huawei_platform/sensor/fingerprint/Kconfig
```kconfig
#
# fingerprint configuration
#
menuconfig FINGERPRINT
	bool "fingerprint"
	default n
	help
	Say yes here to support for fingerprint.
```

## android_kernel_huawei_hi3660/drivers/huawei_platform/sensor/hall/Kconfig
```kconfig
#
# hall sensor driver configuration
#
menuconfig HUAWEI_HALL_INPUTHUB
	bool "hall sensor ak8789 driver"
	default n
	help
	Say yes here to support for light hall ak8789.
```

## android_kernel_huawei_hi3660/drivers/huawei_platform/sensor/pos_hall/Kconfig
```kconfig
#
# pos_hall driver configuration
#
config POS_HALL
	bool "huawei pos_hall driver"
	default n
	help
	Say yes here to support for pos hall.
```

## android_kernel_huawei_hi3660/drivers/huawei_platform/sensor/step_motor/Kconfig
```kconfig
#
# step motor driver configuration
#
menuconfig STEP_MOTOR
	bool "huawei step motor driver"
	default n
	help
	Say yes here to support for step motor.
```

## android_kernel_huawei_hi3660/drivers/huawei_platform/sensor/touch_key/Kconfig
```kconfig
#
# touch key driver configuration
#
menuconfig HW_TOUCH_KEY
	bool "huawei touch key driver"
	default n
	help
	Say yes here to support for touch key.
```

## android_kernel_huawei_hi3660/drivers/huawei_platform/storage/ddrinfo/Kconfig
```kconfig
config DDR_INFO
	bool "/proc/ddr_info support,huawei ddr_info support"
	default n
	help
	    get DDR manufacturer id and memory size from xloader.
```

## android_kernel_huawei_hi3660/drivers/huawei_platform/sw/Kconfig
```kconfig
config HW_SW_DEVICES
    bool "HUAWEI SW_DEVICES"
    default n
    help
	  This module adds support for single-wire communicate Keyboard for CMR Product based on
	  HISI 960 chipset.
```

## android_kernel_huawei_hi3660/drivers/huawei_platform/usb/otg_gpio_id/Kconfig
```kconfig
config OTG_GPIO_ID
	tristate "OTG_GPIO_ID support"
	default n
	depends on GPIOLIB
	help
	  Say Y here to enable GPIO based switch support.
```

## android_kernel_huawei_hi3660/drivers/huawei_platform/usb/pd/Kconfig
```kconfig
source "drivers/huawei_platform/usb/pd/ti/Kconfig"
source "drivers/huawei_platform/usb/pd/richtek/Kconfig"

config HUAWEI_HISHOW
        bool "support huawei hishow function"
        default n
        help
          Say Y to enable

config TYPEC_CAP_CUSTOM_SRC2
        bool "Support Double 22/10k Pullup Function"
        default n
        help
          Say Y to enable
```

## android_kernel_huawei_hi3660/drivers/huawei_platform/usb/pogopin/Kconfig
```kconfig
config POGO_PIN
	tristate "POGO_PIN support"
	help
	  Say Y here to enable Pogopin support.
```

## android_kernel_huawei_hi3660/drivers/huawei_platform/usb/superswitch/Kconfig
```kconfig
config SUPERSWITCH_FSC
	tristate "fsc superswitch support"
	depends on SUPERSWITCH
	help
	  Say Y here to enable fsc superswitch support.
```

## android_kernel_huawei_hi3660/drivers/huawei_platform/usb/switch/switch_sensorhub/Kconfig
```kconfig
if SWITCH

# I2C SWITCH_CHIP driver configuration
config SWITCH_FSA9685_SENSORHUB
	tristate "SWITCH_FSA9685_SENSORHUB"
	depends on INPUTHUB
	help
	  If you say yes here you get support for SWITCH_FSA9685_SENSORHUB.
endif # SWITCH
```

## android_kernel_huawei_hi3660/drivers/huawei_platform/usb/typec/Kconfig
```kconfig
config HUAWEI_TYPEC
	tristate "typec connector"
	depends on GPIOLIB && I2C
	default n
	help
	  Say Y here to enable Type C Connector support.

source "drivers/huawei_platform/usb/typec/pericom30216/Kconfig"
source "drivers/huawei_platform/usb/typec/tusb320/Kconfig"
source "drivers/huawei_platform/usb/typec/fusb301/Kconfig"
source "drivers/huawei_platform/usb/typec/ptn5150h/Kconfig"
```

## android_kernel_huawei_hi3660/drivers/huawei_platform/vendor_exception/Kconfig
```kconfig
#
# HUAWEI_VENDOR_EXCEPTION configuration
#

config HUAWEI_VENDOR_EXCEPTION
    bool "Huawei vendor exception support"
    depends on HISI_BB
    default y
    help
      Say yes here to support HuaWei vendor exception feature.
```

## android_kernel_huawei_hi3660/drivers/huawei_platform/vibrator/classd_vibrator/Kconfig
```kconfig
#
#vibrator using classd on pmu configuration
#
config CLASSD_VIBRATOR
	tristate "vibator using classd on pmu"
	depends on ANDROID_TIMED_OUTPUT
	default n
	help
	Say yes here to support for vibrator using classd on pmu.
```

## android_kernel_huawei_hi3660/drivers/hwbfm/hwbfr/Kconfig
```kconfig
#
# Huawei boot fail recovery subsystem configuration
#

config USE_BOOTFAIL_RECOVERY_SOLUTION
        bool "Enable boot fail recovery subsystem"
        default n
```

## android_kernel_huawei_hi3660/drivers/hwerecovery/Kconfig
```kconfig
config HW_ERECOVERY
    depends on HW_LOGGER
    bool "Huawei erecovery driver"
    default n
    ---help---
    This feature support to catch erecovery info
```

## android_kernel_huawei_hi3660/drivers/hwfdleak/Kconfig
```kconfig
config HW_FDLEAK
	depends on HW_LOGGER
	bool "Huawei fd leak driver"
	default n
	---help---
	  This feature support to catch fd leak log
```

## android_kernel_huawei_hi3660/drivers/hwnet/ipv4/Kconfig
```kconfig
config HW_WIFIPRO
	bool "Huawei wifipro tcp monitor support"
	default n

config HW_WIFIPRO_PROC
	bool "Huawei wifipro proc support"
	depends on HW_WIFIPRO
	default n

config WIFI_DELAY_STATISTIC
	bool "wifi delay statistic"
	default n
```
