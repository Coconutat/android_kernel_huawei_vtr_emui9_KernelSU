## android_kernel_huawei_hi3660/drivers/huawei_platform/connectivity/bcm/gps/bcm47531/Kconfig
```kconfig
menuconfig BCMGPS47531
	tristate "Bcm47531 gps support"
	default n
	help
	  Say Y here to enable bcm47531 gps support. This allows
	  ap to control this module.
```

## android_kernel_huawei_hi3660/drivers/huawei_platform/dome_key/Kconfig
```kconfig
menuconfig DOME_KEY
	bool "dome_key driver"
	default n
	help
		If you say yes here you get support for dome_key.
```

## android_kernel_huawei_hi3660/drivers/huawei_platform/dp_aux_switch/Kconfig
```kconfig
config DP_AUX_SWITCH
        bool "huawei DP_AUX_SWITCH"
        default n
        help
          If you say yes here you get support for huawei SP AUX switch check.
```

## android_kernel_huawei_hi3660/drivers/huawei_platform/dp_source/Kconfig
```kconfig
config HW_DP_SOURCE
        bool "huawei DP_SOURCE"
        default n
        help
            if you say yes here you get support for huawei DP source switch check.
```

## android_kernel_huawei_hi3660/drivers/huawei_platform/emcom/xengine/Kconfig
```kconfig
config HUAWEI_XENGINE
	bool "Huawei xengine feature support"
	default n

config HUAWEI_EMCOM_CHANNEL
	bool "Huawei emcom channel feature support"
	default n

config SMART_MP
        bool 'change stats of smart mp modules'
        depends on NETFILTER_XT_MATCH_QTAGUID && HUAWEI_XENGINE
        help
          This option try to fix the repeated calculation of the stats
          on both app and smartmp module.
          If unsure, say `N'.
```

## android_kernel_huawei_hi3660/drivers/huawei_platform/handpress_switch/Kconfig
```kconfig
menuconfig HW_HANDPRESS_SWITCH
	bool "handpress switch driver"
	default n
	help
		If you say yes here you get support for handpress switch.
```

## android_kernel_huawei_hi3660/drivers/huawei_platform/inputhub/Kconfig
```kconfig
menuconfig INPUTHUB
	bool "InputHub feature support"
	default n
	help
	Say yes here to support inputhub feature.

menuconfig INPUTHUB_20
	bool "InputHub feature2.0 support"
	default n
	help
	Say yes here to support inputhub2.0 feature.

menuconfig CYPRESS_PSOC4000
	bool "cypress capsense support"
	default n
	help
	Say yes here if you want to configure cypress capsense

config CONTEXTHUB_IDLE_32K
	bool "CONTEXTHUB_IDLE_32K"
	depends on INPUTHUB || INPUTHUB_20
	default n
	help
	Say yes here if you want to configure CONTEXTHUB_IDLE_32K

config IOM3_RECOVERY
	bool "iom3 recovery feature support"
	depends on INPUTHUB
	default n
	help
	Say yes here to support the cmdline parse

config INPUTHUB_VIBRATOR_CHANNEL
	bool "inputhub vibrator channel support"
	depends on INPUTHUB || INPUTHUB_20
	default n
	help
	Say yes here to support the cmdline parse
```

## android_kernel_huawei_hi3660/drivers/huawei_platform/iotrace/Kconfig
```kconfig
#HUAWEI IO TRACING


config HUAWEI_IO_TRACING
        tristate "huawei io tracing"
        default n
        depends on TRACING && TASK_XACCT && TASK_IO_ACCOUNTING
        help
            trace the io state for debugging
config HUAWEI_IO_MONITOR
        tristate "huawei io monitor"
        default n
        depends on TASK_IO_ACCOUNTING && HUAWEI_UID_IO_STATS
        help
            trace io monitor 
```

## android_kernel_huawei_hi3660/drivers/huawei_platform/madapt/Kconfig
```kconfig
menuconfig MADAPT
	bool "huawei madapt driver support"
	default n
	help
		Say yes here to support the madapt function
```

## android_kernel_huawei_hi3660/drivers/huawei_platform/net/Kconfig
```kconfig
source "drivers/huawei_platform/net/ipv4/Kconfig"
source "drivers/huawei_platform/net/hw_netfilter/Kconfig"
source "drivers/huawei_platform/net/commstat/Kconfig"
source "drivers/huawei_platform/net/qtaguid_pid/Kconfig"
source "drivers/huawei_platform/net/hw_dpi_mark/Kconfig"
source "drivers/huawei_platform/net/netbooster/Kconfig"
source "drivers/huawei_platform/net/himos/Kconfig"
source "drivers/huawei_platform/net/bastet/Kconfig"
```

## android_kernel_huawei_hi3660/drivers/huawei_platform/net/bastet/Kconfig
```kconfig
menu "Huawei Bastet Support"
	depends on INET && NETFILTER

config HUAWEI_BASTET
	tristate "Huawei Bastet support"
	default n
	---help---
	  This driver provides TCP sequence sync, traffic flow correction, etc. for Huawei Bastet.

config BASTET_BALONG_COMM
	bool "Bastet Balong comm driver support"
	depends on HUAWEI_BASTET && (HISI_BALONG_MODEM_HI3XXX || HISI_BALONG_MODEM_HI6XXX || HISI_BALONG_MODEM_HI3650)
	default n
	---help---
	  This driver provides Balong modem comm interface for Huawei Bastet.

config HUAWEI_BASTET_COMM_NEW
	bool "Bastet new Balong comm driver support"
	default n
	---help---
	  This driver provides new Balong modem comm interface for Huawei Bastet.

config HUAWEI_WIFI_WEIXIN_HONGBAO_ENABLE_PRIORITY
	bool "Huawei Weixin Hongbao priority support"
	depends on HUAWEI_BASTET
	default n
	---help---
	  This feature provides Huawei Weixin Hongbao priority support.
endmenu
```

## android_kernel_huawei_hi3660/drivers/huawei_platform/net/hw_netfilter/Kconfig
```kconfig
config HW_NETFILTER_MODULE
	tristate "kernel huawei custom netfilter hook for ad filter and app download monitor"
    default n
    help
	  This module adds support for ad filter and app download monitor
```

## android_kernel_huawei_hi3660/drivers/huawei_platform/nfc/Kconfig
```kconfig
menu "NFC (Near Field Communication)"
menuconfig NFC_DEVICES
	tristate "Near Field Communication (NFC) devices"
	default n
	---help---
	  You'll have to say Y if your computer contains an NFC device that
	  you wtant to use under Linux.

	  You can say N here if you don't have any Near Field Communication
	  devices connected to your computer.


source "drivers/huawei_platform/nfc/NXP_PN547_64/Kconfig"
source "drivers/huawei_platform/nfc/nfc_bcm20793/Kconfig"
source "drivers/huawei_platform/nfc/cxd224x/Kconfig"

endmenu
```

## android_kernel_huawei_hi3660/drivers/huawei_platform/power/Kconfig
```kconfig
source "drivers/huawei_platform/power/charger/Kconfig"
source "drivers/huawei_platform/power/power_mesg/Kconfig"
source "drivers/huawei_platform/power/battery/Kconfig"
source "drivers/huawei_platform/power/coul/Kconfig"
source "drivers/huawei_platform/power/hw_kstate/Kconfig"
source "drivers/huawei_platform/power/hw_ptm/Kconfig"
source "drivers/huawei_platform/power/ate/Kconfig"
source "drivers/huawei_platform/power/smpl/Kconfig"
source "drivers/huawei_platform/power/usb_short_circuit_protect/Kconfig"
source "drivers/huawei_platform/power/cpu_buck/Kconfig"
source "drivers/huawei_platform/power/water_check/Kconfig"
source "drivers/huawei_platform/power/buckboost/Kconfig"
source "drivers/huawei_platform/power/pid_socket/Kconfig"
source "drivers/huawei_platform/power/wifi_filter/Kconfig"
source "drivers/huawei_platform/power/boost_5v/Kconfig"
source "drivers/huawei_platform/power/batt_acr_detect/Kconfig"
source "drivers/huawei_platform/power/power_thermalzone/Kconfig"
source "drivers/huawei_platform/power/battery_temp_fitting/Kconfig"
source "drivers/huawei_platform/power/power_debug/Kconfig"
```

## android_kernel_huawei_hi3660/drivers/huawei_platform/power/battery/Kconfig
```kconfig
source "drivers/huawei_platform/power/battery/battery_ct/Kconfig"
source "drivers/huawei_platform/power/battery/battery_voltage/Kconfig"
```

## android_kernel_huawei_hi3660/drivers/huawei_platform/power/battery/battery_ct/Kconfig
```kconfig
menu "Battery certification support"

menuconfig HUAWEI_BATTERY_INFORMATION
	bool
	prompt "Certificate battery by information of IC."
	default n

source "drivers/huawei_platform/power/battery/battery_ct/MAXIM/Kconfig"

endmenu
```

## android_kernel_huawei_hi3660/drivers/huawei_platform/power/battery/battery_voltage/Kconfig
```kconfig
config HUAWEI_BATTERY_VOLTAGE
	bool "huawei BATTERY VOLTAGE"
	default n
config HUAWEI_VBAT_HKADC
	bool "huawei vbat hkadc"
	default n
```

## android_kernel_huawei_hi3660/drivers/huawei_platform/power/charger/charger_ap/direct_charger/Kconfig
```kconfig
source "drivers/huawei_platform/power/charger/charger_ap/direct_charger/loadswitch/Kconfig"
source "drivers/huawei_platform/power/charger/charger_ap/direct_charger/switchcap/Kconfig"
#source "drivers/huawei_platform/power/charger/direct_charger/ina231/Kconfig"
config LOADSWITCH
	bool "loadswitch"
	default n
config SWITCHCAP
	bool "switchcap"
	default n
config INA231_FOR_CHARGE
	bool "ina231_for_charge"
	default n
```

## android_kernel_huawei_hi3660/drivers/huawei_platform/power/charger/charger_ap/direct_charger/loadswitch/dual_loadswitch/Kconfig
```kconfig
config DUAL_LOADSWITCH_FAN54151
	bool "dual_loadswitch_fan54151"
	default n
config DUAL_LOADSWITCH_RT9748
	bool "dual_loadswitch_rt9748"
	default n
config DUAL_LOADSWITCH_FPF2283
	bool "dual_loadwitch_fpf2283"
	default n
```

## android_kernel_huawei_hi3660/drivers/huawei_platform/power/charger/charger_sensorhub/Kconfig
```kconfig
config HUAWEI_CHARGER_SENSORHUB
	bool "huawei charger sensorhub"
	depends on INPUTHUB
	default n
config BQ25892_CHARGER_SENSORHUB
	bool "bq25892 charger sensorhub"
	depends on INPUTHUB
	default n
```

## android_kernel_huawei_hi3660/drivers/huawei_platform/power/coul/Kconfig
```kconfig
config HUAWEI_COUL
	bool "huawei coul"
	default n
config BQ28Z610_COUL
	bool "bq28z610 coul"
	default n
```
