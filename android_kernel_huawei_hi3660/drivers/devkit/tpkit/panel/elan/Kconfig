## android_kernel_huawei_hi3660/drivers/devkit/tpkit/panel/elan/Kconfig
```kconfig
#
# huawei touchscreen driver configuration
#
menuconfig ELAN_TS_KIT
	bool "TS_KIT elan drivers"
	default n
	help
	  If you say yes here you get support for huawei touchscreen.
```

## android_kernel_huawei_hi3660/drivers/devkit/tpkit/panel/focaltech/Kconfig
```kconfig
#
# huawei touchscreen driver configuration
#

menuconfig FOCAL_TS_KIT
	tristate "TS_KIT focaltech drivers"
	default n
	help
	  If you say yes here you get support for huawei touchscreen.
```

## android_kernel_huawei_hi3660/drivers/devkit/tpkit/panel/gt1x/Kconfig
```kconfig
#
# huawei touchscreen driver configuration
#

menuconfig GOODIX_GT1X_TS_KIT
	tristate "TS_KIT goodix GT1X drivers"
	default n
	help
	  If you say yes here you get support for huawei touchscreen.
```

## android_kernel_huawei_hi3660/drivers/devkit/tpkit/panel/himax/Kconfig
```kconfig
#
# huawei touchscreen driver configuration
#

menuconfig HIMAX_TS_KIT
	bool "huawei  ts kit himax drivers"
	default n
	help
	  If you say yes here you get support for huawei touchscreen.
```

## android_kernel_huawei_hi3660/drivers/devkit/tpkit/panel/himax_64/Kconfig
```kconfig
#
# huawei touchscreen driver configuration
#

menuconfig HIMAX_TS_KIT_64
	bool "huawei  ts kit himax drivers"
	default n
	help
	  If you say yes here you get support for huawei touchscreen.
```

## android_kernel_huawei_hi3660/drivers/devkit/tpkit/panel/novatek/Kconfig
```kconfig
#
# huawei touchscreen driver configuration
#

menuconfig NOVATEK_TS_KIT
	tristate "novatek ts kit drivers"
	default n
	help
	  If you say yes here you get support for huawei touchscreen.
```

## android_kernel_huawei_hi3660/drivers/devkit/tpkit/panel/samsung/Kconfig
```kconfig
#
# huawei touchscreen driver configuration
#

menuconfig SAMSUNG_TS_KIT
	tristate "TS_KIT samsung.lsi touch drivers"
	default n
	help
	  If you say yes here you get support for huawei touchscreen.
```

## android_kernel_huawei_hi3660/drivers/devkit/tpkit/panel/synaptics/Kconfig
```kconfig
#
# huawei touchscreen driver configuration
#

menuconfig SYNAPTICS_TS_KIT
	tristate "TS_KIT synaptics drivers"
	default n
	help
	  If you say yes here you get support for huawei touchscreen.
```

## android_kernel_huawei_hi3660/drivers/devkit/tpkit/panel/wacom/Kconfig
```kconfig
#
# huawei touchscreen driver configuration
#

menuconfig WACOM_TS_KIT
	tristate "huawei  ts kit wacom drivers"
	default n
	help
	  If you say yes here you get support for huawei touchscreen.
```

## android_kernel_huawei_hi3660/drivers/dsm/Kconfig
```kconfig
#
# huawei device state monitor configuration
#

config HUAWEI_DSM
	bool "huawei dsm"
	default n
	help
	  If you say yes here you get support for huawei touchscreen.
config HUAWEI_SDCARD_VOLD
	bool "huawei sdcard vold"
	default n
	help
	  If you say yes here you get support for huawei vold radar.
config HUAWEI_DATA_ACQUISITION
	bool "huawei data acquisition"
	default n
	depends on HUAWEI_DSM
	help
	  If you say yes here you get support for huawei data acquisition.
```

## android_kernel_huawei_hi3660/drivers/dubai/Kconfig
```kconfig
menu "Huawei Device Usage Big-data Analytics Initiative Support"

config HUAWEI_DUBAI
	bool "Huawei Device Usage Big-data Analytics Initiative Support"
	default n
	help
	  This driver provides DUBAI feature

config HUAWEI_DUBAI_TASK_CPU_POWER
	bool "Huawei DUBAI Task CPU Power"
	default n
	depends on HUAWEI_DUBAI && (CPU_FREQ_POWER_STAT || ARCH_MSM)
	help
	  Get task cpu power

endmenu
```

## android_kernel_huawei_hi3660/drivers/gpu/gmc/Kconfig
```kconfig
config GPU_GMC_GENERIC
	bool "A generic framework for GPU graphical memory compression"
	default y
	select ZSMALLOC
	select ZPOOL
	select CRYPTO
	select CRYPTO_LZ4
	help
	  Enabling the option forces the build system to compile the generic
	  layer made for implementation of GPU memory reclaim facilities for
	  a set of GPUs using ordinary system memory (non-discrete ones). There
	  are at least two possible targets to reclaim: GEM/ION allocations and
	  internal GPU allocations (let's call them 'graphic memory'). This
	  layer is developed for the second type of allocations. The framework
	  provides a set of interfaces that must be implemented by GPU kernel
	  drivers and generic functions including compressed objects in-memory
	  storage and user space interface.
```

## android_kernel_huawei_hi3660/drivers/hisi/cmdline/Kconfig
```kconfig
config HISI_CMDLINE_PARSE
       bool "cmdline parse"
       default n
       help
          Say 'Y' here if you want to support the cmdline parse
	  on hisilicon platform
```

## android_kernel_huawei_hi3660/drivers/hisi/dieid/Kconfig
```kconfig
config HISI_DIEID
	bool "Support Hisilicon DIEID driver"
	default n
	help
	Say yes here if you want to use hisi dieid
```

## android_kernel_huawei_hi3660/drivers/hisi/engineer_mode/Kconfig
```kconfig
config HISI_ENGINEER_MODE
	bool"Hisilicon engineer mode driver"
	default n
	help
	  hisilicon engineer mode driver. this driver will load eng_system
	  and eng_vendor partitions.
```

## android_kernel_huawei_hi3660/drivers/hisi/hisi_dummy_ko/Kconfig
```kconfig
config HISI_DUMMY_KO
	tristate "hisi dummy ko support"
	depends on MODULES
	help
	  Say m here to support hisi dummy ko.
```

## android_kernel_huawei_hi3660/drivers/hisi/hisi_lb/Kconfig
```kconfig
config HISI_LB
	bool "HISI last buffer"
	help
	  Enable last buffer.

	  If unsure, say N here.

config HISI_LB_DEBUG
	bool "HISI lb debug"
	depends on HISI_LB
	help
	  Enable last buffer debug.

	  If unsure, say N here.

config HISI_LB_TST
	bool "HISI lb ip test"
	depends on HISI_LB
	help
	  Enable last buffer ip test
	  and need disable hisi lb debug

	  if unsure, say N here
```

## android_kernel_huawei_hi3660/drivers/hisi/hisi_syscounter/Kconfig
```kconfig
config HISI_SYSCOUNTER
	bool "Hisilicon SysCounter driver"
	depends on INPUTHUB || INPUTHUB_20
	default n
	help
	Say yes here if you want to use hisi syscounter
```

## android_kernel_huawei_hi3660/drivers/hisi/hispfd/Kconfig
```kconfig
menu "Hisilicon ISP FD"

config HISPFD
	tristate "Hisilicon ISP FD Drivers"
	depends on IOMMU_API
	help
		Hisilicon isp face detect drivers.

endmenu
```

## android_kernel_huawei_hi3660/drivers/hisi/hitest/Kconfig
```kconfig
config HISILICON_PLATFORM_HITEST
	bool "Hisilicon platform hitest module support"
	depends on HISI_DEBUG_FS
	default y
	help
	  Say yes here to support the hisilicon platform hitest module
```

## android_kernel_huawei_hi3660/drivers/hisi/ics/Kconfig
```kconfig
#
# Cambricon IPU Platform Specific Drivers
#

menuconfig HISI_ICS_IPU_PLATFORM
	bool "Platform support for Cambricon IPU Device"
	default y
	help
	  Say Y here to get to see options for device drivers of various
	  Cambricon IPU platforms. This option itself does not add any kernel code.

	  If you say N, all options in this submenu will be skipped and disabled.

if HISI_ICS_IPU_PLATFORM

comment "'Cambricon IPU Driver' and 'HISI NPU V200 Support' are mutually exclusive, only one choice!"

config HISI_ICS_IPU
	tristate "Cambricon IPU Driver"
	default y
	help
	  Cambricon IPU Platform driver.

config HISI_NPU_V200
    tristate "HISI NPU V200 Support"
    default n
    help
      NPU V200 Support configuration.

endif # HISI_ICS_IPU_PLATFORM
```

## android_kernel_huawei_hi3660/drivers/hisi/ipp/Kconfig
```kconfig
menu "Hisilicon ISP IPP"

config HISPIPP
	bool "Hisilicon ISP IPP Drivers"
	depends on IOMMU_API
	default n
	help
		Hisilicon isp IPP drivers.

config HISPIPP_V200
	bool "Hisilicon ISP IPP Drivers for V200"
	depends on HISPIPP
	default n
	help
		Hisilicon ISP IPP Drivers for V200

config HISPIPP_V210
    bool "Hisilicon ISP IPP Drivers for V210"
	depends on HISPIPP
    default n
    help
        Hisilicon ISP IPP Drivers for V210

endmenu
```

## android_kernel_huawei_hi3660/drivers/hisi/irq_affinity/Kconfig
```kconfig
config HISI_IRQ_AFFINITY
	bool "Hisilicon irq affinity"
	depends on SMP
	default n
	help
	  Driver for irq affinity recovery in smp system

config HISI_IRQ_AFFINITY_DEBUGFS
	bool "Hisilicon irq affinity debugfs"
	depends on HISI_IRQ_AFFINITY && HISI_DEBUG_FS
	default n
	help
	  Debug code for HISI irq affinity recovery in smp system
```

## android_kernel_huawei_hi3660/drivers/hisi/ivp/Kconfig
```kconfig
menu "Hisilicon IVP"

config HISI_IVP
     bool "hisilicon ivp support"
     default n
     help
          ivp driver for ivpv100.

config IVP_SMMU
	bool "Hisilicon IVP SMMU Support"
	depends on IOMMU_API
	depends on HISI_IODOMAIN_API
	help
	  Hisilicon IVP IOMMU Support.

config IVP_SMMU_TEST
	bool "Hisilicon IVP SMMU TEST Support"
	depends on IVP_SMMU
	help
	  Hisilicon IVP IOMMU TEST Support.

choice
	prompt "IVP Platform"
	default IVP_IVPV100
	depends on HISI_IVP
	help
	  select ivp platform private setting

config IVP_IVPV160
	bool "ivpv160"
	depends on HISI_IVP

config IVP_IVPV200
	bool "ivpv200"
	depends on HISI_IVP

config IVP_IVPV150
	bool "ivpv150"
	depends on HISI_IVP

config IVP_IVPV100
	bool "ivpv100"
	depends on HISI_IVP
	
config IVP_IVPV120
	bool "ivpv120"
	depends on HISI_IVP

config IVP_IVPV210
        bool "ivpv210"
        depends on HISI_IVP

config IVP_IVPV250
	bool "ivpv250"
	depends on HISI_IVP
endchoice
endmenu
```
