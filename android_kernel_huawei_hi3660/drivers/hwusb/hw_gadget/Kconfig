## android_kernel_huawei_hi3660/drivers/hwusb/hw_gadget/Kconfig
```kconfig
menuconfig HW_GADGET
	tristate "huawei gadget class support"
	default n
	help
	  Say Y here to enable hw gadget feature. 
```

## android_kernel_huawei_hi3660/drivers/hwzerohung/Kconfig
```kconfig
config HW_ZEROHUNG
	depends on HW_LOGGER
	bool "Huawei zero hung driver"
	default n
	---help---
	  This feature support to catch hung log

config HW_CGROUP_INFO
	depends on CGROUPS
	depends on CGROUP_FREEZER
	bool "Huawei cgroup info for dfr"
	default n
	---help---
	  This feature support to catch freezer cgroup hung
```

## android_kernel_huawei_hi3660/drivers/log/Kconfig
```kconfig
#
# Logger extend configuration
#
source "drivers/log/goldeneye/Kconfig"
source "drivers/log/boot_log/Kconfig"

menu "Logger extend configuration"

config LOGGER_EXTEND
	bool "Logger extend support"
	depends on HW_LOGGER
	default n
	---help---
	  Enable support for logger extend

if LOGGER_EXTEND

config LOG_SWITCH
	tristate "log switch feature support"
	depends on HISI_NVE
	default n
	---help---
	  Say Y here to enable log switch feature support. This allows
	  user to control log.

config LOG_EXCEPTION
	bool "log exception feature support"
	default n
	---help---
	  Say Y here to enable log exception feature support. This allows
	  user to send log to remote server by net.

config LOG_JANK
	bool "log jank feature support"
	default n
	---help---
	  Say Y here to enable log jank feature support. This allows
	  user to send log to remote server by net.

config HWLOG_KERNEL
        bool "hwlog feature support"
        default n
        ---help---
          Say Y here to enable hwlog kernel feature support. This allows
          user to send log to remote server by net.
endif # if LOGGER_EXTEND

config HIVIEW_SELINUX
	bool "hiview selinux support"
	depends on SECURITY && SECURITY_SELINUX
	default n
	---help---
	  Say Y here to enable log switch feature support. This allows
	  user to collect selinux log to hiview.
endmenu
```

## android_kernel_huawei_hi3660/drivers/media/huawei/camera/Kconfig
```kconfig
comment "Huawei Camera"

# source "drivers/media/huawei/camera/isp/Kconfig"
source "drivers/media/huawei/camera/hisp/Kconfig"
source "drivers/media/huawei/camera/sensor/Kconfig"
source "drivers/media/huawei/camera/laser/Kconfig"
source "drivers/media/huawei/camera/fd/Kconfig"
source "drivers/media/huawei/camera/pmic/Kconfig"

source "drivers/media/huawei/camera/platform/Kconfig"

source "drivers/media/huawei/camera/fpga/Kconfig"
source "drivers/media/huawei/camera/driver_ic/Kconfig"
source "drivers/media/huawei/camera/dot/Kconfig"

menuconfig HISI_CAMERA_LASER
    bool "Huawei laser support"
    default n
    help
        Say Y here to enable Laser for Huawei camera

menuconfig HISI_CAMERA_FLASH
    bool "Huawei flash support"
    default n
    help
        Say Y here to enable Flash for Huawei camera
menuconfig HISI_CAMERA_FPGA
    bool "Huawei Camera FPGA support"
    default n
    help
        Say Y here to enable fpga for Huawei camera
menuconfig HISI_CAMERA_DRIVER_IC
    bool "Huawei Camera Driver IC support"
    default n
    help
        Say Y here to enable driver ic for Huawei camera
menuconfig HISI_CAMERA_DOT_PROJECTOR
    bool "Huawei Camera Dot support"
    default n
    help
        Say Y here to enable dot projector for Huawei camera

config HISI_CAMERA_HISTAR_ISPV110
    tristate "Support histar ispv110 driver"
    depends on HUAWEI_CAMERA
    default n
    ---help---
        Hisilicon histar ispv110 driver.

config HISI_CAMERA_HISTAR_ISPV150
    tristate "Support histar ispv150 driver"
    depends on HUAWEI_CAMERA
    default n
    ---help---
        Hisilicon histar ispv150 driver.

config HISI_CAMERA_HISTAR_ISPV160
    tristate "Support histar ispv160 driver"
    depends on HUAWEI_CAMERA
    default n
    ---help---
        Hisilicon histar ispv160 driver.

config HISI_CAMERA_HISTAR_ISPV120
    tristate "Support histar ispv120 driver"
    depends on HUAWEI_CAMERA
    default n
    ---help---
        Hisilicon histar ispv120 driver.

config HISI_CAMERA_HISTAR_ISPV200
    tristate "Support histar ispv200 driver"
    depends on HUAWEI_CAMERA
    default n
    ---help---
        Hisilicon histar ispv200 driver.

config HISI_CAMERA_HISTAR_ISPV250
    tristate "Support histar ispv250 driver"
    depends on HUAWEI_CAMERA
    default n
    ---help---
        Hisilicon histar ispv250 driver.

config HISI_CAMERA_HISTAR_ISPV210
    tristate "Support histar ispv210 driver"
    depends on HUAWEI_CAMERA
    default n
    ---help---
        Hisilicon histar ispv210 driver.

config HISI_CAMERA_ISP_SECURE
    tristate "Support histar isp secure"
    depends on HUAWEI_CAMERA
    default n
    ---help---
        Hisilicon histar isp secure.
config HUAWEI_CAMERA_PMIC
    tristate "Support Camera PMIC"
    depends on HUAWEI_CAMERA
    default n
    ---help---
        Support Camera PMIC chip
```

## android_kernel_huawei_hi3660/drivers/media/huawei/camera/dot/Kconfig
```kconfig
if HISI_CAMERA_DOT_PROJECTOR

config HISI_CAMERA_DOT_PROJECTOR_CYC8
    tristate "cyc8 camera dot driver"
    depends on HISI_CAMERA_DOT_PROJECTOR
    default n
    ---help---
        cyc8 camera dot driver

endif
```

## android_kernel_huawei_hi3660/drivers/media/huawei/camera/driver_ic/Kconfig
```kconfig
if HISI_CAMERA_DRIVER_IC

config HISI_CAMERA_DRIVER_IC_MP3336
    tristate "mp3336 camera driver ic driver"
    depends on HISI_CAMERA_DRIVER_IC
    default n
    ---help---
        mp3336 camera driver ic driver

		
config HISI_CAMERA_DRIVER_IC_MP3331
    tristate "mp3331 camera driver ic driver"
    depends on HISI_CAMERA_DRIVER_IC
    default n
    ---help---
        mp3331 camera driver ic driver
		
endif
```

## android_kernel_huawei_hi3660/drivers/media/huawei/camera/fpga/Kconfig
```kconfig
if HISI_CAMERA_FPGA

config HISI_CAMERA_FPGA_ICE40
    tristate "ice40 camera fpga driver"
    depends on HISI_CAMERA_FPGA
    default n
    ---help---
        ice40 camera fpga driver

endif
```

## android_kernel_huawei_hi3660/drivers/media/huawei/camera/hisp/Kconfig
```kconfig
comment "HISI ISP"


if HISI_CAMERA_HISTAR_ISPV110
source "drivers/media/huawei/camera/hisp/hisp110/Kconfig"
endif

if HISI_CAMERA_HISTAR_ISPV150
source "drivers/media/huawei/camera/hisp/hisp150/Kconfig"
endif

if HISI_CAMERA_HISTAR_ISPV160
source "drivers/media/huawei/camera/hisp/hisp160/Kconfig"
endif

if HISI_CAMERA_HISTAR_ISPV120
source "drivers/media/huawei/camera/hisp/hisp120/Kconfig"
endif

if HISI_CAMERA_HISTAR_ISPV200
source "drivers/media/huawei/camera/hisp/hisp200/Kconfig"
endif

if HISI_CAMERA_HISTAR_ISPV250
source "drivers/media/huawei/camera/hisp/hisp250/Kconfig"
endif

if HISI_CAMERA_HISTAR_ISPV210
source "drivers/media/huawei/camera/hisp/hisp210/Kconfig"
endif
```

## android_kernel_huawei_hi3660/drivers/media/huawei/camera/hisp/hisp120/Kconfig
```kconfig
comment "HISI ISP"

choice
	prompt "HISP Version"
	default HUAWEI_CAMERA_USE_HISP120
	depends on HUAWEI_CAMERA
	help
        Select ISP version.

config HUAWEI_CAMERA_USE_HISP120
	bool "HISP120"
	depends on HUAWEI_CAMERA

endchoice
```

## android_kernel_huawei_hi3660/drivers/media/huawei/camera/hisp/hisp250/Kconfig
```kconfig
comment "HISI ISP"

choice
	prompt "HISP Version"
	default HUAWEI_CAMERA_USE_HISP250
	depends on HUAWEI_CAMERA
	help
        Select ISP version.

config HUAWEI_CAMERA_USE_HISP250
	bool "HISP250"
	depends on HUAWEI_CAMERA

endchoice
```
