## android_kernel_huawei_hi3660/drivers/media/huawei/camera/sensor/flash/Kconfig
```kconfig
if HISI_CAMERA_FLASH

menu "Hisilicon camera flash driver support"

config HISI_CAMERA_TPS61310
    tristate "TPS61310 camera flash driver"
    depends on HISI_CAMERA_FLASH
    default n
    ---help---
        TPS61310 camera flash driver

config HISI_CAMERA_LM3642
    tristate "LM3642  flash driver"
    depends on HISI_CAMERA_FLASH
    default n
    ---help---
        LM3642 camera flash driver

config HISI_CAMERA_LM3642_FRONT
    tristate "LM3642 front flash driver"
    depends on HISI_CAMERA_FLASH
    default n
    ---help---
        LM3642 front camera flash driver

config HISI_CAMERA_LM3642_IR
    tristate "LM3642 ir flash driver"
    depends on HISI_CAMERA_FLASH
    default n
    ---help---
        LM3642 ir camera flash driver

config HISI_CAMERA_MP3331_IR
    tristate "MP3331 ir flash driver"
    depends on HISI_CAMERA_FLASH
    default n
    ---help---
        MP3331 front camera flash driver

config HISI_CAMERA_MP3331
    tristate "MP3331  flash driver"
    depends on HISI_CAMERA_FLASH
    default n
    ---help---
        MP3331 camera flash driver

config HISI_CAMERA_MP3331_FRONT
    tristate "MP3331 front flash driver"
    depends on HISI_CAMERA_FLASH
    default n
    ---help---
        MP3331 front camera flash driver

config HISI_CAMERA_AW3642
    tristate "AW3642 flash driver"
    depends on HISI_CAMERA_FLASH
    default n
    ---help---
        AW3642 camera flash driver

config HISI_CAMERA_LM3646_FRONT
    tristate "LM3646 FRONT control camera flash driver"
    depends on HISI_CAMERA_FLASH
    default n
    ---help---
        LM3646 front camera flash driver

config HISI_CAMERA_LM3646
    bool "LM3646 camera flash driver"
    default n
    depends on HISI_CAMERA_FLASH    
    ---help---
        LM3646 front camera flash driver
config HISI_CAMERA_MP3336
    bool "MP3336 camera flash driver"
    default n
    depends on HISI_CAMERA_FLASH
    ---help---
        MP3336 camera flash driver

config HISI_CAMERA_LM3646_MIX
    bool "LM3646 mix camera flash driver"
    default n
    depends on HISI_CAMERA_FLASH
    ---help---
        LM3646 mix camera flash driver

config HISI_CAMERA_MP3336_MIX
    bool "MP3336 mix camera flash driver"
    default n
    depends on HISI_CAMERA_FLASH
    ---help---
        MP3336 mix camera flash driver

config HISI_CAMERA_MP3336_MIX_IR
    bool "MP3336 mix camera flash driver with IR"
    default n
    depends on HISI_CAMERA_FLASH
    ---help---
        MP3336 mix camera flash driver with IR

config HISI_CAMERA_LM3646_MIX_IR
    bool "LM3646 mix camera flash driver with IR"
    default n
    depends on HISI_CAMERA_FLASH
    ---help---
        LM3646 mix camera flash driver with IR

config HISI_CAMERA_PMU_LED
    tristate "PMU LED camera flash driver"
    depends on HISI_CAMERA_FLASH
    default n
    ---help---
        PMU LED camera flash driver

config HISI_CAMERA_SCHARGER
    bool "schage camera flash driver"
    default n
    depends on HISI_CAMERA_FLASH

endmenu

endif
```

## android_kernel_huawei_hi3660/drivers/mmc/Kconfig
```kconfig
#
# MMC subsystem configuration
#

menuconfig MMC
	tristate "HISI MMC/SD/SDIO card support"
	depends on HAS_IOMEM
	help
	  This selects MultiMediaCard, Secure Digital and Secure
	  Digital I/O support.

	  If you want MMC/SD/SDIO support, you should say Y here and
	  also to your specific host controller driver.

config HISI_MMC
	bool "HISI MMC"
	depends on MMC
	default y
	help
	   config HISI mmc driver

config SD_SDIO_CRC_RETUNING
	bool "SD SDIO CRC RETUNING"
	depends on MMC
	default n
	help
	   config HISI sd driver

config SD_TIMEOUT_RESET
	bool "SD STIMEOUT RESET"
	depends on MMC
	default n
	help
	   config HISI sd driver

config MMC_DEBUG
	bool "MMC debugging"
	depends on MMC != n
	help
	  This is an option for use by developers; most people should
	  say N here.  This enables MMC core and driver debugging.

config HISI_MMC_SECURE_RPMB
       bool "MMC RPMB Security Solution"
       depends on HISI_MMC
       help
         Enable this config will change the default behavior of RPMB
         HMAC calucation will be done in secure wolrd.

config HISI_RPMB_TIME_DEBUG
	bool "HISI STORAGE RPMB TIME DEBUG"
	help
         Enable HISI STORAGE RPMB TIME DEGUG.

config HISI_MMC_FLUSH_REDUCE
	bool "Flush Reduce on MMC"
	depends on MMC != n
	default n
	help
	   Enable this config will provide the flush reduce support in MMC

config HISI_MMC_FLUSH_REDUCE_WHITE_LIST
	bool "Flush Reduce eMMC devices white list"
	depends on HISI_MMC_FLUSH_REDUCE != n
	default n
	help
	   Enable this config will enfore white list check on eMMC devices for flush reduce

config HISI_MMC_MANUAL_BKOPS
	bool "MMC manual BKOPS support"
	depends on HISI_BK_OPS
	default n
	help
	 MMC manual BKOPS support

 config HUAWEI_SDCARD_DSM
	bool "Listen sdcard kernel err"
	depends on MMC != n
	default n
	help
	   use huawei sdcard log radar
config HUAWEI_EMMC_DSM
	bool "Listen eMMC kernel err"
	depends on MMC != n
	default n
	help
	   use huawei emmc log radar

config HUAWEI_EMMC_DSM_ONLY_VDET
	bool "Listen eMMC low voltage err"
	depends on MMC != n
	default n
	help
	   use device radar only to record emmc vdet log


if MMC

source "drivers/mmc/core/Kconfig"

source "drivers/mmc/card/Kconfig"

source "drivers/mmc/host/Kconfig"

endif # MMC
```

## android_kernel_huawei_hi3660/drivers/power/hisi/charger/Kconfig
```kconfig
config HISI_CHARGER
	bool "hisi charger"
	default n
config HISI_CHARGER_ARCH
	bool "hisi charger arch"
	default n
config BQ25892_CHARGER
	bool "bq25892 charger"
	default n
config SCHARGER_V200
	bool "schargerV200"
	default n
config SCHARGER_V300
	bool "schargerV300"
	default n
config HI6523_CHARGER_SENSORHUB
	bool "hi6523 charger sensorhub"
	depends on INPUTHUB
	default n
config SCHARGER_V600
	bool "schargerV600"
	default n
config HISI_CHARGER_SYS_WDG
	bool "hisi charger sys watchdog"
	default n
```

## android_kernel_huawei_hi3660/drivers/power/hisi/soh/Kconfig
```kconfig
config HISI_SOH
        bool "hisi soh"
        default n

config HISI_SOH_PMIC
        bool "hisi soh pmic driver"
        default n

config HISI_SOH_HI6531
        bool "hisi soh hi6531 driver"
        default n
```

## android_kernel_huawei_hi3660/drivers/spmi_hisi/Kconfig
```kconfig
#
# HISI SPMI driver configuration
#


config HISI_SPMI
	tristate "HISI SPMI Controller"
	help
	  enabel hisi spmi

config HISI_SPMI_DEBUG_FS
	tristate "HISI SPMI Controller Debug"
	depends on HISI_SPMI
	depends on HISI_DEBUG_FS
	help
	  enable hisi spmi debug fs
```

## android_kernel_huawei_hi3660/drivers/staging/android/Kconfig
```kconfig
menu "Android"

if ANDROID

config ASHMEM
	bool "Enable the Anonymous Shared Memory Subsystem"
	default n
	depends on SHMEM
	---help---
	  The ashmem subsystem is a new shared memory allocator, similar to
	  POSIX SHM but with different behavior and sporting a simpler
	  file-based API.

	  It is, in theory, a good memory allocator for low-memory devices,
	  because it can discard shared memory units when under memory pressure.

config ANDROID_TIMED_OUTPUT
	bool "Timed output class driver"
	default y

config ANDROID_TIMED_GPIO
	tristate "Android timed gpio driver"
	depends on GPIOLIB || COMPILE_TEST
	depends on ANDROID_TIMED_OUTPUT
	default n
        ---help---
	  Unlike generic gpio is to allow programs to access and manipulate gpio
	  registers from user space, timed output/gpio is a system to allow changing
	  a gpio pin and restore it automatically after a specified timeout.

config ANDROID_LOW_MEMORY_KILLER
	bool "Android Low Memory Killer"
	---help---
	  Registers processes to be killed when low memory conditions, this is useful
	  as there is no particular swap space on android.

	  The registered process will kill according to the priorities in android init
	  scripts (/init.rc), and it defines priority values with minimum free memory size
	  for each priority.

config ANDROID_LOW_MEMORY_KILLER_AUTODETECT_OOM_ADJ_VALUES
	bool "Android Low Memory Killer: detect oom_adj values"
	depends on ANDROID_LOW_MEMORY_KILLER
	default y
	---help---
	  Detect oom_adj values written to
	  /sys/module/lowmemorykiller/parameters/adj and convert them
	  to oom_score_adj values.

config ANDROID_INTF_ALARM_DEV
	bool "Android alarm driver"
	depends on RTC_CLASS
	default n
	---help---
	  Provides non-wakeup and rtc backed wakeup alarms based on rtc or
	  elapsed realtime, and a non-wakeup alarm on the monotonic clock.
	  Also exports the alarm interface to user-space.

config ANDROID_VSOC
	tristate "Android Virtual SoC support"
	default n
	depends on PCI_MSI
	---help---
	  This option adds support for the Virtual SoC driver needed to boot
	  a 'cuttlefish' Android image inside QEmu. The driver interacts with
	  a QEmu ivshmem device. If built as a module, it will be called vsoc.

config HISI_SMART_RECLAIM
	bool "Enable smart reclaim"
	default y
	depends on PROCESS_RECLAIM
	help
	  When enabled, memory pages of background processes will be reclaimed.
	  Depending on if the process is an application or service.
	  In case of service, advise kernel to reclaim file backed pages
	  of background processes(file tpyes .dex, .jar and/or .apk).
	  This triggered by writting soft to /proc/<pid>/reclaim from user space.

config HUAWEI_RCC
	tristate "RAM Compress and Clean"
	depends on SYSFS && SWAP
	default n
	help
	  Creates background thread for compress and clean used RAM
	  dynamiclly,enabled by write 1 to /sys/kernel/rcc/enable.

config HUAWEI_RCC_DEBUG
	bool "RAM Compress and Clean debug support"
	depends on HISI_RCC
	default n
	help
	  This option adds additional debugging code to the
	  RAM Compress and Clean module.

source "drivers/staging/android/ion/Kconfig"

source "drivers/staging/android/fiq_debugger/Kconfig"

source "drivers/staging/android/hwlogger/Kconfig"

endif # if ANDROID

endmenu
```

## android_kernel_huawei_hi3660/drivers/staging/android/hwlogger/Kconfig
```kconfig
config HW_LOGGER
	bool "Huawei log driver"
	default n
	---help---
	  This adds support for system-wide logging using two log buffers.
	  Plus adds reboot watchdog for triggering logcat and xlogcat flush.

	  These are:

	      1: hwlog_exception
	      2: hwlog_jank
```

## android_kernel_huawei_hi3660/drivers/thermal/hisi/Kconfig
```kconfig
config HISI_IPA_THERMAL
	tristate "Temperature sensor on ARM SoC based on HISI_THERMAL_TSENSOR interface"
	depends on HISI_THERMAL_TSENSOR
	depends on CPU_FREQ
	depends on OF
	select THERMAL_POWER_ACTOR_CPU
	help
	  Support for the HISI thermal sensor driver in the Linux thermal
	  framework.
config HISI_THERMAL_TSENSOR
	tristate "Hisi thermal sensor driver"
	default n
	help
	  Enable this to plug the thermal sensor driver into the Linux
	  thermal framework

config HISI_THERMAL_PERIPHERAL
	tristate "Hisi peripheral thermal driver"
	default n
	help
	  Enable this to plug the peripheral thermal sensor driver into the Linux
	  thermal framework

config HISI_THERMAL_PERIPHERAL_HIGHRESTEMP
	bool "High resolution thermal format for Hisi peripheral thermal driver"
	depends on HISI_THERMAL_PERIPHERAL
	default n
	help
	  Enable this to use hi-resolution temperature format for PERIPHERAL thermal.

config HISI_THERMAL_CONTEXTHUB
	bool "Hisi contexthub thermal driver"
	default n
	help
	  Enable Contexthub Thermal

config HISI_THERMAL_SPM
	bool "Hisi sustainable performance mode"
	depends on HISI_IPA_THERMAL
	default n
	help
	  Enable sustainable performance mode

config HISI_THERMAL_HOTPLUG
	bool "Hisi thermal hotplug support"
	depends on HOTPLUG_CPU
	depends on HISI_IPA_THERMAL
	default n
	help
	  Enable thermal hotplug

config HISI_HOTPLUG_EMULATION
	bool "Hisi thermal hotplug emulation support"
	depends on HISI_THERMAL_HOTPLUG
	default n
	help
	  Enable thermal hotplug emulation

config HISI_THERMAL_TRIP
	bool "Hisi trip point for thermal zone"
	depends on HISI_THERMAL_TSENSOR
	depends on HISI_THERMAL_PERIPHERAL
	depends on HISI_BCI_BATTERY
	default n
	help
	  Enable trip point for thermal zone

config HISI_THERMAL_SHELL
	bool "Hisi shell temp calculation"
	depends on HISI_THERMAL_PERIPHERAL
	depends on HISI_COUL
	default n
	help
	  Enable shell temp calculation
config HISI_SHELL_TEMP_DEBUG
	bool "Hisi shell temp debug configuration"
	depends on HISI_THERMAL_SHELL
	default n
	help
	  Enable debug node for shell temp calculation

config HISI_THERMAL_AMBIENT
	bool "Hisi ambient temp calculation"
	depends on HISI_THERMAL_PERIPHERAL
	depends on HISI_COUL
	default n
	help
	  Enable ambient temp calculation

config HISI_THERMAL_TRIPPLE_CLUSTERS
        bool "Hisi thermal support tripple clusters."
        depends on HISI_IPA_THERMAL
        default n
        help
          Support for the HISI tripple clusters.
```

## android_kernel_huawei_hi3660/drivers/usb/proxy-hcd/Kconfig
```kconfig
config USB_PROXY_HCD
	tristate "Hisilicon Proxy Host Controller Driver"
	depends on USB
	help
	  Say Y here if your system has a USB Host Controller that can be
	  accessed via proxy.

config USB_PROXY_HCD_DEBUG
	bool "Hisilicon Proxy Host Controller Driver Debug"
	depends on USB_PROXY_HCD
	help
	  enable proxy HCD debug or not.

config HIFI_USB_HAS_H2X
	bool "HiFi USB has h2x bridge in ASP"
	depends on USB_PROXY_HCD
	help
	  Say Y here if there is h2x bridge in ASP
```

## android_kernel_huawei_hi3660/drivers/usb/susb/Kconfig
```kconfig
#
# USB Dual Role (OTG-ready) Controller Drivers
# for silicon based on Synopsys designs
#

comment "Enable Host or Gadget support to see Synopsys options"
	depends on !USB && USB_GADGET=n

# (S)HDRC = (Synopsys) DWC
config USB_SUSB_HDRC
	depends on (USB || USB_GADGET)
	select USB_OTG_UTILS
	tristate 'Synopsys Highspeed Dual Role Controller '
	help
	  Say Y here if your system has a dual role high speed USB
	  controller based on the Synopsis USB2.0 OTG silicon IP.

config DEC_USB
	depends on USB_SUSB_HDRC
	bool 'USB for dec'
	default n

config USB_DEBUG_NODE
	bool 'SUSB DEBUG NODE for dec'
```

## android_kernel_huawei_hi3660/drivers/vcodec/hi_vcodec/vdec/Kconfig
```kconfig
menu "Hisilicon video vdec support"
config HI_VCODEC_VDEC_HI3660
    tristate "Hisilicon video decoder support"
    default n
    help
      This is the hisilicon decoder driver
endmenu
```

## android_kernel_huawei_hi3660/drivers/vcodec/hi_vcodec/venc/drv/venc/Kconfig
```kconfig
menu "Hisilicon video venc support"
config HI_VCODEC_VENC_HI3660
    #depends on ANDROID_PMEM
    tristate "Support for venc"
    default n
    help
        The decode device provides venc function
endmenu
```

## android_kernel_huawei_hi3660/drivers/vcodec/hi_vcodec/venc_hivna/drv/venc/Kconfig
```kconfig
menu "Hisilicon video venc support"
config HI_VCODEC_VENC_HIVNA
    #depends on ANDROID_PMEM
    tristate "Support for venc"
    default n
    help
        The decode device provides venc function
endmenu
```

## android_kernel_huawei_hi3660/drivers/vcodec/imagination/D5500_DRM/Kconfig
```kconfig
menuconfig IMAGINATION_D5500_DRM_VCODEC
    tristate "Hi3xxx Support DRM IMG Video Codec Drivers"
    default n
    ---help---
      This is the codec driver based on hi3xxx.

if IMAGINATION_D5500_DRM_VCODEC      
source "drivers/vcodec/imagination/D5500_DRM/imgvideo/Kconfig"
source "drivers/vcodec/imagination/D5500_DRM/decoder/vdec/Kconfig"
source "drivers/vcodec/imagination/D5500_DRM/encoder/DDK4/Kconfig"
endif
```
