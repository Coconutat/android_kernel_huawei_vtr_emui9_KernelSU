## android_kernel_huawei_hi3660/drivers/hisi/l3cache/Kconfig
```kconfig
menu "Hisi L3 Cache"
config HISI_L3CACHE_SHARE
	bool "l3cache share"
	default n
	help
	 support l3cache share

config HISI_L3CACHE_SHARE_PERF
	bool "l3cache share perf"
	depends on HISI_L3CACHE_SHARE && ARM64_DSU_PCTRL_DEVFREQ
	default n
	help
	 support l3cache share perf

config HISI_L3CACHE_SHARE_DEBUG
	bool "l3cache share debug"
	depends on HISI_L3CACHE_SHARE
	default n
	help
	 support l3cache share debug

config HISI_L3CACHE_LP_DEBUG
	bool "l3cache lowpower debug"
	default n
	help
	 support l3cache low power debug

endmenu
```

## android_kernel_huawei_hi3660/drivers/hisi/load_image/Kconfig
```kconfig
config LOAD_IMAGE
	bool "Support HiSilicon load image"
	default n
	depends on TZDRIVER
	help
	  This driver supports HiSilicon LOAD IMAGE
```

## android_kernel_huawei_hi3660/drivers/hisi/memory_dump/Kconfig
```kconfig
config HISILICON_PLATFORM_KERNELDUMP
	bool "Support HiSilicon KERNELDUMP"
	default n
	help
	  This driver supports HiSilicon HiXXX KERNELDUMP,
	  including hisilicon kerneldump driver.

config HISI_KERNELDUMP
	bool "Support HiSilicon Hisi KERNELDUMP"
	default n
	help
	  This driver supports HiSilicon HiXXX KERNELDUMP,
	  including hisilicon kerneldump driver.

config KERNELDUMP_KO_DBG
	bool "Support hisi ko mem dump"
	depends on HISI_KERNELDUMP
	default n
	help
	  This driver supports HiSilicon HiXXX ko dump,
	  including hisilicon ko dump driver.
```

## android_kernel_huawei_hi3660/drivers/hisi/mntn/Kconfig
```kconfig
config HISILICON_PLATFORM_MAINTAIN
	bool "Hisilicon platform maintain module support"
	default n
	help
	  Say yes here to support the hisilicon platform maintain module

config HISILICON_PLATFORM_HISI_EASYSHELL
	bool "Support HiSilicon Hi6XXX Easy Shell"
	default n
	help
	  This driver supports HiSilicon HiXXX SOC,
	  including easy shell, etc.
source "drivers/hisi/mntn/blackbox/Kconfig"
source "drivers/hisi/mntn/hisee/Kconfig"
source "drivers/hisi/mntn/bl31/Kconfig"
source "drivers/hisi/mntn/subpmu/Kconfig"


config HISI_VIRT_TO_PHYS
	bool "support converting virtual address to physical address"
	default n
	help
	  Say 'Y' here if you want to support virtual address to physical address enable.

config HISI_BOOT_TIME
	bool "support print all boot slice"
	default n
	help
	  Say 'Y' here if you want to print all boot slice.

config HISI_BB_SYSCALL
	bool "support print system call trace "
	default n
	help
	  Say 'Y' here if you want to print system call trace.

config HISI_POWER_OFF
	bool "Hisilicon platform power off and reset driver"
	default n
	help
	  Power off and reset support for the Hisilicon boards.

config HISI_FIQ
	bool "Hisilicon platform fiq dump driver"
	default n
	help
	   Say 'Y' here if you want to support fiq dump.

config HISI_MNTNDUMP
        bool "Hisilicon platform mntn dump driver"
        default n
        help
           Say 'Y' here if you want to support mntn dump.

config HISI_DEBUG_FS
	bool "Hisilicon platform debugfs"
	depends on DEBUG_FS
	help
		hisi debugfs disable by self

config HISI_RECORD_SP
        bool "Hisilicon platform mntn record sp"
		depends on FUNCTION_TRACER
		default n
        help
           Say 'Y' here if you want to support record sp.

config HISI_L3CACHE_ECC
        bool "Hisilicon platform l3cache ecc driver"
        default n
        help
           Say 'Y' here if you want to support l3cache ecc.

config HISI_L3CACHE_ECC_DEBUG
        bool "Hisilicon platform l3cache ecc debug"
        default n
        help
           Say 'Y' here if you want to support l3cache ecc debug.

config HISI_CLANG
        bool "clang compiler auxiliary for kernel"
        default n
        help
           Say 'Y' here if you want to support clang.
```

## android_kernel_huawei_hi3660/drivers/hisi/mntn/bl31/Kconfig
```kconfig
config HISI_BL31_MNTN
    bool "bl31 mntn module support"
    default n
    help
      Say yes here to support the bl31 mntn module.
```

## android_kernel_huawei_hi3660/drivers/hisi/mntn/blackbox/Kconfig
```kconfig
menu "RDR - Running data recorder menu"

config HISI_BB
	bool "kernel run data recorder"
	depends on SYSFS
	default n
	help
	  This module can record some data about kernel internal info.
	  Include:
	  the task switch,
	  interrupts switch,
	  arm exception info,
	  etc ...

config HISI_BB_DEBUG
	bool "test unit for kernel run data recorder"
	depends on SYSFS && HISI_BB
	default n
	help
	  This module can test RDR function ...
	  Include:
	  dataabort,
	  etc

# need_other_module_clear
config HISI_MNTN_SP
	bool "hisi ap core register sp record"
	depends on  HISI_LPMCU_BB
	default n

config HISI_LPMCU_BB
	bool "hisi lpmcu bbox"
	depends on  HISI_BB
	default n

config HISI_HIFI_BB
	bool "hisi hifi bbox"
	depends on  HISI_BB
	default n

# need_other_module_clear
config HISI_ISP_RDR
	bool "hisi isp rdr"
	depends on HISI_BB
	default n

config HISI_MEM_TRACE
	bool "hisi mem trace"
	depends on HISI_BB
	default n

config HISI_DFX_CORE
	bool "hisi dfx core"
	depends on HISI_BB
	default n
	help
	  This module can record some data to dfx partition.

config HISI_MNTN_ESUBTYPE
	bool "hisi exception subtype"
	depends on HISI_BB
	default n
	help
	  This module can record exception subtype.

config HISI_BB_DIAGINFO
	bool "hisi diaginfo"
	depends on HISI_BB
	default n
	help
	  This module used to record nonreset exception.

source "drivers/hisi/mntn/blackbox/platform_ap/Kconfig"
source "drivers/hisi/hifi_dsp/Kconfig"
endmenu
```

## android_kernel_huawei_hi3660/drivers/hisi/mntn/hisee/Kconfig
```kconfig
config HISI_HISEE_MNTN
    bool "hisee mntn module support"
    default n
    help
      Say yes here to support the hisee mntn module.

config HISI_HISEE_MNTN_TEST
    bool "hisee mntn test"
    default n
    help
      Say yes here to support the hisee mntn test.

config HISI_HISEE_NVMFORMAT_TEST
    bool "hisee nvm format"
    default n
    help
      Say yes here to support the hisee nvm format.

config HISI_MNTN_CHECKMISC
    bool "chech misc ver"
    default n
    help
      Say yes here to support checking misc version.
```

## android_kernel_huawei_hi3660/drivers/hisi/modem/Kconfig
```kconfig
menu "Hisi Modem"
config HISI_BALONG_MODEM
	bool "Hisilicon ap+modem config"
	default n
	help
	Hisilicon ap+modem config support.

config HISI_BALONG_MODEM_HI3650
	bool "Hisilicon ap+modem config"
	default n
	help
	Hisilicon ap+modem config support.

config BALONG_OAM_PS
	tristate "support tlmsp tlps gumsp gups taf"
	default n
	help
	tlmsp tlps gumsp gups taf acore image

config VOWIFI_NEW_FRW
	bool "vowifi android n&o frw diff"
	default n
	help
	vowifi android n&o frw diff

source "drivers/hisi/modem/drv/Kconfig"
endmenu
```

## android_kernel_huawei_hi3660/drivers/hisi/modem/drv/Kconfig
```kconfig
menu "Modem Drivers"

source "drivers/hisi/modem/drv/ipc/Kconfig"
source "drivers/hisi/modem/drv/icc/Kconfig"
source "drivers/hisi/modem/drv/sec_call/Kconfig"
source "drivers/hisi/modem/drv/balong_timer/Kconfig"
source "drivers/hisi/modem/drv/reset/Kconfig"
source "drivers/hisi/modem/drv/rfile/Kconfig"
source "drivers/hisi/modem/drv/nvim/Kconfig"
source "drivers/hisi/modem/drv/s_memory/Kconfig"
source "drivers/hisi/modem/drv/hwadp/Kconfig"
source "drivers/hisi/modem/drv/onoff/Kconfig"
source "drivers/hisi/modem/drv/efuse/Kconfig"
source "drivers/hisi/modem/drv/loadm/Kconfig"
source "drivers/hisi/modem/drv/udi/Kconfig"
source "drivers/hisi/modem/drv/sysctrl/Kconfig"
source "drivers/hisi/modem/drv/mem/Kconfig"
source "drivers/hisi/modem/drv/sync/Kconfig"
source "drivers/hisi/modem/drv/sc/Kconfig"
source "drivers/hisi/modem/drv/ipf/Kconfig"
source "drivers/hisi/modem/drv/psam/Kconfig"
source "drivers/hisi/modem/drv/n_ipf/Kconfig"
source "drivers/hisi/modem/drv/n_psam/Kconfig"
source "drivers/hisi/modem/drv/dump/Kconfig"
source "drivers/hisi/modem/drv/pm_om/Kconfig"
source "drivers/hisi/modem/drv/ocp/Kconfig"
source "drivers/hisi/modem/drv/sim_hotplug/Kconfig"
source "drivers/hisi/modem/drv/bbp/Kconfig"
endmenu
```

## android_kernel_huawei_hi3660/drivers/hisi/modem/drv/bbp/Kconfig
```kconfig
#
# ccore image load
#

comment "ccore image load driver"

config BBP_ACORE
	tristate "bbp drivers in acore"
	default n
	help
	  BBP drivers in acore
```

## android_kernel_huawei_hi3660/drivers/hisi/modem/drv/icc/Kconfig
```kconfig
#
# multicore communication driver
#

comment "multicore communication driver"

config ICC_BALONG
	tristate "support icc"
	depends on IPC_DRIVER
	default n
	help
	  ICC driver

config CA_ICC
	tristate "ca icc"
	default n
	help
	  ca icc

config ICC_BALONG_TEST
	tristate "icc test"
	depends on ICC_BALONG
	default n
	help
	  ICC test
```

## android_kernel_huawei_hi3660/drivers/hisi/modem/drv/sim_hotplug/Kconfig
```kconfig
#
#Hisilicon HISI SIM hotplug support.
#
config HISI_SIM_HOTPLUG
	bool "support sim hotplug function"
	default n
	help
	  Say 'Y' here if you want to support the SIM HOTPLUG.

config HISI_SIM_HOTPLUG_SPMI
	bool "support spmi sim hotplug function"
	default n
	help
	  Say 'Y' here if you want to support the SPMI SIM HOTPLUG.
```

## android_kernel_huawei_hi3660/drivers/hisi/pm/Kconfig
```kconfig
menu "Hisi S/R options"

config HISI_SR
	bool "support hi3xxx suspend and resume"
	depends on SUSPEND
	default n
	help
	   support hi3xxx suspend and resume

config HISI_SR_DEBUG
	bool "hisi suspend-resume debug interface"
	depends on PM
	default n
	help
	suspend-resume debug for hisi platform

config HISI_SR_DEBUG_SLEEP
	bool "hisi suspend-resume debug sleep"
	depends on PM
	default n
	help
	suspend-resume debug sleep for hisi platform

config HISI_SR_SYNC
	bool "Hisilicon suspend optimization"
	depends on SUSPEND
	default n
	help
	  Driver for suspend optimization

config PM_SEC_GPIO
	bool "Hisilicon have SEC GPIO"
	default n
	help
	  tell us if this platform have SEC GPIO

config PM_SEC_IO
	bool "Hisilicon have SEC IO"
	default n
	help
	  tell us if this platform have SEC IO

config HISI_SR_TICK
	bool "Hisilicon sr tick"
	depends on SUSPEND
	default n
	help
	  mark kernel sr position

config PM_FCM
	bool "Hisilicon FCM architecture"
	default n
	help
	  FCM architecture

endmenu
```

## android_kernel_huawei_hi3660/drivers/hisi/test_spinlock/Kconfig
```kconfig
config HISI_GETSPINLOCK_TEST
	bool "Hisilicon spinlock test driver"
	default n
	help
	  hisilicon spinlock test.
```

## android_kernel_huawei_hi3660/drivers/hisi/timekeeper/Kconfig
```kconfig
config HISI_TIMEKEEPER
	bool"Hisilicon high solution time-keeper driver"
	default n
	help
	  hisilicon high solution time-keeper,
	  we take a sp804 timer as persistent timer in suspend/resume,
	  because sp804 runs in 32k frequence, much more accurate than RTC.
```

## android_kernel_huawei_hi3660/drivers/hisi/tlb_conflict/Kconfig
```kconfig
config TLB_CONFLICT_WORKAROUND
	bool "Artemis: work around for tlb conflict in high load"
	default n
	help
	  This option enable the work around for tlb conflict error in
	  Artemis. We found, when Artemis runs in high load, 2 same translate
	  items may appear in the tlb, we shall flush the tlb, the conflict
	  shall be ignored.
```

## android_kernel_huawei_hi3660/drivers/huawei_platform/antenna_board_match/Kconfig
```kconfig
menuconfig HW_ANTENNA_BOARD_MATCH
	bool "antenna_board_match support"
	default n
	help
	Say yes here to support antenna boardid detection

if HW_ANTENNA_BOARD_MATCH

source "drivers/huawei_platform/antenna_board_match/antenna_board_adc_match/Kconfig"

endif
```

## android_kernel_huawei_hi3660/drivers/huawei_platform/audio/Kconfig
```kconfig
menu "Audio configuration"
config HUAWEI_AUDIO
        bool "Audio support"
        default n
        select REGMAP_I2C
        help
          Enable support for audio
if HUAWEI_AUDIO
source "drivers/huawei_platform/audio/maxim/Kconfig"
source "drivers/huawei_platform/audio/tfa9895/Kconfig"
source "drivers/huawei_platform/audio/tas2560/Kconfig"
source "drivers/huawei_platform/audio/tfa98xx/Kconfig"
source "drivers/huawei_platform/audio/invert_hs/Kconfig"
source "drivers/huawei_platform/audio/anc_hs_module/Kconfig"
source "drivers/huawei_platform/audio/ak4376/Kconfig"
source "drivers/huawei_platform/audio/ak4376-kernel-4-1/Kconfig"
source "drivers/huawei_platform/audio/hifi_vir_dai/Kconfig"
source "drivers/huawei_platform/audio/usb_analog_hs_module/Kconfig"
source "drivers/huawei_platform/audio/usb_audio_power/Kconfig"
source "drivers/huawei_platform/audio/usb_audio_common/Kconfig"
endif # if HUAWEI_AUDIO
endmenu
```

## android_kernel_huawei_hi3660/drivers/huawei_platform/audio/ak4376/Kconfig
```kconfig
config AK4376
    tristate "AK4376 Driver for headset hifi"
	default n
	help
		Say Y to enable AK4376 Driver Support For headset hifi
```

## android_kernel_huawei_hi3660/drivers/huawei_platform/audio/anc_hs_module/Kconfig
```kconfig
menuconfig ANC_HS_MODULE
       bool "ANC headset drivers support"
       default n
       help
       Say yes here to support the ANC headset module

if ANC_HS_MODULE
config ANC_HS_INTERFACE
	tristate "Support for ANC_HS_INTERFACE"
	default n
	---help---
	 Say Y here if you want to support ANC_HS_INTERFACE
config ANC_HS
	tristate "Support for ANC headset"
	default n
	---help---
	 Say Y here if you want to support ANC headset
config ANC_MAX14744
	tristate "Support for ANC MAX14744"
	default n
	---help---
	 Say Y here if you want to support ANC MAX14744
config ANC_DEFAULT
	tristate "Support for ANC DEFAULT"
	default n
	---help---
	 Say Y here if you want to support ANC DEFAULT
config ANC_NCX8293
	tristate "Support for ANC NCX8293"
	default n
	---help---
	 Say Y here if you want to support ANC NCX8293
endif #ANC_HS_MODULE
```

## android_kernel_huawei_hi3660/drivers/huawei_platform/audio/tas2560/Kconfig
```kconfig
menuconfig SND_SOC_TAS2560
	tristate "Texas Instruments TAS2560 SmartAmp(R)"

if SND_SOC_TAS2560
config TAS2560_I2C
    bool "Use of I2C RegMap API"

config TAS2560_MISC
    bool "Misc Driver support"

endif # SND_SOC_TAS2560
```

## android_kernel_huawei_hi3660/drivers/huawei_platform/audio/usb_audio_common/Kconfig
```kconfig
config USB_AUDIO_COMMON
	tristate "Support for usb audio common control"
	default n
	---help---
	 Say Y here if you want to support usb audio common control
```

## android_kernel_huawei_hi3660/drivers/huawei_platform/boottime/Kconfig
```kconfig
config HUAWEI_BOOT_TIME
	default n
	  bool "huawei boot time"
	help
	  only open on eng mode.
```

## android_kernel_huawei_hi3660/drivers/huawei_platform/connectivity/bcm/gps/bcm4752/Kconfig
```kconfig
menuconfig BCMGPS4752
	tristate "Bcm4752 gps support"
	default n
	help
	  Say Y here to enable bcm4752 gps support. This allows
	  ap to control this module.
```
