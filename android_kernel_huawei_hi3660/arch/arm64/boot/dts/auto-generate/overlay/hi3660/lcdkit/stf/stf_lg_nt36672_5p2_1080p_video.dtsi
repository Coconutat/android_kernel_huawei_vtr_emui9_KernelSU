/* Copyright (c) 2013, The Linux Foundation. All rights reserved.
 *
 * This program is free software; you can redistribute it and/or modify
 * it under the terms of the GNU General Public License version 2 and
 * only version 2 as published by the Free Software Foundation.
 *
 * This program is distributed in the hope that it will be useful,
 * but WITHOUT ANY WARRANTY; without even the implied warranty of
 * MERCHANTABILITY or FITNESS FOR A PARTICULAR PURPOSE.  See the
 * GNU General Public License for more details.
 */

/*-------------------------------------------------------------------------
 * This file is autogenerated file using gcdb parser. Please do not edit it.
 * Update input XML file to add a new entry or update variable in this file
 * VERSION = 1.1
 *-----------------------------------------------------------------------*/
/ {
	dsi_stf_lg_nt36672_5p2_1080p_video: lcdkit_stf_lg_nt36672_5p2_1080p_video {
		compatible = "lg_nt36672_5p2_1080P_video";
		hw,lcdkit-panel-name = "STAF_04 100 0";
		hw,lcdkit-panel-type = <0x01>;
		hw,lcdkit-panel-xres = <1080>;
		hw,lcdkit-panel-yres = <1920>;
		hw,lcdkit-panel-width = <65>;
		hw,lcdkit-panel-height = <115>;
		hw,lcdkit-panel-on-command = <0x15 0x01 0x00 0x00 0x01 0x01 0x02 0xFF 0x20
			0x15 0x01 0x00 0x00 0x0a 0x00 0x02 0xFB 0x01
			0x29 0x01 0x00 0x00 0x1a 0x00 0x11 0xB0 0x00 0x00 0x00 0x16 0x00 0x49 0x00 0x6A 0x00 0x7F 0x00 0x95 0x00 0xB3 0x00 0xBC
			0x29 0x01 0x00 0x00 0x1a 0x00 0x11 0xB1 0x00 0xCD 0x01 0x00 0x01 0x28 0x01 0x61 0x01 0x8D 0x01 0xCF 0x02 0x04 0x02 0x06
			0x29 0x01 0x00 0x00 0x1a 0x00 0x11 0xB2 0x02 0x39 0x02 0x73 0x02 0x9A 0x02 0xD1 0x02 0xF8 0x03 0x30 0x03 0x3E 0x03 0x50
			0x29 0x01 0x00 0x00 0x16 0x00 0x0D 0xB3 0x03 0x5A 0x03 0x6E 0x03 0x86 0x03 0xA3 0x03 0xBA 0x03 0xFF
			0x29 0x01 0x00 0x00 0x1a 0x00 0x11 0xB4 0x00 0x00 0x00 0x15 0x00 0x48 0x00 0x65 0x00 0x7F 0x00 0x96 0x00 0xA9 0x00 0xBC
			0x29 0x01 0x00 0x00 0x1a 0x00 0x11 0xB5 0x00 0xCC 0x01 0x00 0x01 0x2A 0x01 0x64 0x01 0x90 0x01 0xD2 0x02 0x08 0x02 0x0A
			0x29 0x01 0x00 0x00 0x1a 0x00 0x11 0xB6 0x02 0x3D 0x02 0x78 0x02 0x9F 0x02 0xD7 0x02 0xFE 0x03 0x36 0x03 0x41 0x03 0x53
			0x29 0x01 0x00 0x00 0x16 0x00 0x0D 0xB7 0x03 0x5A 0x03 0x6E 0x03 0x86 0x03 0xA3 0x03 0xBA 0x03 0xFF
			0x29 0x01 0x00 0x00 0x1a 0x00 0x11 0xB8 0x00 0x00 0x00 0x1A 0x00 0x4B 0x00 0x6E 0x00 0x89 0x00 0xA0 0x00 0xB0 0x00 0xC8
			0x29 0x01 0x00 0x00 0x1a 0x00 0x11 0xB9 0x00 0xD6 0x01 0x09 0x01 0x30 0x01 0x69 0x01 0x93 0x01 0xD4 0x02 0x09 0x02 0x0B
			0x29 0x01 0x00 0x00 0x1a 0x00 0x11 0xBA 0x02 0x3D 0x02 0x77 0x02 0x9E 0x02 0xD6 0x02 0xFD 0x03 0x38 0x03 0x42 0x03 0x53
			0x29 0x01 0x00 0x00 0x16 0x00 0x0D 0xBB 0x03 0x59 0x03 0x6D 0x03 0x85 0x03 0xA2 0x03 0xBA 0x03 0xFF
			0x15 0x01 0x00 0x00 0x01 0x01 0x02 0xFF 0x21
			0x15 0x01 0x00 0x00 0x0a 0x00 0x02 0xFB 0x01
			0x29 0x01 0x00 0x00 0x1a 0x00 0x11 0xB0 0x00 0x00 0x00 0x16 0x00 0x49 0x00 0x6A 0x00 0x7F 0x00 0x95 0x00 0xB3 0x00 0xBC
			0x29 0x01 0x00 0x00 0x1a 0x00 0x11 0xB1 0x00 0xCD 0x01 0x00 0x01 0x28 0x01 0x61 0x01 0x8D 0x01 0xCF 0x02 0x04 0x02 0x06
			0x29 0x01 0x00 0x00 0x1a 0x00 0x11 0xB2 0x02 0x39 0x02 0x73 0x02 0x9A 0x02 0xD1 0x02 0xF8 0x03 0x30 0x03 0x3E 0x03 0x50
			0x29 0x01 0x00 0x00 0x16 0x00 0x0D 0xB3 0x03 0x5A 0x03 0x6E 0x03 0x86 0x03 0xA3 0x03 0xBA 0x03 0xFF
			0x29 0x01 0x00 0x00 0x1a 0x00 0x11 0xB4 0x00 0x00 0x00 0x15 0x00 0x48 0x00 0x65 0x00 0x7F 0x00 0x96 0x00 0xA9 0x00 0xBC
			0x29 0x01 0x00 0x00 0x1a 0x00 0x11 0xB5 0x00 0xCC 0x01 0x00 0x01 0x2A 0x01 0x64 0x01 0x90 0x01 0xD2 0x02 0x08 0x02 0x0A
			0x29 0x01 0x00 0x00 0x1a 0x00 0x11 0xB6 0x02 0x3D 0x02 0x78 0x02 0x9F 0x02 0xD7 0x02 0xFE 0x03 0x36 0x03 0x41 0x03 0x53
			0x29 0x01 0x00 0x00 0x16 0x00 0x0D 0xB7 0x03 0x5A 0x03 0x6E 0x03 0x86 0x03 0xA3 0x03 0xBA 0x03 0xFF
			0x29 0x01 0x00 0x00 0x1a 0x00 0x11 0xB8 0x00 0x00 0x00 0x1A 0x00 0x4B 0x00 0x6E 0x00 0x89 0x00 0xA0 0x00 0xB0 0x00 0xC8
			0x29 0x01 0x00 0x00 0x1a 0x00 0x11 0xB9 0x00 0xD6 0x01 0x09 0x01 0x30 0x01 0x69 0x01 0x93 0x01 0xD4 0x02 0x09 0x02 0x0B
			0x29 0x01 0x00 0x00 0x1a 0x00 0x11 0xBA 0x02 0x3D 0x02 0x77 0x02 0x9E 0x02 0xD6 0x02 0xFD 0x03 0x38 0x03 0x42 0x03 0x53
			0x29 0x01 0x00 0x00 0x16 0x00 0x0D 0xBB 0x03 0x59 0x03 0x6D 0x03 0x85 0x03 0xA2 0x03 0xBA 0x03 0xFF
			0x15 0x01 0x00 0x00 0x01 0x01 0x02 0xFF 0x23
			0x15 0x01 0x00 0x00 0x0a 0x00 0x02 0xFB 0x01
			0x15 0x01 0x00 0x00 0x0a 0x00 0x02 0x00 0x00
			0x15 0x01 0x00 0x00 0x0a 0x00 0x02 0x01 0x84
			0x15 0x01 0x00 0x00 0x0a 0x00 0x02 0x05 0x24
			0x15 0x01 0x00 0x00 0x0a 0x00 0x02 0x30 0xFF
			0x15 0x01 0x00 0x00 0x0a 0x00 0x02 0x31 0xFD
			0x15 0x01 0x00 0x00 0x0a 0x00 0x02 0x32 0xFB
			0x15 0x01 0x00 0x00 0x0a 0x00 0x02 0x33 0xF9
			0x15 0x01 0x00 0x00 0x0a 0x00 0x02 0x34 0xF7
			0x15 0x01 0x00 0x00 0x0a 0x00 0x02 0x35 0xF5
			0x15 0x01 0x00 0x00 0x0a 0x00 0x02 0x36 0xF3
			0x15 0x01 0x00 0x00 0x0a 0x00 0x02 0x37 0xF1
			0x15 0x01 0x00 0x00 0x0a 0x00 0x02 0x38 0xEF
			0x15 0x01 0x00 0x00 0x0a 0x00 0x02 0x39 0xED
			0x15 0x01 0x00 0x00 0x0a 0x00 0x02 0x3A 0xEB
			0x15 0x01 0x00 0x00 0x0a 0x00 0x02 0x3B 0xE9
			0x15 0x01 0x00 0x00 0x0a 0x00 0x02 0x3D 0xE7
			0x15 0x01 0x00 0x00 0x0a 0x00 0x02 0x3F 0xE5
			0x15 0x01 0x00 0x00 0x0a 0x00 0x02 0x40 0xE3
			0x15 0x01 0x00 0x00 0x0a 0x00 0x02 0x41 0xE0
			0x15 0x01 0x00 0x00 0x0a 0x00 0x02 0x45 0xFF
			0x15 0x01 0x00 0x00 0x0a 0x00 0x02 0x46 0xFD
			0x15 0x01 0x00 0x00 0x0a 0x00 0x02 0x47 0xFB
			0x15 0x01 0x00 0x00 0x0a 0x00 0x02 0x48 0xF9
			0x15 0x01 0x00 0x00 0x0a 0x00 0x02 0x49 0xF7
			0x15 0x01 0x00 0x00 0x0a 0x00 0x02 0x4A 0xF5
			0x15 0x01 0x00 0x00 0x0a 0x00 0x02 0x4B 0xF3
			0x15 0x01 0x00 0x00 0x0a 0x00 0x02 0x4C 0xF1
			0x15 0x01 0x00 0x00 0x0a 0x00 0x02 0x4D 0xEF
			0x15 0x01 0x00 0x00 0x0a 0x00 0x02 0x4E 0xED
			0x15 0x01 0x00 0x00 0x0a 0x00 0x02 0x4F 0xEB
			0x15 0x01 0x00 0x00 0x0a 0x00 0x02 0x50 0xE9
			0x15 0x01 0x00 0x00 0x0a 0x00 0x02 0x51 0xE7
			0x15 0x01 0x00 0x00 0x0a 0x00 0x02 0x52 0xE5
			0x15 0x01 0x00 0x00 0x0a 0x00 0x02 0x53 0xE3
			0x15 0x01 0x00 0x00 0x0a 0x00 0x02 0x54 0xE0
			0x15 0x01 0x00 0x00 0x0a 0x00 0x02 0x58 0xFF
			0x15 0x01 0x00 0x00 0x0a 0x00 0x02 0x59 0xFC
			0x15 0x01 0x00 0x00 0x0a 0x00 0x02 0x5A 0xF8
			0x15 0x01 0x00 0x00 0x0a 0x00 0x02 0x5B 0xF1
			0x15 0x01 0x00 0x00 0x0a 0x00 0x02 0x5C 0xEA
			0x15 0x01 0x00 0x00 0x0a 0x00 0x02 0x5D 0xE2
			0x15 0x01 0x00 0x00 0x0a 0x00 0x02 0x5E 0xD8
			0x15 0x01 0x00 0x00 0x0a 0x00 0x02 0x5F 0xCF
			0x15 0x01 0x00 0x00 0x0a 0x00 0x02 0x60 0xCA
			0x15 0x01 0x00 0x00 0x0a 0x00 0x02 0x61 0xC5
			0x15 0x01 0x00 0x00 0x0a 0x00 0x02 0x62 0xBC
			0x15 0x01 0x00 0x00 0x0a 0x00 0x02 0x63 0xB3
			0x15 0x01 0x00 0x00 0x0a 0x00 0x02 0x64 0xA9
			0x15 0x01 0x00 0x00 0x0a 0x00 0x02 0x65 0x9F
			0x15 0x01 0x00 0x00 0x0a 0x00 0x02 0x66 0x9B
			0x15 0x01 0x00 0x00 0x0a 0x00 0x02 0x67 0x97
			0x15 0x01 0x00 0x00 0x0a 0x00 0x02 0xFF 0x10
			0x15 0x01 0x00 0x00 0x0a 0x00 0x02 0xFB 0x01
			0x15 0x01 0x00 0x00 0x0a 0x00 0x02 0x51 0xFE
			0x15 0x01 0x00 0x00 0x0a 0x00 0x02 0x53 0x24
			0x15 0x01 0x00 0x00 0x0a 0x00 0x02 0x55 0x01
			0x05 0x01 0x00 0x00 0x78 0x01 0x02 0x11 0x00
			0x05 0x01 0x00 0x00 0x14 0x01 0x02 0x29 0x00>;
		hw,lcdkit-panel-on-command-state = "dsi_lp_mode";
		hw,lcdkit-panel-display-on-command = <0x05 0x01 0x00 0x00 0x64 0x00 0x02 0x29 0x00>;
		hw,lcdkit-panel-off-command = <0x05 0x01 0x00 0x00 0x34 0x01 0x02 0x28 0x00
			0x05 0x01 0x00 0x00 0x66 0x01 0x02 0x10 0x00>;
		hw,lcdkit-panel-off-command-state = "dsi_lp_mode";
		hw,lcdkit-panel-backlight-command = <0x15 0x01 0x00 0x00 0x0a 0x00 0x02 0x51 0x00>;
		hw,lcdkit-panel-backlight-command-state = "dsi_lp_mode";
		hw,lcdkit-panel-cabc-off-command = <0x15 0x01 0x00 0x00 0x0a 0x00 0x02 0x55 0x00>;
		hw,lcdkit-panel-cabc-off-command-state = "dsi_lp_mode";
		hw,lcdkit-panel-cabc-ui-command = <0x15 0x01 0x00 0x00 0x0a 0x00 0x02 0x55 0x01>;
		hw,lcdkit-panel-cabc-ui-command-state = "dsi_lp_mode";
		hw,lcdkit-panel-cabc-still-command = <0x15 0x01 0x00 0x00 0x0a 0x00 0x02 0x55 0x02>;
		hw,lcdkit-panel-cabc-still-command-state = "dsi_lp_mode";
		hw,lcdkit-panel-cabc-moving-command = <0x15 0x01 0x00 0x00 0x0a 0x00 0x02 0x55 0x03>;
		hw,lcdkit-panel-cabc-moving-command-state = "dsi_lp_mode";
		hw,lcdkit-panel-cabc-support = <1>;
		hw,lcdkit-panel-cabc-switch-support = <1>;
		hw,lcdkit-panel-display-on-effect-support = <1>;
		hw,lcdkit-panel-ce-support = <1>;
		hw,lcdkit-panel-inversion-support = <0>;
		hw,lcdkit-panel-scan-support = <0>;
		hw,lcdkit-panel-display-region-support = <0>;
		hw,lcdkit-panel-checksum-support = <0>;
		hw,lcdkit-panel-esd-reg-command = <0x06 0x01 0x00 0x00 0x0a 0x00 0x01 0x0a
			0x06 0x01 0x00 0x00 0x0a 0x00 0x01 0x0e>;
		hw,lcdkit-panel-esd-reg-command-state = "dsi_lp_mode";
		hw,lcdkit-panel-esd-value = <0x9c 0x00>;
		hw,lcdkit-panel-esd-support = <1>;
		hw,lcdkit-platform-esd-support = <1>;
		hw,lcdkit-platform-esd-reg = <0xc0>;
		hw,lcdkit-platform-esd-value = <0x80>;
		hw,lcdkit-panel-check-reg-command = <0x06 0x01 0x00 0x00 0x0a 0x00 0x01 0x0a>;
		hw,lcdkit-panel-check-reg-value = <0x9c>;
		hw,lcdkit-panel-check-reg-command-state = "dsi_lp_mode";
		hw,lcdkit-panel-check-reg-support = <1>;
		hw,lcdkit-panel-check-on-value = <0x0a>;
		hw,lcdkit-panel-check-reg-expect-value = <0x9c>;
		hw,lcdkit-panel-check-reg-mask-value = <0xff>;
		hw,lcdkit-panel-dynamic-gamma-support = <0>;
		hw,lcdkit-panel-mipi-detect-command = <0x06 0x01 0x00 0x00 0x0a 0x00 0x01 0x0e
				0x06 0x01 0x00 0x00 0x0a 0x00 0x01 0x05
				0x06 0x01 0x00 0x00 0x0a 0x00 0x01 0xab>;
		hw,lcdkit-panel-mipi-detect-value = <0x00 0x00 0x00>;
		hw,lcdkit-panel-mipi-detect-mask = <0xFF 0xFF 0xFFFF>;
		hw,lcdkit-panel-mipi-detect-command-state = "dsi_lp_mode";
		hw,lcdkit-panel-mipi-detect-support = <1>;
		hw,lcdkit-panel-dynamic-sram-check-support = <0>;
		hw,lcdkit-panel-fps-updt-support = <0>;
		hw,lcdkit-panel-fps-func-switch = <0>;
		hw,lcdkit-panel-chip-esd-disable = <0>;
		hw,lcdkit-panel-check-reg-on-support = <0>;
		hw,lcdkit-panel-fps-tscall-support = <0>;
		hw,lcdkit-panel-dis-on-cmds-delay-margin-support = <0>;
		hw,lcdkit-panel-snd-cmd-before-frame-support = <0>;
		hw,lcdkit-panel-ts-resume-ctrl-mode = <0>;
		hw,lcdkit-panel-dis-on-cmds-delay-margin-time = <0>;
		hw,lcdkit-panel-lptohs-mipi-check-support = <0>;
		hw,lcdkit-panel-acl-ctrl-support = <0>;
		hw,lcdkit-panel-hbm-ctrl-support = <0>;
		hw,lcdkit-panel-vr-support = <0>;
		hw,lcdkit-panel-current-detect-support = <0>;
		hw,lcdkit-panel-lv-detect-support = <0>;
		hw,lcdkit-panel-orientation = <1>;
		hw,lcdkit-panel-bpp = <0>;
		hw,lcdkit-panel-bgrfmt = <0>;
		hw,lcdkit-panel-bl-type = <4>;
		hw,lcdkit-panel-blmin = <29>;
		hw,lcdkit-panel-blmax = <6610>;
		hw,lcdkit-panel-bl-def = <4000>;
		hw,lcdkit-panel-bl-maxnit = <530>;
		hw,lcdkit-panel-getblmaxnit-type = <0>;
		hw,lcdkit-panel-cmd-type = <8>;
		hw,lcdkit-panel-dsi1-snd-cmd-panel-support = <0>;
		hw,lcdkit-panel-ifbctype = <0>;
		hw,lcdkit-panel-frc-enable = <0>;
		hw,lcdkit-panel-esd-skip-mipi-check = <1>;
		hw,lcdkit-panel-pxl-clk = <146>;
		hw,lcdkit-panel-pxl-clk-div = <1>;
		hw,lcdkit-panel-tp-resume-nosync = <1>;
		hw,lcdkit-panel-display-on-in-backlight = <0>;
		hw,lcdkit-panel-display-on-new-seq = <0>;
		hw,lcdkit-panel-dirt-updt-support = <0>;
		hw,lcdkit-is-hostprocessing = <0>;
		hw,lcdkit-panel-dsi-upt-support = <0>;
		hw,lcdkit-panel-vsyn-ctr-type = <0>;
		hw,lcdkit-panel-bl-pwm-preci-type = <2>;
		hw,lcdkit-panel-bl-ic-ctrl-type = <1>;
		hw,lcdkit-panel-fps-updt-only = <1>;
		hw,lcdkit-panel-step-support = <1>;
		hw,lcdkit-ldi-hsync-plr = <0>;
		hw,lcdkit-ldi-vsync-plr = <0>;
		hw,lcdkit-ldi-pixel-clk-plr = <0>;
		hw,lcdkit-ldi-data-en-plr = <0>;
		hw,lcdkit-ldi-dpi-a-overlap-size = <0>;
		hw,lcdkit-ldi-dpi-b-overlap-size = <0>;
		hw,lcdkit-sbl-stren-limit = <128>;
		hw,lcdkit-sbl-cal-a = <60>;
		hw,lcdkit-sbl-cal-b = <95>;
		hw,lcdkit-sbl-cal-c = <5>;
		hw,lcdkit-sbl-cal-d = <1>;
		hw,lcdkit-sbl-tf-ctl = <5>;
		hw,lcdkit-sbl-bl-min = <480>;
		hw,lcdkit-sbl-bl-max = <4096>;
		hw,lcdkit-sbl-bl-scale = <0xff>;
		hw,lcdkit-sbl-am-light-min = <14>;
		hw,lcdkit-sbl-filter-a = <1738>;
		hw,lcdkit-sbl-filter-b = <6>;
		hw,lcdkit-sbl-logo-left = <0>;
		hw,lcdkit-sbl-logo-top = <0>;
		hw,lcdkit-sbl-variance-intensity-space = <145>;
		hw,lcdkit-sbl-slope-max = <54>;
		hw,lcdkit-sbl-slope-min = <160>;
		hw,lcdkit-mipi-lane-nums = <3>;
		hw,lcdkit-mipi-color-mode = <5>;
		hw,lcdkit-mipi-vc = <0>;
		hw,lcdkit-mipi-dsi-bit-clk = <490>;
		hw,lcdkit-mipi-burst-mode = <2>;
		hw,lcdkit-mipi-max-esc-clk = <10>;
		hw,lcdkit-mipi-dsi-bit-clk-val-a = <471>;
		hw,lcdkit-mipi-dsi-bit-clk-val-b = <500>;
		hw,lcdkit-mipi-dsi-bit-clk-val-c = <490>;
		hw,lcdkit-mipi-dsi-bit-clk-val-d = <500>;
		hw,lcdkit-mipi-dsi-bit-clk-val-e = <0>;
		hw,lcdkit-mipi-dsi-bit-clk-upt = <490>;
		hw,lcdkit-mipi-rg-vcm-adjust = <0>;
		hw,lcdkit-mipi-non-continue-enable = <1>;
		hw,lcdkit-mipi-clk-post-adjust = <215>;
		hw,lcdkit-mipi-clk-pre-adjust = <0>;
		hw,lcdkit-mipi-clk-t-hs-prepare-adjust = <0>;
		hw,lcdkit-mipi-clk-t-lpx-adjust = <0>;
		hw,lcdkit-mipi-clk-t-hs-trail-adjust = <0>;
		hw,lcdkit-mipi-clk-t-hs-exit-adjust = <0>;
		hw,lcdkit-mipi-clk-t-hs-zero-adjust = <0>;
		hw,lcdkit-mipi-hs-wr-to-time = <0>;
		hw,lcdkit-dirt-left-align = <2>;
		hw,lcdkit-dirt-right-align = <2>;
		hw,lcdkit-dirt-top-align = <2>;
		hw,lcdkit-dirt-bott-align = <2>;
		hw,lcdkit-dirt-width-align = <2>;
		hw,lcdkit-dirt-height-align = <2>;
		hw,lcdkit-dirt-width-min = <2>;
		hw,lcdkit-dirt-height-min = <2>;
		hw,lcdkit-dirt-top-start = <0xffff>;
		hw,lcdkit-dirt-bott-start = <0xffff>;
		hw,lcdkit-gpios = <&gpio4 5 0>,<&gpio15 5 0>,<&gpio5 0 0>,<&gpio5 6 0>,<&gpio6 2 0>,<&gpio4 4 0>;
		lcdanalog-vcc-supply = <&ldo17>;
		pinctrl-0 = <&gpio037_pmx_func &gpio125_pmx_func &gpio040_pmx_func &gpio046_pmx_func &gpio050_pmx_func &gpio037_cfg_func &gpio125_cfg_func &gpio040_cfg_func &gpio046_cfg_func &gpio050_cfg_func>;
		pinctrl-1 = <&gpio037_pmx_idle &gpio125_pmx_idle &gpio040_pmx_idle &gpio046_pmx_idle &gpio050_pmx_idle &gpio037_cfg_idle &gpio125_cfg_idle &gpio040_cfg_idle &gpio046_cfg_idle &gpio050_cfg_idle>;
		pinctrl-names = "default","idle";
		status = "disabled";
		hw,lcdkit-sbl-support = <1>;
		hw,lcdkit-gamma-support = <1>;
		hw,lcdkit-gmp-support = <0>;
		hw,lcdkit-color-temp-support = <1>;
		hw,lcdkit-color-temp-rectify-support = <1>;
		hw,lcdkit-comform-mode-support = <1>;
		hw,lcdkit-cinema-mode-support = <0>;
		hw,lcdkit-prefix-sharp-two-d-support = <1>;
		hw,lcdkit-xcc-support = <1>;
		hw,lcdkit-prefix-ce-support = <0>;
		hw,lcdkit-prefix-sharp-one-d-support = <0>;
		hw,lcdkit-acm-support = <1>;
		hw,lcdkit-smart-color-mode-support = <1>;
		hw,lcdkit-acm-ce-support = <0>;
		hw,lcdkit-r_hh0 = <0x80>;
		hw,lcdkit-r_lh0 = <0x0>;
		hw,lcdkit-r_hh1 = <0x11f>;
		hw,lcdkit-r_lh1 = <0x81>;
		hw,lcdkit-r_hh2 = <0x17f>;
		hw,lcdkit-r_lh2 = <0x120>;
		hw,lcdkit-r_hh3 = <0x1df>;
		hw,lcdkit-r_lh3 = <0x180>;
		hw,lcdkit-r_hh4 = <0x281>;
		hw,lcdkit-r_lh4 = <0x1e0>;
		hw,lcdkit-r_hh5 = <0x2ff>;
		hw,lcdkit-r_lh5 = <0x282>;
		hw,lcdkit-r_hh6 = <0x380>;
		hw,lcdkit-r_lh6 = <0x300>;
		hw,lcdkit-r_video_hh0 = <0x7f>;
		hw,lcdkit-r_video_lh0 = <0x0>;
		hw,lcdkit-r_video_hh1 = <0x101>;
		hw,lcdkit-r_video_lh1 = <0x80>;
		hw,lcdkit-r_video_hh2 = <0x175>;
		hw,lcdkit-r_video_lh2 = <0x102>;
		hw,lcdkit-r_video_hh3 = <0x1ed>;
		hw,lcdkit-r_video_lh3 = <0x176>;
		hw,lcdkit-r_video_hh4 = <0x26f>;
		hw,lcdkit-r_video_lh4 = <0x1ee>;
		hw,lcdkit-r_video_hh5 = <0x2ff>;
		hw,lcdkit-r_video_lh5 = <0x270>;
		hw,lcdkit-r_video_hh6 = <0x37c>;
		hw,lcdkit-r_video_lh6 = <0x300>;
		hw,lcdkit-color-temp-rectify-r = <32381>;
		hw,lcdkit-color-temp-rectify-g = <32768>;
		hw,lcdkit-color-temp-rectify-b = <32322>;
		hw,lcdkit-hiace-support = <1>;
		hw,lcdkit-panel-effect-support = <0>;
		hw,lcdkit-arsr1p-sharpness-support = <1>;
		hw,lcdkit-iglobal-hist-black-pos = <16>;
		hw,lcdkit-iglobal-hist-white-pos = <240>;
		hw,lcdkit-iglobal-hist-black-weight = <51>;
		hw,lcdkit-iglobal-hist-white-weight = <51>;
		hw,lcdkit-iglobal-hist-zero-cut-ratio = <486>;
		hw,lcdkit-iglobal-hist-slope-cut-ratio = <410>;
		hw,lcdkit-imax-lcd-luminance = <500>;
		hw,lcdkit-imin-lcd-luminance = <3>;
		hw,lcdkit-cfg-name = "/product/etc/display/effect/algorithm/hdr_engine_STF.xml";
		hw,lcdkit-effect-support-mode = <65537>;
		hw,lcdkit-delay-af-rst-off = <5>;
		hw,lcdkit-h-back-porch = <118>;
		hw,lcdkit-h-front-porch = <142>;
		hw,lcdkit-h-pulse-width = <8>;
		hw,lcdkit-v-back-porch = <26>;
		hw,lcdkit-v-pulse-width = <10>;
		hw,lcdkit-v-front-porch = <12>;
		hw,lcdkit-h-sync-skew = <0>;
		hw,lcdkit-non-check-ldi-porch = <0>;
		hw,lcdkit-dpi01-set-change = <0>;
		hw,lcdkit-lcd-type = <1>;
		hw,lcdkit-panel-pt-test-support = <1>;
		hw,lcdkit-panel-hkadc-support = <0>;
		hw,lcdkit-bias-power-ctrl-mode = <2>;
		hw,lcdkit-iovcc-power-ctrl-mode = <2>;
		hw,lcdkit-vci-power-ctrl-mode = <1>;
		hw,lcdkit-id0-gpio = <46>;
		hw,lcdkit-id1-gpio = <50>;
		hw,lcdkit-reset-gpio = <40>;
		hw,lcdkit-te-gpio = <23>;
		hw,lcdkit-vsp-gpio = <125>;
		hw,lcdkit-vsn-gpio = <37>;
		hw,lcdkit-iovcc-gpio = <36>;
		hw,lcdkit-vci-gpio = <0>;
		hw,lcdkit-iovcc-on-is-need-reset = <0>;
		hw,lcdkit-vsn-on-is-need-reset = <1>;
		hw,lcdkit-lcdanalog-vcc = <3300000>;
		hw,lcdkit-lcdio-vcc = <1800000>;
		hw,lcdkit-lcd-bias = <5400000>;
		hw,lcdkit-lcd-vsp = <5400000>;
		hw,lcdkit-lcd-vsn = <5400000>;
		hw,lcdkit-lcd-rst-first-high = <5>;
		hw,lcdkit-lcd-rst-low = <5>;
		hw,lcdkit-lcd-rst-second-high = <20>;
		hw,lcdkit-delay-af-vci-on = <0>;
		hw,lcdkit-delay-af-iovcc-on = <10>;
		hw,lcdkit-delay-af-bias-on = <0>;
		hw,lcdkit-delay-af-vsp-on = <10>;
		hw,lcdkit-delay-af-vsn-on = <5>;
		hw,lcdkit-delay-af-display-on = <0>;
		hw,lcdkit-delay-af-display-off = <0>;
		hw,lcdkit-delay-af-display-off-second = <0>;
		hw,lcdkit-delay-af-lp11 = <12>;
		hw,lcdkit-delay-af-tp-reset = <0>;
		hw,lcdkit-delay-af-vsn-off = <15>;
		hw,lcdkit-delay-af-vsp-off = <15>;
		hw,lcdkit-delay-af-bias-off = <0>;
		hw,lcdkit-delay-af-iovcc-off = <10>;
		hw,lcdkit-delay-af-vci-off = <0>;
    };
};