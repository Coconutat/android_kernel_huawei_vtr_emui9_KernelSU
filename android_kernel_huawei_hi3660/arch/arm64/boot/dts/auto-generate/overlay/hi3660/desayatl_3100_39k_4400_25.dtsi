/* DO NOT EDIT - Automatically generated by python */
		&desayatl_3100_39k_4400_25 {
			fcc = <3100>;
			default_rbatt_mohm = <100>;
			identify_type = "id_volt";
			id_identify_min = <1235>;
			id_identify_max = <1759>;
			id_voltage_min = <1420>;
			id_voltage_max = <1562>;
			vbat_max = <4400>;
			temp_para = 
						"-32767","0","-1","0","4100","0",
						"0","5","-1","310","4400","0",
						"5","10","-1","930","4400","3",
						"10","45","-1","-1","4400","3",
						"45","50","-1","1085","4100","3",
						"50","32767","-1","0","4100","0";
			vbat_para = 
						"-32767","3400","-1","820","0",
						"3400","32767","-1","-1","0";
			segment_para = 
						"-32767","4150","3100","4208","50",
						"4150","4450","2170","4400","0";
			batt_brand = "desayatl";
			fcc_temp = <3107 3103 3096 3119 3086 3064>;
			fcc_sf_x = <0 100 200 300 400 500 600 700 800 1000 1500>;
			fcc_sf_y = <100 96 94 92 90 88 87 84 81 75 50>;
			fcc_sf_cols = <11>;
			pc_sf_rows = <1>;
			pc_sf_cols = <1>;
			pc_sf_row_entries = <0>;
			pc_sf_percent = <100>;
			pc_sf_sf = <100>;
			rbatt_sf_rows = <28>;
			rbatt_sf_cols = <6>;
			rbatt_sf_percent = <100 95 90 85 80 75 70 65 60 55 50 45 40 35 30 25 20 15 10 9 8 7 6 5 4 3 2 1>;
			rbatt_sf_sf = <
			               2196 1301 543 146 111 101
			               2137 1280 540 145 112 101
			               1921 1216 532 144 113 102
			               1789 1168 528 145 114 103
			               1714 1136 543 148 116 105
			               1577 1088 563 154 119 106
			               1481 991 531 165 124 109
			               1469 967 500 180 133 114
			               1461 948 481 169 134 116
			               1460 940 465 142 117 105
			               1486 949 465 135 111 103
			               1535 984 473 136 111 104
			               1608 1043 496 139 114 105
			               1709 1125 535 143 119 108
			               1829 1234 597 142 117 108
			               1955 1363 684 136 110 102
			               2092 1492 795 135 110 103
			               2275 1618 945 138 111 103
			               3555 1550 758 137 113 104
			               3979 1769 817 137 111 104
			               4374 1942 887 139 114 107
			               4874 2215 984 140 115 108
			               5387 2492 1090 145 116 107
			               5995 2890 1252 143 114 105
			               6653 3169 1414 148 113 107
			               7513 3669 1622 167 116 109
			               8583 4523 2034 245 136 112
			               10206 5772 2741 526 239 172
			              >;
			pc_temp_ocv_rows = <29>;
			pc_temp_ocv_cols = <6>;
			pc_temp_ocv_percent = <100 95 90 85 80 75 70 65 60 55 50 45 40 35 30 25 20 15 10 9 8 7 6 5 4 3 2 1>;
			pc_temp_ocv_ocv = <
			                   4359 4357 4354 4356 4342 4336
			                   4263 4275 4282 4296 4282 4276
			                   4190 4207 4219 4238 4224 4219
			                   4134 4151 4162 4181 4168 4163
			                   4088 4101 4111 4125 4114 4109
			                   4017 4045 4063 4073 4063 4059
			                   3950 3974 4003 4024 4016 4012
			                   3909 3927 3948 3977 3973 3969
			                   3871 3885 3903 3927 3926 3924
			                   3839 3850 3864 3880 3877 3876
			                   3818 3823 3832 3847 3845 3844
			                   3803 3806 3810 3823 3821 3820
			                   3790 3795 3794 3804 3802 3800
			                   3778 3786 3784 3787 3787 3784
			                   3764 3775 3775 3772 3769 3764
			                   3750 3761 3764 3755 3747 3736
			                   3735 3743 3746 3735 3727 3715
			                   3718 3720 3719 3708 3702 3691
			                   3695 3694 3688 3687 3680 3669
			                   3689 3691 3685 3686 3679 3667
			                   3681 3686 3682 3684 3677 3666
			                   3672 3682 3678 3681 3675 3663
			                   3661 3675 3672 3674 3669 3657
			                   3643 3663 3658 3653 3653 3638
			                   3613 3633 3630 3610 3615 3601
			                   3569 3582 3580 3554 3563 3550
			                   3504 3513 3510 3480 3493 3483
			                   3406 3411 3408 3374 3394 3385
			                   3200 3200 3200 3200 3200 3200
			                  >;
			vol_dec1=  <50>;
			pc_temp_ocv_ocv1 = <
			                   4334 4332 4329 4331 4317 4311
			                   4245 4255 4262 4273 4260 4254
			                   4177 4192 4202 4216 4204 4198
			                   4126 4137 4146 4161 4149 4144
			                   4075 4090 4100 4107 4097 4092
			                   4003 4027 4048 4058 4048 4044
			                   3943 3964 3989 4010 4003 3999
			                   3903 3919 3938 3966 3962 3959
			                   3866 3879 3894 3913 3912 3911
			                   3836 3845 3857 3872 3869 3868
			                   3816 3820 3828 3842 3839 3838
			                   3802 3804 3807 3819 3817 3816
			                   3789 3794 3793 3801 3799 3797
			                   3776 3785 3783 3785 3784 3781
			                   3763 3774 3774 3770 3766 3760
			                   3749 3760 3762 3753 3745 3734
			                   3734 3741 3744 3734 3725 3713
			                   3718 3719 3718 3706 3700 3689
			                   3694 3693 3688 3687 3680 3668
			                   3688 3690 3685 3685 3678 3667
			                   3680 3686 3681 3684 3677 3666
			                   3672 3682 3678 3680 3674 3663
			                   3659 3674 3670 3673 3669 3656
			                   3641 3662 3656 3649 3650 3635
			                   3611 3631 3627 3606 3611 3597
			                   3566 3580 3577 3550 3559 3546
			                   3502 3510 3508 3476 3490 3479
			                   3404 3409 3406 3371 3392 3383
			                   3200 3200 3200 3200 3200 3200
			                  >;
			vol_dec2=  <200>;
			pc_temp_ocv_ocv2 = <
			                   4184 4182 4179 4181 4167 4161
			                   4149 4154 4149 4140 4129 4124
			                   4114 4109 4108 4093 4084 4079
			                   4057 4066 4066 4051 4042 4038
			                   3989 3994 4012 4009 4003 3999
			                   3938 3949 3961 3971 3967 3963
			                   3902 3909 3920 3927 3926 3924
			                   3867 3874 3882 3885 3883 3881
			                   3839 3843 3851 3855 3852 3851
			                   3819 3820 3825 3832 3830 3829
			                   3805 3806 3807 3814 3812 3811
			                   3793 3796 3794 3799 3798 3795
			                   3782 3788 3785 3785 3784 3782
			                   3769 3778 3777 3772 3769 3764
			                   3757 3768 3768 3758 3750 3739
			                   3743 3753 3755 3742 3733 3721
			                   3729 3734 3734 3722 3715 3702
			                   3714 3713 3708 3694 3688 3679
			                   3690 3691 3685 3685 3678 3667
			                   3683 3687 3682 3683 3677 3665
			                   3675 3683 3679 3680 3674 3663
			                   3666 3677 3673 3674 3670 3657
			                   3652 3669 3663 3656 3657 3643
			                   3631 3650 3643 3623 3628 3613
			                   3599 3614 3608 3579 3587 3574
			                   3554 3562 3557 3524 3535 3525
			                   3490 3494 3489 3453 3469 3459
			                   3394 3393 3389 3352 3372 3368
			                   3200 3200 3200 3200 3200 3200
			                  >;
		};
