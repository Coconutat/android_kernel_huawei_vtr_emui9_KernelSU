/* DO NOT EDIT - Automatically generated by python */
		&coslightguangyu_4000_22k_4400 {
			fcc = <4000>;
			default_rbatt_mohm = <100>;
			identify_type = "id_volt";
			id_identify_min = <751>;
			id_identify_max = <1235>;
			id_voltage_min = <939>;
			id_voltage_max = <1059>;
			vbat_max = <4400>;
			temp_para = 
						"-32767","0","-1","0","4100","0",
						"0","5","-1","400","4400","0",
						"5","10","-1","1200","4400","3",
						"10","45","-1","-1","4400","3",
						"45","50","-1","1400","4100","3",
						"50","32767","-1","0","4100","0";
			vbat_para = 
						"-32767","3400","-1","820","0",
						"3400","32767","-1","-1","0";
			segment_para = 
						"-32767","4150","4000","4208","50",
						"4150","4450","2800","4400","0";
			batt_brand = "coslightguangyu";
			fcc_temp = <4101 4105 4098 4111 4103 4076>;
			fcc_sf_x = <0 100 200 300 400 500 600 700 800 1000 1500>;
			fcc_sf_y = <100 96 94 92 90 88 87 84 81 75 50>;
			fcc_sf_cols = <11>;
			pc_sf_rows = <1>;
			pc_sf_cols = <1>;
			pc_sf_row_entries = <0>;
			pc_sf_percent = <100>;
			pc_sf_sf = <100>;
			rbatt_sf_rows = <28>;
			rbatt_sf_cols = <6>;
			rbatt_sf_percent = <100 95 90 85 80 75 70 65 60 55 50 45 40 35 30 25 20 15 10 9 8 7 6 5 4 3 2 1>;
			rbatt_sf_sf = <
			               1909 1259 620 134 100 89
			               1905 1258 620 134 100 90
			               1757 1201 612 133 99 90
			               1633 1144 588 133 100 90
			               1551 1095 579 136 102 91
			               1476 1070 583 139 104 93
			               1339 955 552 149 109 96
			               1331 934 515 157 115 99
			               1311 917 497 155 121 103
			               1318 903 483 132 106 95
			               1344 916 481 124 97 90
			               1376 953 493 125 98 90
			               1417 999 526 128 101 92
			               1466 1049 573 132 104 94
			               1525 1107 624 134 104 95
			               1600 1175 685 131 99 90
			               1700 1251 762 131 98 91
			               1840 1346 869 134 99 91
			               3100 1557 762 131 101 91
			               3337 1695 829 133 101 96
			               3608 1856 914 133 102 94
			               3897 2053 1015 136 105 97
			               4161 2264 1155 139 108 99
			               4534 2477 1282 137 103 94
			               4942 2713 1416 144 103 95
			               5488 3026 1607 157 105 97
			               6134 3457 1936 201 109 98
			               7160 4178 2476 482 237 133
			              >;
			pc_temp_ocv_rows = <29>;
			pc_temp_ocv_cols = <6>;
			pc_temp_ocv_percent = <100 95 90 85 80 75 70 65 60 55 50 45 40 35 30 25 20 15 10 9 8 7 6 5 4 3 2 1>;
			pc_temp_ocv_ocv = <
			                   4387 4384 4380 4374 4368 4362
			                   4281 4294 4298 4309 4305 4300
			                   4210 4225 4234 4250 4246 4242
			                   4149 4164 4175 4193 4189 4185
			                   4096 4109 4120 4137 4133 4129
			                   4040 4060 4071 4084 4080 4077
			                   3956 3978 4009 4035 4031 4028
			                   3916 3932 3953 3984 3984 3983
			                   3874 3891 3908 3938 3940 3939
			                   3844 3853 3868 3888 3890 3890
			                   3823 3825 3835 3853 3853 3853
			                   3806 3808 3810 3827 3828 3827
			                   3791 3795 3795 3807 3808 3806
			                   3776 3783 3784 3790 3791 3789
			                   3761 3770 3773 3775 3773 3769
			                   3747 3756 3761 3758 3751 3741
			                   3732 3737 3743 3738 3730 3718
			                   3713 3716 3717 3710 3704 3693
			                   3686 3693 3688 3689 3682 3671
			                   3677 3688 3684 3688 3681 3670
			                   3668 3683 3681 3685 3680 3668
			                   3657 3676 3676 3682 3677 3666
			                   3640 3666 3670 3675 3672 3660
			                   3618 3646 3656 3651 3653 3642
			                   3585 3612 3624 3607 3615 3604
			                   3540 3563 3572 3548 3562 3553
			                   3473 3494 3501 3470 3491 3484
			                   3372 3391 3400 3361 3393 3385
			                   3200 3200 3200 3200 3200 3200
			                  >;
		};
