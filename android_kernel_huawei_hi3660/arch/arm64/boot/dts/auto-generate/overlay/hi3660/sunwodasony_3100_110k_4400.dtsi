/* DO NOT EDIT - Automatically generated by python */
		&sunwodasony_3100_110k_4400 {
			fcc = <3100>;
			default_rbatt_mohm = <100>;
			identify_type = "id_volt";
			id_identify_min = <2281>;
			id_identify_max = <2786>;
			id_voltage_min = <2426>;
			id_voltage_max = <2631>;
			vbat_max = <4400>;
			temp_para = 
						"-32767","0","-1","0","4100","0",
						"0","5","-1","310","4400","0",
						"5","10","-1","930","4400","3",
						"10","45","-1","-1","4400","3",
						"45","50","-1","1085","4100","3",
						"50","32767","-1","0","4100","0";
			vbat_para = 
						"-32767","3400","-1","820","0",
						"3400","32767","-1","-1","0";
			segment_para = 
						"-32767","4150","3100","4208","50",
						"4150","4450","2170","4400","0";
			batt_brand = "sunwodasony";
			fcc_temp = <3132 3147 3161 3226 3188 3169>;
			fcc_sf_x = <0 100 200 300 400 500 600 700 800 1000 1500>;
			fcc_sf_y = <100 96 94 92 90 88 87 84 81 75 50>;
			fcc_sf_cols = <11>;
			pc_sf_rows = <1>;
			pc_sf_cols = <1>;
			pc_sf_row_entries = <0>;
			pc_sf_percent = <100>;
			pc_sf_sf = <100>;
			rbatt_sf_rows = <28>;
			rbatt_sf_cols = <6>;
			rbatt_sf_percent = <100 95 90 85 80 75 70 65 60 55 50 45 40 35 30 25 20 15 10 9 8 7 6 5 4 3 2 1>;
			rbatt_sf_sf = <
			               1707 835 422 162 121 109
			               1707 836 422 162 121 109
			               1699 849 434 164 122 109
			               1670 864 444 167 125 110
			               1675 874 457 173 128 112
			               1614 883 482 180 132 114
			               1563 856 475 190 137 117
			               1564 852 457 199 146 121
			               1574 856 449 191 147 125
			               1575 861 441 169 129 113
			               1610 874 443 161 123 110
			               1668 910 448 163 124 110
			               1737 974 462 169 128 112
			               1827 1053 488 175 133 114
			               1940 1136 528 177 132 115
			               2090 1252 576 171 126 110
			               2309 1419 638 171 127 112
			               2817 1713 759 175 128 113
			               4911 1948 703 169 127 113
			               6017 2209 741 172 128 114
			               7328 2591 798 176 130 115
			               8998 3113 894 182 131 116
			               11391 3856 1007 185 132 118
			               15897 5018 1212 188 132 118
			               28180 6573 1514 199 136 116
			               49042 9106 1953 248 139 118
			               82966 17210 2766 350 210 146
			               135665 35307 4661 511 195 219
			              >;
			pc_temp_ocv_rows = <29>;
			pc_temp_ocv_cols = <6>;
			pc_temp_ocv_percent = <100 95 90 85 80 75 70 65 60 55 50 45 40 35 30 25 20 15 10 9 8 7 6 5 4 3 2 1>;
			pc_temp_ocv_ocv = <
			                   4381 4380 4378 4379 4364 4359
			                   4285 4299 4303 4310 4297 4292
			                   4211 4232 4239 4248 4236 4231
			                   4144 4171 4178 4188 4177 4172
			                   4094 4113 4120 4130 4120 4116
			                   4030 4057 4068 4075 4067 4063
			                   3964 3994 4012 4024 4018 4015
			                   3915 3941 3958 3977 3973 3970
			                   3873 3895 3910 3928 3928 3927
			                   3834 3855 3870 3883 3881 3879
			                   3804 3820 3836 3848 3847 3845
			                   3780 3794 3809 3823 3822 3820
			                   3758 3776 3787 3802 3802 3800
			                   3739 3761 3771 3785 3786 3782
			                   3721 3745 3758 3769 3767 3761
			                   3704 3727 3743 3748 3743 3731
			                   3683 3702 3720 3727 3721 3709
			                   3658 3670 3685 3697 3692 3681
			                   3618 3630 3643 3665 3661 3651
			                   3605 3618 3637 3660 3656 3646
			                   3589 3607 3630 3654 3651 3641
			                   3568 3593 3621 3647 3644 3635
			                   3549 3577 3609 3636 3633 3623
			                   3524 3559 3591 3612 3608 3598
			                   3492 3528 3560 3569 3567 3558
			                   3448 3474 3507 3515 3514 3506
			                   3397 3402 3432 3449 3449 3440
			                   3304 3315 3334 3360 3352 3351
			                   3200 3200 3200 3200 3200 3200
			                  >;
		};
