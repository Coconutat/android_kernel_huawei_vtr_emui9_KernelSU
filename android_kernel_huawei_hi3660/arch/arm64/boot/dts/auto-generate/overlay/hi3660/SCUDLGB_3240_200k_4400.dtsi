/* DO NOT EDIT - Automatically generated by python */
		&SCUDLGB_3240_200k_4400 {
			fcc = <3240>;
			default_rbatt_mohm = <100>;
			identify_type = "id_volt";
			id_identify_min = <2786>;
			id_identify_max = <3312>;
			id_voltage_min = <2941>;
			id_voltage_max = <3167>;
			vbat_max = <4400>;
			temp_para = 
						"-32767","0","-1","0","4100","0",
						"0","5","-1","324","4400","0",
						"5","10","-1","972","4400","3",
						"10","45","-1","-1","4400","3",
						"45","50","-1","1134","4100","3",
						"50","32767","-1","0","4100","0";
			vbat_para = 
						"-32767","3400","-1","820","0",
						"3400","32767","-1","-1","0";
			segment_para = 
						"-32767","4150","3240","4208","50",
						"4150","4450","2268","4400","0";
			batt_brand = "SCUDLGB";
			fcc_temp = <3298 3299 3289 3346 3297 3286>;
			fcc_sf_x = <0 100 200 300 400 500 600 700 800 1000 1500>;
			fcc_sf_y = <100 96 94 92 90 88 87 84 81 75 50>;
			fcc_sf_cols = <11>;
			pc_sf_rows = <1>;
			pc_sf_cols = <1>;
			pc_sf_row_entries = <0>;
			pc_sf_percent = <100>;
			pc_sf_sf = <100>;
			rbatt_sf_rows = <28>;
			rbatt_sf_cols = <6>;
			rbatt_sf_percent = <100 95 90 85 80 75 70 65 60 55 50 45 40 35 30 25 20 15 10 9 8 7 6 5 4 3 2 1>;
			rbatt_sf_sf = <
			               2181 1367 518 107 76 62
			               2181 1367 518 107 76 62
			               2054 1310 513 109 76 63
			               1939 1246 515 111 79 63
			               1854 1211 518 115 80 65
			               1684 1145 542 120 84 66
			               1670 1008 488 133 87 67
			               1664 988 470 144 95 71
			               1637 965 430 152 108 77
			               1644 950 409 116 81 66
			               1697 947 409 104 76 63
			               1757 987 408 105 77 64
			               1834 1041 417 107 79 64
			               1926 1126 442 109 82 68
			               2025 1224 480 108 84 68
			               2180 1357 533 105 73 61
			               2418 1528 616 104 74 63
			               2692 1738 781 109 77 62
			               3947 1920 1012 107 79 64
			               5560 2136 737 110 78 64
			               6813 2629 763 113 83 66
			               7901 3076 789 125 97 66
			               8809 3391 905 179 108 76
			               9562 3641 1274 208 94 100
			               10232 4044 1636 123 81 110
			               10922 5101 2026 136 86 69
			               11473 5656 2536 176 106 68
			               14340 6551 3383 459 164 82
			              >;
			pc_temp_ocv_rows = <29>;
			pc_temp_ocv_cols = <6>;
			pc_temp_ocv_percent = <100 95 90 85 80 75 70 65 60 55 50 45 40 35 30 25 20 15 10 9 8 7 6 5 4 3 2 1>;
			pc_temp_ocv_ocv = <
			                   4360 4352 4345 4361 4341 4339
			                   4257 4268 4273 4297 4278 4275
			                   4191 4204 4214 4238 4221 4218
			                   4137 4148 4161 4182 4165 4161
			                   4081 4101 4111 4127 4111 4108
			                   3982 4037 4063 4075 4061 4057
			                   3930 3956 3982 4023 4009 4010
			                   3892 3917 3940 3975 3971 3967
			                   3851 3877 3897 3936 3931 3929
			                   3823 3842 3857 3882 3876 3875
			                   3807 3813 3829 3847 3843 3842
			                   3794 3797 3806 3823 3819 3818
			                   3783 3786 3791 3803 3801 3798
			                   3773 3777 3782 3787 3785 3783
			                   3760 3766 3773 3773 3770 3767
			                   3747 3752 3761 3758 3748 3736
			                   3733 3734 3743 3738 3730 3716
			                   3717 3717 3719 3712 3704 3691
			                   3685 3697 3697 3688 3680 3667
			                   3672 3688 3695 3686 3678 3666
			                   3659 3680 3692 3684 3677 3664
			                   3646 3674 3686 3682 3675 3662
			                   3631 3666 3668 3678 3670 3656
			                   3612 3656 3647 3659 3650 3641
			                   3589 3622 3614 3614 3613 3608
			                   3555 3577 3562 3555 3561 3556
			                   3481 3497 3488 3475 3491 3487
			                   3370 3379 3382 3365 3389 3386
			                   3200 3200 3200 3200 3200 3200
			                  >;
		};
