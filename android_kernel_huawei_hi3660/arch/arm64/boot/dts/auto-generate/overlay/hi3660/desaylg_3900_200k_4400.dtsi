/* DO NOT EDIT - Automatically generated by python */
		&desaylg_3900_200k_4400 {
			fcc = <3900>;
			default_rbatt_mohm = <100>;
			identify_type = "id_volt";
			id_identify_min = <2786>;
			id_identify_max = <3312>;
			id_voltage_min = <2941>;
			id_voltage_max = <3167>;
			vbat_max = <4400>;
			temp_para = 
						"-32767","0","-1","0","4100","0",
						"0","5","-1","390","4400","0",
						"5","10","-1","1170","4400","3",
						"10","45","-1","-1","4400","3",
						"45","50","-1","1365","4100","3",
						"50","32767","-1","0","4100","0";
			vbat_para = 
						"-32767","3400","-1","820","0",
						"3400","32767","-1","-1","0";
			segment_para = 
						"-32767","4150","3900","4208","50",
						"4150","4450","2730","4400","0";
			batt_brand = "desaylg";
			fcc_temp = <3999 3971 3965 3999 3966 3938>;
			fcc_sf_x = <0 100 200 300 400 500 600 700 800 1000 1500>;
			fcc_sf_y = <100 96 94 92 90 88 87 84 81 75 50>;
			fcc_sf_cols = <11>;
			pc_sf_rows = <1>;
			pc_sf_cols = <1>;
			pc_sf_row_entries = <0>;
			pc_sf_percent = <100>;
			pc_sf_sf = <100>;
			rbatt_sf_rows = <28>;
			rbatt_sf_cols = <6>;
			rbatt_sf_percent = <100 95 90 85 80 75 70 65 60 55 50 45 40 35 30 25 20 15 10 9 8 7 6 5 4 3 2 1>;
			rbatt_sf_sf = <
			               1898 1104 519 111 75 63
			               1894 1103 519 112 75 63
			               1744 1074 531 114 76 63
			               1653 1043 535 117 78 64
			               1616 1041 548 122 80 65
			               1501 1005 590 128 83 67
			               1453 909 498 138 88 70
			               1440 896 486 149 94 73
			               1428 888 474 146 103 78
			               1434 879 461 119 90 73
			               1478 884 450 108 75 64
			               1550 932 458 109 76 65
			               1647 1007 495 114 80 67
			               1753 1103 555 118 84 71
			               1855 1210 639 118 85 72
			               1955 1314 739 117 78 65
			               2066 1410 854 119 76 64
			               2207 1520 1004 123 77 65
			               4319 1847 883 120 79 67
			               4717 2074 953 122 78 66
			               5085 2281 1054 124 78 66
			               5492 2539 1198 130 79 67
			               5924 2789 1340 135 79 67
			               6385 3078 1497 136 78 68
			               6900 3380 1628 149 81 69
			               7436 3735 1779 182 85 70
			               8034 4238 2080 277 91 71
			               9281 4932 2621 877 119 80
			              >;
			pc_temp_ocv_rows = <29>;
			pc_temp_ocv_cols = <6>;
			pc_temp_ocv_percent = <100 95 90 85 80 75 70 65 60 55 50 45 40 35 30 25 20 15 10 9 8 7 6 5 4 3 2 1>;
			pc_temp_ocv_ocv = <
			                   4392 4381 4377 4370 4360 4355
			                   4266 4272 4280 4294 4287 4283
			                   4185 4198 4212 4234 4227 4224
			                   4122 4135 4153 4176 4170 4167
			                   4071 4087 4096 4121 4115 4112
			                   3989 4030 4054 4069 4063 4061
			                   3932 3956 3977 4016 4014 4013
			                   3888 3912 3932 3972 3972 3970
			                   3849 3872 3891 3929 3932 3931
			                   3819 3837 3854 3881 3884 3884
			                   3801 3809 3822 3845 3845 3845
			                   3786 3794 3801 3820 3821 3820
			                   3774 3782 3789 3801 3802 3800
			                   3762 3771 3778 3785 3786 3784
			                   3749 3760 3768 3772 3771 3768
			                   3735 3748 3755 3758 3751 3739
			                   3719 3733 3737 3738 3731 3718
			                   3699 3715 3715 3710 3705 3694
			                   3670 3692 3691 3687 3681 3670
			                   3662 3686 3684 3685 3680 3668
			                   3651 3679 3677 3682 3678 3667
			                   3638 3672 3670 3677 3675 3664
			                   3622 3661 3660 3666 3669 3658
			                   3601 3646 3643 3639 3649 3638
			                   3573 3618 3615 3593 3611 3599
			                   3532 3573 3570 3534 3559 3550
			                   3469 3507 3502 3457 3489 3481
			                   3377 3404 3403 3372 3386 3381
			                   3200 3200 3200 3200 3200 3200
			                  >;
		};
