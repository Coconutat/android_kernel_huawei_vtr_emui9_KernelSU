/* DO NOT EDIT - Automatically generated by python */
		&scudsony_7350_110k_4400 {
			fcc = <7350>;
			default_rbatt_mohm = <100>;
			identify_type = "id_volt";
			id_identify_min = <2281>;
			id_identify_max = <2786>;
			id_voltage_min = <2426>;
			id_voltage_max = <2631>;
			vbat_max = <4400>;
			temp_para = 
						"-32767","0","-1","0","4100","0",
						"0","5","-1","735","4400","0",
						"5","10","-1","2205","4400","3",
						"10","45","-1","-1","4400","3",
						"45","50","-1","2572","4100","3",
						"50","32767","-1","0","4100","0";
			vbat_para = 
						"-32767","3400","-1","820","0",
						"3400","32767","-1","-1","0";
			segment_para = 
						"-32767","4150","7350","4208","50",
						"4150","4450","5145","4400","0";
			batt_brand = "scudsony";
			fcc_temp = <7433 7452 7508 7542 7549 7483>;
			fcc_sf_x = <0 100 200 300 400 500 600 700 800 1000 1500>;
			fcc_sf_y = <100 96 94 92 90 88 87 84 81 75 50>;
			fcc_sf_cols = <11>;
			pc_sf_rows = <1>;
			pc_sf_cols = <1>;
			pc_sf_row_entries = <0>;
			pc_sf_percent = <100>;
			pc_sf_sf = <100>;
			rbatt_sf_rows = <28>;
			rbatt_sf_cols = <6>;
			rbatt_sf_percent = <100 95 90 85 80 75 70 65 60 55 50 45 40 35 30 25 20 15 10 9 8 7 6 5 4 3 2 1>;
			rbatt_sf_sf = <
			               762 321 226 89 77 75
			               762 321 226 89 77 75
			               757 326 232 90 78 75
			               746 331 234 91 79 75
			               728 323 239 94 80 76
			               730 329 240 97 82 77
			               720 320 235 101 84 78
			               719 321 233 105 88 80
			               721 324 230 102 89 82
			               724 323 231 91 81 77
			               742 327 232 90 78 75
			               765 332 237 90 78 75
			               792 337 243 92 79 76
			               823 351 258 94 81 77
			               865 368 276 96 81 78
			               916 390 298 95 79 76
			               996 414 327 94 79 76
			               1147 476 374 95 80 77
			               1758 537 366 94 80 79
			               1950 574 389 95 80 77
			               2479 646 418 96 81 78
			               2721 744 458 97 82 78
			               3708 877 521 98 83 79
			               4782 1095 571 98 81 78
			               7337 1509 686 100 82 78
			               15576 2404 763 102 84 80
			               27955 5496 1033 106 85 80
			               47805 13301 1451 117 91 82
			              >;
			pc_temp_ocv_rows = <29>;
			pc_temp_ocv_cols = <6>;
			pc_temp_ocv_percent = <100 95 90 85 80 75 70 65 60 55 50 45 40 35 30 25 20 15 10 9 8 7 6 5 4 3 2 1>;
			pc_temp_ocv_ocv = <
			                   4384 4382 4379 4373 4369 4359
			                   4283 4299 4299 4303 4300 4291
			                   4210 4235 4235 4242 4239 4231
			                   4144 4175 4173 4182 4180 4172
			                   4075 4110 4116 4125 4123 4116
			                   4019 4054 4059 4071 4070 4063
			                   3965 3995 4001 4022 4021 4015
			                   3915 3946 3950 3975 3975 3970
			                   3871 3905 3904 3928 3930 3928
			                   3834 3865 3866 3881 3883 3880
			                   3805 3834 3833 3847 3848 3845
			                   3782 3808 3806 3822 3822 3819
			                   3761 3784 3784 3802 3802 3799
			                   3743 3767 3768 3785 3786 3782
			                   3728 3750 3754 3770 3768 3763
			                   3706 3735 3737 3751 3745 3733
			                   3686 3712 3714 3729 3722 3709
			                   3663 3683 3682 3699 3694 3683
			                   3630 3652 3647 3668 3663 3652
			                   3616 3641 3639 3664 3659 3648
			                   3600 3631 3631 3658 3653 3643
			                   3581 3619 3622 3650 3647 3637
			                   3561 3604 3610 3640 3637 3626
			                   3537 3583 3590 3620 3614 3601
			                   3507 3553 3563 3582 3573 3561
			                   3456 3501 3509 3528 3519 3508
			                   3416 3424 3441 3458 3449 3441
			                   3309 3322 3342 3359 3352 3348
			                   3200 3200 3200 3200 3200 3200
			                  >;
		};
