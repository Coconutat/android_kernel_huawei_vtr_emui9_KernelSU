/* DO NOT EDIT - Automatically generated by python */
		&desayatl_3100_39k_4400 {
			fcc = <3100>;
			default_rbatt_mohm = <100>;
			identify_type = "id_volt";
			id_identify_min = <1235>;
			id_identify_max = <1759>;
			id_voltage_min = <1420>;
			id_voltage_max = <1562>;
			vbat_max = <4400>;
			temp_para = 
						"-32767","0","-1","0","4100","0",
						"0","5","-1","310","4400","0",
						"5","10","-1","930","4400","3",
						"10","45","-1","-1","4400","3",
						"45","50","-1","1085","4100","3",
						"50","32767","-1","0","4100","0";
			vbat_para = 
						"-32767","3400","-1","820","0",
						"3400","32767","-1","-1","0";
			segment_para = 
						"-32767","4150","3100","4208","50",
						"4150","4450","2170","4400","0";
			batt_brand = "desayatl";
			fcc_temp = <3145 3148 3147 3183 3149 3126>;
			fcc_sf_x = <0 100 200 300 400 500 600 700 800 1000 1500>;
			fcc_sf_y = <100 96 94 92 90 88 87 84 81 75 50>;
			fcc_sf_cols = <11>;
			pc_sf_rows = <1>;
			pc_sf_cols = <1>;
			pc_sf_row_entries = <0>;
			pc_sf_percent = <100>;
			pc_sf_sf = <100>;
			rbatt_sf_rows = <28>;
			rbatt_sf_cols = <6>;
			rbatt_sf_percent = <100 95 90 85 80 75 70 65 60 55 50 45 40 35 30 25 20 15 10 9 8 7 6 5 4 3 2 1>;
			rbatt_sf_sf = <
			               2196 1301 543 146 111 101
			               2191 1299 543 146 111 101
			               1955 1229 534 144 112 102
			               1799 1178 528 144 113 103
			               1742 1138 531 146 115 104
			               1600 1116 570 151 117 106
			               1483 996 540 161 122 108
			               1470 971 504 175 130 112
			               1462 950 486 180 139 119
			               1457 940 465 146 119 106
			               1481 945 465 135 111 103
			               1528 978 471 135 111 103
			               1599 1034 493 139 113 105
			               1700 1115 529 142 118 107
			               1819 1223 590 143 119 109
			               1948 1353 675 137 110 102
			               2084 1485 786 135 110 103
			               2266 1613 936 138 111 103
			               3497 1531 746 137 113 104
			               3934 1740 809 137 111 104
			               4336 1920 878 139 114 107
			               4830 2187 973 139 115 108
			               5349 2463 1078 145 116 107
			               5957 2866 1238 143 114 105
			               6616 3149 1403 147 113 107
			               7478 3641 1608 165 116 108
			               8553 4494 2017 239 133 112
			               10174 5750 2725 505 238 169
			              >;
			pc_temp_ocv_rows = <29>;
			pc_temp_ocv_cols = <6>;
			pc_temp_ocv_percent = <100 95 90 85 80 75 70 65 60 55 50 45 40 35 30 25 20 15 10 9 8 7 6 5 4 3 2 1>;
			pc_temp_ocv_ocv = <
			                   4384 4382 4379 4381 4367 4361
			                   4280 4295 4302 4318 4304 4298
			                   4204 4222 4237 4259 4245 4240
			                   4142 4163 4177 4200 4187 4182
			                   4101 4111 4122 4143 4131 4126
			                   4031 4062 4078 4088 4077 4074
			                   3958 3984 4016 4038 4028 4024
			                   3915 3935 3958 3989 3984 3980
			                   3877 3892 3911 3942 3939 3938
			                   3843 3855 3870 3888 3886 3884
			                   3820 3826 3837 3853 3850 3849
			                   3804 3808 3812 3827 3825 3823
			                   3791 3796 3796 3807 3805 3803
			                   3779 3787 3785 3790 3789 3786
			                   3765 3776 3776 3774 3771 3768
			                   3751 3763 3765 3757 3749 3738
			                   3735 3744 3747 3737 3729 3716
			                   3719 3721 3721 3710 3704 3692
			                   3696 3695 3689 3688 3680 3669
			                   3689 3691 3686 3686 3679 3668
			                   3682 3687 3682 3684 3678 3666
			                   3673 3683 3679 3682 3675 3664
			                   3662 3675 3672 3675 3671 3658
			                   3644 3665 3660 3656 3656 3641
			                   3615 3636 3632 3614 3619 3605
			                   3570 3585 3583 3558 3566 3554
			                   3505 3515 3513 3484 3497 3486
			                   3408 3413 3410 3378 3397 3388
			                   3200 3200 3200 3200 3200 3200
			                  >;
		};
