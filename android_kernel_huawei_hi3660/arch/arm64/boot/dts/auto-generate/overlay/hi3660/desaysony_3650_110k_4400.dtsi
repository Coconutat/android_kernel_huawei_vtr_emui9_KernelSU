/* DO NOT EDIT - Automatically generated by python */
		&desaysony_3650_110k_4400 {
			fcc = <3650>;
			default_rbatt_mohm = <100>;
			identify_type = "id_volt";
			id_identify_min = <2281>;
			id_identify_max = <2786>;
			id_voltage_min = <2426>;
			id_voltage_max = <2631>;
			vbat_max = <4400>;
			temp_para = 
						"-32767","0","-1","0","4100","0",
						"0","5","-1","365","4400","0",
						"5","10","-1","1095","4400","3",
						"10","45","-1","-1","4400","3",
						"45","50","-1","1277","4100","3",
						"50","32767","-1","0","4100","0";
			vbat_para = 
						"-32767","3400","-1","820","0",
						"3400","32767","-1","-1","0";
			segment_para = 
						"-32767","4150","3650","4208","50",
						"4150","4450","2555","4400","0";
			batt_brand = "desaysony";
			fcc_temp = <3740 3756 3766 3808 3797 3775>;
			fcc_sf_x = <0 100 200 300 400 500 600 700 800 1000 1500>;
			fcc_sf_y = <100 96 94 92 90 88 87 84 81 75 50>;
			fcc_sf_cols = <11>;
			pc_sf_rows = <1>;
			pc_sf_cols = <1>;
			pc_sf_row_entries = <0>;
			pc_sf_percent = <100>;
			pc_sf_sf = <100>;
			rbatt_sf_rows = <28>;
			rbatt_sf_cols = <6>;
			rbatt_sf_percent = <100 95 90 85 80 75 70 65 60 55 50 45 40 35 30 25 20 15 10 9 8 7 6 5 4 3 2 1>;
			rbatt_sf_sf = <
			               1496 731 397 144 112 101
			               1496 732 397 144 112 101
			               1509 751 407 147 113 102
			               1480 763 414 151 116 103
			               1494 773 416 155 118 105
			               1424 791 440 161 120 107
			               1406 747 431 169 125 109
			               1405 749 416 178 132 113
			               1405 749 407 172 131 114
			               1419 746 403 152 118 106
			               1452 765 401 148 113 103
			               1503 799 405 151 114 103
			               1559 847 418 156 117 104
			               1623 905 446 161 122 108
			               1708 969 479 163 120 107
			               1821 1047 512 160 116 104
			               1988 1156 554 160 118 105
			               2310 1376 632 163 120 106
			               4172 1644 615 159 118 107
			               4733 1804 647 161 120 107
			               5515 2019 697 164 120 108
			               6573 2300 743 170 125 109
			               8028 2781 810 184 127 110
			               10697 3395 933 205 125 108
			               18818 4410 1138 250 146 124
			               35779 6469 1389 246 175 124
			               62294 10211 1847 249 152 141
			               98476 23578 3071 227 175 122
			              >;
			pc_temp_ocv_rows = <29>;
			pc_temp_ocv_cols = <6>;
			pc_temp_ocv_percent = <100 95 90 85 80 75 70 65 60 55 50 45 40 35 30 25 20 15 10 9 8 7 6 5 4 3 2 1>;
			pc_temp_ocv_ocv = <
			                   4381 4380 4377 4370 4365 4359
			                   4282 4301 4304 4302 4298 4292
			                   4214 4238 4242 4241 4237 4232
			                   4148 4178 4182 4181 4178 4173
			                   4099 4119 4121 4124 4122 4117
			                   4027 4068 4071 4071 4068 4065
			                   3966 3999 4015 4021 4019 4016
			                   3915 3946 3961 3974 3975 3972
			                   3870 3899 3913 3927 3929 3927
			                   3834 3855 3873 3881 3882 3881
			                   3806 3821 3838 3847 3848 3846
			                   3783 3796 3809 3822 3823 3821
			                   3761 3776 3787 3802 3804 3801
			                   3742 3759 3772 3786 3787 3784
			                   3724 3742 3759 3769 3767 3761
			                   3706 3724 3742 3749 3744 3733
			                   3686 3698 3718 3727 3722 3710
			                   3660 3666 3684 3697 3694 3682
			                   3621 3634 3651 3667 3663 3652
			                   3605 3623 3645 3662 3659 3648
			                   3590 3612 3639 3656 3653 3643
			                   3575 3598 3631 3648 3646 3636
			                   3554 3584 3619 3637 3635 3624
			                   3530 3563 3601 3616 3611 3599
			                   3497 3531 3571 3578 3571 3559
			                   3462 3491 3519 3527 3520 3507
			                   3397 3419 3445 3458 3452 3441
			                   3310 3322 3349 3359 3357 3347
			                   3200 3200 3200 3200 3200 3200
			                  >;
		};
