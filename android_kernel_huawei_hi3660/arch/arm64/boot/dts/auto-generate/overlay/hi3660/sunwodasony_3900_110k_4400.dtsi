/* DO NOT EDIT - Automatically generated by python */
		&sunwodasony_3900_110k_4400 {
			fcc = <3900>;
			default_rbatt_mohm = <100>;
			identify_type = "id_volt";
			id_identify_min = <2281>;
			id_identify_max = <2786>;
			id_voltage_min = <2426>;
			id_voltage_max = <2631>;
			vbat_max = <4400>;
			temp_para = 
						"-32767","0","-1","0","4100","0",
						"0","5","-1","390","4400","0",
						"5","10","-1","1170","4400","3",
						"10","45","-1","-1","4400","3",
						"45","50","-1","1365","4100","3",
						"50","32767","-1","0","4100","0";
			vbat_para = 
						"-32767","3400","-1","820","0",
						"3400","32767","-1","-1","0";
			segment_para = 
						"-32767","4150","3900","4208","50",
						"4150","4450","2730","4400","0";
			batt_brand = "sunwodasony";
			fcc_temp = <3986 3989 4006 4052 4027 4006>;
			fcc_sf_x = <0 100 200 300 400 500 600 700 800 1000 1500>;
			fcc_sf_y = <100 96 94 92 90 88 87 84 81 75 50>;
			fcc_sf_cols = <11>;
			pc_sf_rows = <1>;
			pc_sf_cols = <1>;
			pc_sf_row_entries = <0>;
			pc_sf_percent = <100>;
			pc_sf_sf = <100>;
			rbatt_sf_rows = <28>;
			rbatt_sf_cols = <6>;
			rbatt_sf_percent = <100 95 90 85 80 75 70 65 60 55 50 45 40 35 30 25 20 15 10 9 8 7 6 5 4 3 2 1>;
			rbatt_sf_sf = <
			               1333 604 328 132 105 96
			               1332 604 328 132 105 96
			               1316 624 342 135 106 96
			               1291 635 351 139 108 98
			               1279 644 357 143 111 98
			               1256 664 379 149 114 100
			               1213 636 374 158 119 103
			               1211 618 355 166 125 106
			               1204 624 344 161 127 109
			               1197 625 337 142 113 100
			               1222 628 335 135 106 96
			               1262 657 340 137 107 96
			               1320 700 351 142 110 97
			               1392 756 371 147 114 101
			               1480 830 403 147 113 101
			               1598 921 441 144 109 97
			               1763 1048 493 144 109 99
			               2039 1260 586 147 110 99
			               3889 1633 575 144 110 99
			               4421 1848 609 146 109 100
			               4974 2097 673 149 109 100
			               5657 2446 748 155 112 102
			               6528 2871 856 157 114 101
			               7622 3458 977 162 114 101
			               9454 4239 1128 175 115 103
			               14621 5412 1402 213 121 103
			               27607 7329 1950 361 173 127
			               46824 13395 3085 367 237 180
			              >;
			pc_temp_ocv_rows = <29>;
			pc_temp_ocv_cols = <6>;
			pc_temp_ocv_percent = <100 95 90 85 80 75 70 65 60 55 50 45 40 35 30 25 20 15 10 9 8 7 6 5 4 3 2 1>;
			pc_temp_ocv_ocv = <
			                   4391 4386 4383 4378 4372 4367
			                   4300 4305 4308 4309 4304 4298
			                   4226 4240 4246 4248 4243 4238
			                   4159 4178 4185 4188 4184 4180
			                   4101 4119 4126 4131 4128 4123
			                   4041 4069 4075 4077 4074 4071
			                   3975 4006 4020 4027 4025 4022
			                   3927 3947 3963 3980 3980 3977
			                   3883 3902 3915 3932 3934 3933
			                   3842 3862 3874 3885 3887 3885
			                   3813 3826 3840 3850 3851 3850
			                   3789 3801 3813 3824 3826 3824
			                   3768 3783 3792 3804 3806 3803
			                   3749 3767 3776 3787 3789 3786
			                   3730 3753 3763 3770 3769 3763
			                   3711 3735 3747 3750 3745 3734
			                   3690 3709 3722 3728 3723 3710
			                   3665 3673 3685 3698 3695 3683
			                   3629 3634 3649 3668 3665 3654
			                   3619 3625 3643 3663 3661 3650
			                   3606 3614 3637 3657 3656 3645
			                   3590 3603 3629 3650 3649 3638
			                   3574 3589 3619 3638 3637 3626
			                   3551 3569 3601 3613 3613 3599
			                   3520 3534 3564 3570 3571 3557
			                   3474 3481 3507 3516 3518 3504
			                   3405 3412 3435 3455 3451 3436
			                   3350 3328 3354 3365 3361 3345
			                   3200 3200 3200 3200 3200 3200
			                  >;
		};
