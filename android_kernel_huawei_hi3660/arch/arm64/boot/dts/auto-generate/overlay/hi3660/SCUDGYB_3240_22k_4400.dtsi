/* DO NOT EDIT - Automatically generated by python */
		&SCUDGYB_3240_22k_4400 {
			fcc = <3240>;
			default_rbatt_mohm = <100>;
			identify_type = "id_volt";
			id_identify_min = <751>;
			id_identify_max = <1235>;
			id_voltage_min = <939>;
			id_voltage_max = <1059>;
			vbat_max = <4400>;
			temp_para = 
						"-32767","0","-1","0","4100","0",
						"0","5","-1","324","4400","0",
						"5","10","-1","972","4400","3",
						"10","45","-1","-1","4400","3",
						"45","50","-1","1134","4100","3",
						"50","32767","-1","0","4100","0";
			vbat_para = 
						"-32767","3400","-1","820","0",
						"3400","32767","-1","-1","0";
			segment_para = 
						"-32767","4150","3240","4208","50",
						"4150","4450","2268","4400","0";
			batt_brand = "SCUDGYB";
			fcc_temp = <3268 3248 3270 3284 3266 3244>;
			fcc_sf_x = <0 100 200 300 400 500 600 700 800 1000 1500>;
			fcc_sf_y = <100 96 94 92 90 88 87 84 81 75 50>;
			fcc_sf_cols = <11>;
			pc_sf_rows = <1>;
			pc_sf_cols = <1>;
			pc_sf_row_entries = <0>;
			pc_sf_percent = <100>;
			pc_sf_sf = <100>;
			rbatt_sf_rows = <28>;
			rbatt_sf_cols = <6>;
			rbatt_sf_percent = <100 95 90 85 80 75 70 65 60 55 50 45 40 35 30 25 20 15 10 9 8 7 6 5 4 3 2 1>;
			rbatt_sf_sf = <
			               2136 1338 441 141 99 91
			               2134 1337 442 141 99 91
			               1989 1282 495 136 99 91
			               1899 1253 483 136 100 92
			               1804 1257 486 135 101 92
			               1624 1174 515 137 103 94
			               1578 1044 463 144 107 95
			               1532 1009 450 155 115 99
			               1529 984 421 160 123 105
			               1543 998 388 125 101 92
			               1575 1044 377 121 98 92
			               1630 1110 387 122 98 92
			               1711 1196 412 124 101 93
			               1810 1303 447 127 103 96
			               1922 1424 499 126 102 97
			               2044 1535 566 122 98 92
			               2181 1639 652 123 98 92
			               2343 1738 772 127 99 92
			               4088 1875 724 128 101 96
			               4454 2084 770 128 101 99
			               4803 2285 845 130 102 98
			               5136 2443 905 131 105 99
			               5508 2629 1016 133 106 97
			               5863 2831 1148 133 108 94
			               6322 3091 1263 134 156 102
			               6925 3363 1414 138 142 129
			               7659 3812 1724 148 112 143
			               8729 4576 2008 237 111 104
			              >;
			pc_temp_ocv_rows = <29>;
			pc_temp_ocv_cols = <6>;
			pc_temp_ocv_percent = <100 95 90 85 80 75 70 65 60 55 50 45 40 35 30 25 20 15 10 9 8 7 6 5 4 3 2 1>;
			pc_temp_ocv_ocv = <
			                   4360 4353 4357 4355 4347 4341
			                   4253 4258 4281 4293 4286 4282
			                   4177 4185 4218 4234 4229 4224
			                   4124 4129 4160 4178 4172 4168
			                   4063 4085 4108 4123 4117 4114
			                   3971 4020 4064 4070 4066 4063
			                   3925 3950 3999 4021 4018 4016
			                   3881 3901 3952 3976 3976 3973
			                   3851 3858 3905 3931 3932 3931
			                   3831 3831 3862 3879 3878 3877
			                   3815 3815 3829 3847 3847 3846
			                   3801 3803 3808 3823 3823 3822
			                   3787 3793 3795 3803 3804 3802
			                   3774 3782 3787 3787 3788 3785
			                   3760 3770 3778 3773 3771 3767
			                   3746 3753 3765 3756 3748 3736
			                   3732 3733 3745 3736 3728 3715
			                   3714 3714 3717 3710 3703 3691
			                   3692 3698 3689 3688 3681 3668
			                   3686 3694 3686 3686 3680 3668
			                   3679 3691 3684 3685 3678 3666
			                   3671 3687 3680 3682 3676 3664
			                   3661 3680 3674 3675 3670 3658
			                   3642 3665 3662 3656 3651 3639
			                   3613 3632 3630 3616 3617 3600
			                   3570 3583 3580 3561 3566 3551
			                   3506 3511 3515 3485 3496 3485
			                   3406 3391 3415 3372 3393 3382
			                   3200 3200 3200 3200 3200 3200
			                  >;
		};
