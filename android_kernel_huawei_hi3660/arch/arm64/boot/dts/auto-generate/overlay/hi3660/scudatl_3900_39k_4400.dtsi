/* DO NOT EDIT - Automatically generated by python */
		&scudatl_3900_39k_4400 {
			fcc = <3900>;
			default_rbatt_mohm = <100>;
			identify_type = "id_volt";
			id_identify_min = <1235>;
			id_identify_max = <1759>;
			id_voltage_min = <1420>;
			id_voltage_max = <1562>;
			vbat_max = <4400>;
			temp_para = 
						"-32767","0","-1","0","4100","0",
						"0","5","-1","390","4400","0",
						"5","10","-1","1170","4400","3",
						"10","45","-1","-1","4400","3",
						"45","50","-1","1365","4100","3",
						"50","32767","-1","0","4100","0";
			vbat_para = 
						"-32767","3400","-1","820","0",
						"3400","32767","-1","-1","0";
			segment_para = 
						"-32767","4150","3900","4208","50",
						"4150","4450","2730","4400","0";
			batt_brand = "scudatl";
			fcc_temp = <3955 3958 3959 3979 3969 3941>;
			fcc_sf_x = <0 100 200 300 400 500 600 700 800 1000 1500>;
			fcc_sf_y = <100 96 94 92 90 88 87 84 81 75 50>;
			fcc_sf_cols = <11>;
			pc_sf_rows = <1>;
			pc_sf_cols = <1>;
			pc_sf_row_entries = <0>;
			pc_sf_percent = <100>;
			pc_sf_sf = <100>;
			rbatt_sf_rows = <28>;
			rbatt_sf_cols = <6>;
			rbatt_sf_percent = <100 95 90 85 80 75 70 65 60 55 50 45 40 35 30 25 20 15 10 9 8 7 6 5 4 3 2 1>;
			rbatt_sf_sf = <
			               1479 944 413 126 102 94
			               1478 944 413 126 102 94
			               1434 932 405 126 102 94
			               1382 912 393 128 104 95
			               1356 891 386 132 106 96
			               1347 918 401 137 109 98
			               1201 856 421 145 115 100
			               1185 797 385 153 118 103
			               1171 799 373 161 126 109
			               1154 786 353 135 112 99
			               1177 775 345 123 102 95
			               1218 824 343 124 104 96
			               1263 880 345 127 107 99
			               1315 943 372 132 110 101
			               1375 1016 408 134 111 103
			               1454 1102 450 130 104 96
			               1553 1204 500 126 102 96
			               1686 1317 562 129 103 95
			               2302 1234 476 124 104 97
			               2507 1337 499 125 105 98
			               2682 1466 518 125 105 99
			               2859 1604 550 128 106 100
			               3038 1752 600 129 107 102
			               3229 1903 653 128 105 98
			               3427 2048 691 128 104 98
			               3664 2223 756 132 105 99
			               3995 2474 870 135 108 99
			               4487 2850 1079 157 125 114
			              >;
			pc_temp_ocv_rows = <29>;
			pc_temp_ocv_cols = <6>;
			pc_temp_ocv_percent = <100 95 90 85 80 75 70 65 60 55 50 45 40 35 30 25 20 15 10 9 8 7 6 5 4 3 2 1>;
			pc_temp_ocv_ocv = <
			                   4391 4388 4385 4378 4374 4369
			                   4304 4312 4317 4315 4313 4308
			                   4235 4246 4258 4256 4255 4251
			                   4172 4187 4201 4198 4197 4194
			                   4121 4128 4144 4142 4141 4138
			                   4077 4087 4096 4089 4088 4085
			                   3983 4016 4045 4040 4040 4036
			                   3936 3949 3978 3990 3991 3991
			                   3896 3909 3933 3948 3950 3948
			                   3857 3869 3889 3895 3898 3896
			                   3831 3831 3853 3857 3859 3859
			                   3813 3813 3824 3831 3832 3832
			                   3798 3800 3801 3810 3811 3811
			                   3784 3789 3789 3793 3794 3793
			                   3770 3779 3779 3778 3776 3773
			                   3756 3766 3768 3761 3754 3743
			                   3741 3748 3750 3741 3732 3720
			                   3724 3724 3722 3714 3706 3695
			                   3699 3693 3692 3690 3683 3672
			                   3693 3688 3689 3689 3682 3671
			                   3686 3684 3686 3687 3680 3669
			                   3679 3680 3682 3684 3677 3666
			                   3668 3673 3676 3678 3671 3658
			                   3652 3658 3661 3660 3653 3636
			                   3622 3628 3626 3623 3616 3597
			                   3576 3578 3573 3571 3565 3546
			                   3509 3509 3503 3502 3497 3477
			                   3407 3408 3402 3402 3399 3379
			                   3200 3200 3200 3200 3200 3200
			                  >;
		};
