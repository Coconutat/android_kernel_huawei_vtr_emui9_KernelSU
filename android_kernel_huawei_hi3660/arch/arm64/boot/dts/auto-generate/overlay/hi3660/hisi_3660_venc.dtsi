/*
 * Hisilicon Ltd. Hi3660 SoC
 *
 * Copyright (C) 2014- Hisilicon Ltd.
 *
 * This program is free software; you can redistribute it and/or modify
 * it under the terms of the GNU General Public License version 2 as
 * publishhed by the Free Software Foundation.
 */

/ {
  venc{
        compatible = "hisi,kirin960-venc";
        reg = <0x0 0xe8900000 0x0 0x20000>;
        interrupts = <0 298 4>, <0 299 4>;
        clocks = <&clk_gate_venc &venc_volt_hold>;
        clock-names = "clk_venc", "venc_volt_hold";
        enc_clk_rate = <645000000>, <534000000>;
        ldo_venc-supply = <&venc>;
        venc_qos_mode = <0x2>;
        status = "ok";
        iommu_info {
            start-addr = <0x40000>;
            size = <0xE0000000>;
        };
      };
};
