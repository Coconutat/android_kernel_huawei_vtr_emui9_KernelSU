/*---------------------------------------------------------------------------
 * This file is autogenerated file using huawei LCD parser. Please do not edit it.
 * Update input XML file to add a new entry or update variable in this file
 * Parser location: vendor/huawei/chipset_common/devkit/lcdkit/tools 
 *---------------------------------------------------------------------------*/


/include/ "victoria_va_jdi_nt35696_5p5_1080p_cmd.dtsi"
/include/ "victoria_va_jdi_nt35696h_5p1_1080p_cmd.dtsi"
/include/ "victoria_va_lgd_nt36772_5p5_1080p_cmd.dtsi"
/include/ "victoria_va_sharp_td4322_5p5_1080p_cmd.dtsi"
/include/ "victoria_va_tianma_td4322_5p5_1080p_cmd.dtsi"