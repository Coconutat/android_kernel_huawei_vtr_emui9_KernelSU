/**
 * Copyright (C) 2014 Hisilicon Ltd.
 *
 *  This program is free software; you can redistribute it and/or modify
 *  it under the terms of the GNU General Public License version 2 as
 *  publishhed by the Free Software Foundation.
 */

/dts-v1/;
/include/ "fastboot.dtsi"
/include/ "hi3660_udp_default_config.dtsi"
/include/ "hi3660_udp_EVB8_VERD_sec_pin.dtsi"
/include/ "hi3660_udp_EVB8_VERD_pin.dtsi"
/ {
	hisi,boardid = <5 0 0 3>;
	hisi,boardname = "hi3660_udp_EVB8_VERD";
	hisi,product_id = <0x3AF5FC03>;
};
