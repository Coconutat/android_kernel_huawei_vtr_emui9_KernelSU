/* DO NOT EDIT - Automatically generated by python */
/ {
		sunwodasony_3100_110k_4400_40:sunwodasony_3100_110k_4400_40 {
			fcc = <3100>;
			default_rbatt_mohm = <100>;
			identify_type = "id_volt";
			id_identify_min = <2281>;
			id_identify_max = <2786>;
			id_voltage_min = <2426>;
			id_voltage_max = <2631>;
			vbat_max = <4400>;
			temp_para = 
						"-32767","0","-1","0","4100","0",
						"0","5","-1","310","4400","0",
						"5","10","-1","930","4400","3",
						"10","45","-1","-1","4400","3",
						"45","50","-1","1085","4100","3",
						"50","32767","-1","0","4100","0";
			vbat_para = 
						"-32767","3400","-1","820","0",
						"3400","32767","-1","-1","0";
			segment_para = 
						"-32767","4150","3100","4208","50",
						"4150","4450","2170","4400","0";
			batt_brand = "sunwodasony";
			fcc_temp = <3068 3070 3077 3132 3095 3076>;
			fcc_sf_x = <0 100 200 300 400 500 600 700 800 1000 1500>;
			fcc_sf_y = <100 96 94 92 90 88 87 84 81 75 50>;
			fcc_sf_cols = <11>;
			pc_sf_rows = <1>;
			pc_sf_cols = <1>;
			pc_sf_row_entries = <0>;
			pc_sf_percent = <100>;
			pc_sf_sf = <100>;
			rbatt_sf_rows = <28>;
			rbatt_sf_cols = <6>;
			rbatt_sf_percent = <100 95 90 85 80 75 70 65 60 55 50 45 40 35 30 25 20 15 10 9 8 7 6 5 4 3 2 1>;
			rbatt_sf_sf = <
			               1707 835 422 162 121 109
			               1704 842 428 163 121 109
			               1688 856 438 166 124 110
			               1673 868 449 170 127 111
			               1655 879 469 176 130 113
			               1597 872 480 184 134 115
			               1563 854 468 195 141 118
			               1567 853 455 199 149 124
			               1573 857 446 181 140 120
			               1583 864 441 165 126 111
			               1622 881 444 161 124 110
			               1681 924 451 165 125 110
			               1752 990 466 170 129 112
			               1843 1066 495 176 133 115
			               1958 1152 535 176 130 113
			               2110 1270 583 170 126 110
			               2338 1443 647 171 128 112
			               2891 1744 774 175 128 112
			               5136 1976 715 170 126 114
			               6254 2301 753 173 129 114
			               7589 2660 817 177 130 116
			               9323 3228 915 183 132 117
			               11781 3974 1040 186 132 118
			               16998 5191 1251 189 132 117
			               29502 6735 1557 204 136 116
			               50783 9329 2010 256 143 118
			               85205 17734 2845 359 209 150
			               137013 35798 4768 517 202 221
			              >;
			pc_temp_ocv_rows = <29>;
			pc_temp_ocv_cols = <6>;
			pc_temp_ocv_percent = <100 95 90 85 80 75 70 65 60 55 50 45 40 35 30 25 20 15 10 9 8 7 6 5 4 3 2 1>;
			pc_temp_ocv_ocv = <
			                   4341 4340 4338 4339 4324 4319
			                   4256 4268 4271 4276 4263 4258
			                   4185 4205 4210 4217 4205 4200
			                   4126 4147 4152 4159 4149 4144
			                   4073 4091 4098 4104 4095 4091
			                   4009 4034 4046 4053 4045 4041
			                   3949 3976 3991 4005 3999 3996
			                   3903 3926 3941 3959 3956 3955
			                   3863 3883 3897 3911 3910 3909
			                   3827 3845 3859 3871 3869 3867
			                   3799 3814 3828 3840 3839 3837
			                   3776 3790 3803 3817 3816 3814
			                   3755 3773 3783 3798 3798 3795
			                   3736 3758 3769 3782 3783 3779
			                   3719 3742 3755 3766 3762 3755
			                   3702 3724 3740 3745 3740 3728
			                   3682 3699 3717 3724 3718 3706
			                   3656 3667 3682 3694 3689 3678
			                   3615 3626 3641 3663 3660 3649
			                   3602 3616 3635 3658 3655 3645
			                   3586 3604 3628 3653 3650 3640
			                   3566 3591 3619 3645 3643 3633
			                   3546 3574 3606 3632 3631 3620
			                   3521 3556 3587 3606 3604 3593
			                   3489 3524 3554 3563 3561 3552
			                   3445 3470 3501 3510 3508 3501
			                   3397 3398 3427 3444 3443 3436
			                   3302 3312 3330 3357 3348 3348
			                   3200 3200 3200 3200 3200 3200
			                  >;
		};
};
