/* DO NOT EDIT - Automatically generated by python */
/ {
		scudlgc_3100_200k_4400:scudlgc_3100_200k_4400 {
			fcc = <3100>;
			default_rbatt_mohm = <100>;
			identify_type = "id_volt";
			id_identify_min = <2786>;
			id_identify_max = <3312>;
			id_voltage_min = <2941>;
			id_voltage_max = <3167>;
			vbat_max = <4400>;
			temp_para = 
						"-32767","0","-1","0","4100","0",
						"0","5","-1","310","4400","0",
						"5","10","-1","930","4400","3",
						"10","45","-1","-1","4400","3",
						"45","50","-1","1085","4100","3",
						"50","32767","-1","0","4100","0";
			vbat_para = 
						"-32767","3400","-1","820","0",
						"3400","32767","-1","-1","0";
			segment_para = 
						"-32767","4150","3100","4208","50",
						"4150","4450","2170","4400","0";
			batt_brand = "scudlgc";
			fcc_temp = <3096 3100 3096 3157 3099 3087>;
			fcc_sf_x = <0 100 200 300 400 500 600 700 800 1000 1500>;
			fcc_sf_y = <100 96 94 92 90 88 87 84 81 75 50>;
			fcc_sf_cols = <11>;
			pc_sf_rows = <1>;
			pc_sf_cols = <1>;
			pc_sf_row_entries = <0>;
			pc_sf_percent = <100>;
			pc_sf_sf = <100>;
			rbatt_sf_rows = <28>;
			rbatt_sf_cols = <6>;
			rbatt_sf_percent = <100 95 90 85 80 75 70 65 60 55 50 45 40 35 30 25 20 15 10 9 8 7 6 5 4 3 2 1>;
			rbatt_sf_sf = <
			               2303 1316 559 138 85 70
			               2303 1316 559 138 85 70
			               2127 1270 565 137 85 71
			               2023 1241 574 138 88 71
			               1985 1260 587 144 92 74
			               1767 1138 689 152 97 76
			               1722 1071 537 168 101 80
			               1705 1059 528 176 109 83
			               1705 1045 519 175 123 93
			               1713 1040 497 136 96 79
			               1770 1060 492 124 84 71
			               1869 1129 489 123 86 72
			               1998 1245 521 127 89 74
			               2151 1400 580 130 95 79
			               2309 1566 685 131 96 81
			               2465 1732 828 127 87 72
			               2613 1871 1004 125 85 72
			               2780 1999 1223 131 87 74
			               3222 2096 1416 124 89 73
			               4574 2061 907 128 91 77
			               5121 2327 1079 129 90 72
			               5545 2644 1218 139 89 75
			               5959 2890 1378 138 88 72
			               6448 3180 1549 144 87 76
			               6925 3449 1703 149 89 78
			               7472 3746 1910 169 94 79
			               8075 4060 2189 230 99 78
			               8970 4660 2624 561 107 86
			              >;
			pc_temp_ocv_rows = <29>;
			pc_temp_ocv_cols = <6>;
			pc_temp_ocv_percent = <100 95 90 85 80 75 70 65 60 55 50 45 40 35 30 25 20 15 10 9 8 7 6 5 4 3 2 1>;
			pc_temp_ocv_ocv = <
			                   4379 4378 4374 4376 4357 4352
			                   4255 4272 4283 4309 4292 4289
			                   4172 4192 4214 4250 4234 4232
			                   4111 4129 4155 4193 4178 4175
			                   4068 4086 4100 4137 4123 4121
			                   3973 4005 4066 4084 4071 4069
			                   3925 3948 3978 4038 4022 4021
			                   3881 3905 3936 3979 3979 3977
			                   3846 3865 3894 3939 3938 3938
			                   3817 3831 3855 3887 3885 3885
			                   3800 3808 3823 3852 3849 3849
			                   3787 3794 3800 3826 3825 3824
			                   3776 3783 3788 3805 3805 3804
			                   3764 3775 3780 3788 3789 3787
			                   3752 3764 3771 3774 3773 3770
			                   3740 3752 3760 3759 3753 3741
			                   3725 3738 3743 3740 3733 3720
			                   3706 3722 3720 3712 3706 3693
			                   3679 3701 3699 3688 3682 3670
			                   3670 3694 3688 3687 3681 3669
			                   3663 3686 3684 3685 3679 3668
			                   3654 3680 3678 3683 3677 3666
			                   3640 3670 3669 3675 3672 3660
			                   3623 3656 3654 3653 3657 3642
			                   3599 3631 3628 3609 3623 3604
			                   3562 3590 3588 3551 3574 3555
			                   3503 3522 3526 3474 3508 3486
			                   3405 3420 3431 3368 3409 3385
			                   3200 3200 3200 3200 3200 3200
			                  >;
		};
};
