/* Copyright (c) 2013, The Linux Foundation. All rights reserved.
 *
 * This program is free software; you can redistribute it and/or modify
 * it under the terms of the GNU General Public License version 2 and
 * only version 2 as published by the Free Software Foundation.
 *
 * This program is distributed in the hope that it will be useful,
 * but WITHOUT ANY WARRANTY; without even the implied warranty of
 * MERCHANTABILITY or FITNESS FOR A PARTICULAR PURPOSE.  See the
 * GNU General Public License for more details.
 */

/*-------------------------------------------------------------------------
 * This file is autogenerated file using gcdb parser. Please do not edit it.
 * Update input XML file to add a new entry or update variable in this file
 * VERSION = 1.1
 *-----------------------------------------------------------------------*/
/ {
	dsi_cmr_boedvt2_nt35523_10p7_1600p_video: lcdkit_cmr_boedvt2_nt35523_10p7_1600p_video {
		compatible = "boedvt2-nt35523-10p7-1600p-video";
		hw,lcdkit-panel-name = "BOEDVT2_NT35523 10p7 VIDEO TFT 1600 x 2560";
		hw,lcdkit-panel-type = <0x01>;
		hw,lcdkit-panel-xres = <1600>;
		hw,lcdkit-panel-yres = <2560>;
		hw,lcdkit-panel-width = <144>;
		hw,lcdkit-panel-height = <231>;
		hw,lcdkit-panel-on-command = <0x29 0x01 0x00 0x00 0x0a 0x00 0x06 0xF0 0x55 0xAA 0x52 0x08 0x00
				0x29 0x01 0x00 0x00 0x0a 0x00 0x03 0xB1 0xE8 0x07
				0x29 0x01 0x00 0x00 0x0a 0x00 0x03 0xB2 0x25 0x02
				0x29 0x01 0x00 0x00 0x0a 0x00 0x03 0xB5 0x0A 0x00
				0x29 0x01 0x00 0x00 0x0a 0x00 0x04 0xB8 0x02 0x06 0x0A
				0x29 0x01 0x00 0x00 0x0a 0x00 0x03 0xBB 0x83 0x83
				0x29 0x01 0x00 0x00 0x0a 0x00 0x03 0xBC 0x0F 0x00
				0x29 0x01 0x00 0x00 0x0a 0x00 0x05 0xBD 0x01 0x40 0x0A 0x0A
				0x23 0x01 0x00 0x00 0x0a 0x00 0x02 0x6F 0x07
				0x23 0x01 0x00 0x00 0x0a 0x00 0x02 0xC0 0x04
				0x29 0x01 0x00 0x00 0x0a 0x00 0x04 0xC5 0x12 0x21 0x00
				0x29 0x01 0x00 0x00 0x0a 0x00 0x04 0xD9 0x00 0x01 0x80
				0x29 0x01 0x00 0x00 0x0a 0x00 0x05 0xE6 0xFE 0xF6 0xEE 0xE6
				0x29 0x01 0x00 0x00 0x0a 0x00 0x0B 0xE7 0xFC 0xF9 0xF7 0xF4 0xF2 0xF0 0xDD 0xCB 0xC0 0x9B
				0x29 0x01 0x00 0x00 0x0a 0x00 0x0E 0xD5 0x09 0x09 0x0A 0x09 0x09 0x06 0x08 0x0B 0x0A 0x11 0x00 0x05 0x09
				0x29 0x01 0x00 0x00 0x0a 0x00 0x06 0xF0 0x55 0xAA 0x52 0x08 0x01
				0x23 0x01 0x00 0x00 0x0a 0x00 0x02 0xB3 0x37
				0x23 0x01 0x00 0x00 0x0a 0x00 0x02 0xB4 0x19
				0x23 0x01 0x00 0x00 0x0a 0x00 0x02 0xB9 0x54
				0x29 0x01 0x00 0x00 0x0a 0x00 0x03 0xBC 0x60 0x00
				0x29 0x01 0x00 0x00 0x0a 0x00 0x03 0xBD 0x60 0x00
				0x23 0x01 0x00 0x00 0x0a 0x00 0x02 0xCA 0x00
				0x23 0x01 0x00 0x00 0x0a 0x00 0x02 0xCE 0x04
				0x29 0x01 0x00 0x00 0x0a 0x00 0x03 0xD8 0xC0 0x03
				0x29 0x01 0x00 0x00 0x0a 0x00 0x06 0xF0 0x55 0xAA 0x52 0x08 0x03
				0x29 0x01 0x00 0x00 0x0a 0x00 0x05 0xB0 0x00 0x00 0x32 0x32
				0x29 0x01 0x00 0x00 0x0a 0x00 0x05 0xB1 0x00 0x00 0x07 0x00
				0x29 0x01 0x00 0x00 0x0a 0x00 0x08 0xB2 0x00 0x00 0x08 0x03 0x00 0x26 0x5A
				0x29 0x01 0x00 0x00 0x0a 0x00 0x08 0xBA 0x84 0x04 0x00 0x07 0x01 0x26 0x5A
				0x29 0x01 0x00 0x00 0x0a 0x00 0x08 0xBB 0x84 0x04 0x00 0x06 0x01 0x26 0x5A
				0x23 0x01 0x00 0x00 0x0a 0x00 0x02 0xC4 0x10
				0x23 0x01 0x00 0x00 0x0a 0x00 0x02 0xEF 0x41
				0x29 0x01 0x00 0x00 0x0a 0x00 0x06 0xF0 0x55 0xAA 0x52 0x08 0x05
				0x29 0x01 0x00 0x00 0x0a 0x00 0x05 0xB0 0x01 0x03 0x00 0x03
				0x29 0x01 0x00 0x00 0x0a 0x00 0x03 0xB1 0x30 0x00
				0x29 0x01 0x00 0x00 0x0a 0x00 0x04 0xB2 0x03 0x01 0x00
				0x29 0x01 0x00 0x00 0x0a 0x00 0x05 0xB3 0x82 0x00 0x01 0x87
				0x29 0x01 0x00 0x00 0x0a 0x00 0x05 0xB4 0xD5 0x75 0x07 0x57
				0x29 0x01 0x00 0x00 0x0a 0x00 0x06 0xD0 0x00 0x0A 0x01 0x00 0x00
				0x29 0x01 0x00 0x00 0x0a 0x00 0x06 0xD1 0x00 0x0A 0x00 0x00 0x00
				0x29 0x01 0x00 0x00 0x0a 0x00 0x06 0xF0 0x55 0xAA 0x52 0x08 0x06
				0x29 0x01 0x00 0x00 0x0a 0x00 0x06 0xB0 0x18 0x18 0x19 0x19 0x16
				0x29 0x01 0x00 0x00 0x0a 0x00 0x06 0xB1 0x16 0x17 0x17 0x32 0x32
				0x29 0x01 0x00 0x00 0x0a 0x00 0x06 0xB2 0x32 0x32 0x33 0x33 0x01
				0x29 0x01 0x00 0x00 0x0a 0x00 0x06 0xB3 0x01 0x33 0x33 0x3D 0x3D
				0x29 0x01 0x00 0x00 0x0a 0x00 0x03 0xB4 0x3D 0x3D
				0x29 0x01 0x00 0x00 0x0a 0x00 0x06 0xB5 0x12 0x12 0x13 0x13 0x10
				0x29 0x01 0x00 0x00 0x0a 0x00 0x06 0xB6 0x10 0x11 0x11 0x32 0x32
				0x29 0x01 0x00 0x00 0x0a 0x00 0x06 0xB7 0x32 0x32 0x33 0x33 0x00
				0x29 0x01 0x00 0x00 0x0a 0x00 0x06 0xB8 0x00 0x33 0x33 0x3D 0x3D
				0x29 0x01 0x00 0x00 0x0a 0x00 0x03 0xB9 0x3D 0x3D
				0x29 0x01 0x00 0x00 0x0a 0x00 0x06 0xC0 0x11 0x11 0x10 0x10 0x13
				0x29 0x01 0x00 0x00 0x0a 0x00 0x06 0xC1 0x13 0x12 0x12 0x32 0x32
				0x29 0x01 0x00 0x00 0x0a 0x00 0x06 0xC2 0x33 0x33 0x33 0x33 0x00
				0x29 0x01 0x00 0x00 0x0a 0x00 0x06 0xC3 0x00 0x32 0x32 0x3D 0x3D
				0x29 0x01 0x00 0x00 0x0a 0x00 0x03 0xC4 0x3D 0x3D
				0x29 0x01 0x00 0x00 0x0a 0x00 0x06 0xC5 0x17 0x17 0x16 0x16 0x19
				0x29 0x01 0x00 0x00 0x0a 0x00 0x06 0xC6 0x19 0x18 0x18 0x32 0x32
				0x29 0x01 0x00 0x00 0x0a 0x00 0x06 0xC7 0x33 0x33 0x33 0x33 0x01
				0x29 0x01 0x00 0x00 0x0a 0x00 0x06 0xC8 0x01 0x32 0x32 0x3D 0x3D
				0x29 0x01 0x00 0x00 0x0a 0x00 0x03 0xC9 0x3D 0x3D
				0x23 0x01 0x00 0x00 0x0a 0x00 0x02 0x35 0x00
				0x15 0x01 0x00 0x00 0x0a 0x00 0x02 0x51 0xFE
				0x15 0x01 0x00 0x00 0x0a 0x00 0x02 0x53 0x24
				0x15 0x01 0x00 0x00 0x0a 0x00 0x02 0x55 0x01
				0x29 0x01 0x00 0x00 0x0a 0x00 0x05 0xFF 0xAA 0x55 0xA5 0x80
				0x23 0x01 0x00 0x00 0x0a 0x00 0x02 0x6F 0x1E
				0x23 0x01 0x00 0x00 0x0a 0x00 0x02 0xF4 0x08
				0x29 0x01 0x00 0x00 0x0a 0x00 0x06 0xF0 0x55 0xAA 0x52 0x08 0x04
				0x23 0x01 0x00 0x00 0x0a 0x00 0x02 0xEC 0x4C
				0x29 0x01 0x00 0x00 0x0a 0x00 0x05 0xFF 0xAA 0x55 0xA5 0x80
				0x23 0x01 0x00 0x00 0x0a 0x00 0x02 0x6F 0x09
				0x23 0x01 0x00 0x00 0x0a 0x00 0x02 0xF7 0x82
				0x23 0x01 0x00 0x00 0x0a 0x00 0x02 0x6F 0x0B
				0x23 0x01 0x00 0x00 0x0a 0x00 0x02 0xF7 0xE0
				0x29 0x01 0x00 0x00 0x0a 0x00 0x05 0xFF 0xAA 0x55 0xA5 0x00
				0x05 0x01 0x00 0x00 0x0a 0x00 0x02 0x11 0x00>;
		hw,lcdkit-panel-on-command-state = "dsi_lp_mode";
		hw,lcdkit-panel-on-second-command = <0x05 0x01 0x00 0x00 0x00 0x00 0x02 0x29 0x00>;
		hw,lcdkit-panel-display-on-command = <0x05 0x01 0x00 0x00 0x78 0x00 0x02 0x29 0x00>;
		hw,lcdkit-panel-off-command = <0x05 0x01 0x00 0x00 0x0a 0x00 0x02 0x28 0x00>;
		hw,lcdkit-panel-off-command-state = "dsi_lp_mode";
		hw,lcdkit-panel-off-second-command = <0x05 0x01 0x00 0x00 0x0a 0x00 0x02 0x10 0x00>;
		hw,lcdkit-panel-backlight-command = <0x15 0x01 0x00 0x00 0x00 0x00 0x02 0x51 0x00>;
		hw,lcdkit-panel-backlight-command-state = "dsi_lp_mode";
		hw,lcdkit-panel-cabc-off-command = <0x15 0x01 0x00 0x00 0x0a 0x00 0x02 0x55 0x00>;
		hw,lcdkit-panel-cabc-off-command-state = "dsi_lp_mode";
		hw,lcdkit-panel-cabc-ui-command = <0x15 0x01 0x00 0x00 0x0a 0x00 0x02 0x55 0x01>;
		hw,lcdkit-panel-cabc-ui-command-state = "dsi_lp_mode";
		hw,lcdkit-panel-cabc-still-command = <0x15 0x01 0x00 0x00 0x0a 0x00 0x02 0x55 0x02>;
		hw,lcdkit-panel-cabc-still-command-state = "dsi_lp_mode";
		hw,lcdkit-panel-cabc-moving-command = <0x15 0x01 0x00 0x00 0x0a 0x00 0x02 0x55 0x02>;
		hw,lcdkit-panel-cabc-moving-command-state = "dsi_lp_mode";
		hw,lcdkit-panel-cabc-support = <1>;
		hw,lcdkit-panel-display-on-effect-command = <0x15 0x01 0x00 0x00 0x0a 0x00 0x02 0x55 0x81>;
		hw,lcdkit-panel-display-on-effect-support = <0>;
		hw,lcdkit-panel-ce-off-command = <>;
		hw,lcdkit-panel-ce-srgb-command = <>;
		hw,lcdkit-panel-ce-user-command = <>;
		hw,lcdkit-panel-ce-vivid-command = <>;
		hw,lcdkit-panel-ce-support = <0>;
		hw,lcdkit-panel-inversion-support = <0>;
		hw,lcdkit-panel-scan-support = <0>;
		hw,lcdkit-panel-display-region-command = <0x39 0x01 0x00 0x00 0x05 0x00 0x05 0x2A 0x00 0x00 0x04 0x37
				0x39 0x01 0x00 0x00 0x05 0x00 0x05 0x2B 0x00 0x00 0x07 0x7F>;
		hw,lcdkit-panel-display-region-command-state = "dsi_lp_mode";
		hw,lcdkit-panel-display-region-support = <0>;
		hw,lcdkit-panel-checksum-enter-command = <0x15 0x01 0x00 0x00 0x0a 0x00 0x02 0xFF 0xF0>;
		hw,lcdkit-panel-checksum-command = <0x06 0x01 0x00 0x00 0x14 0x00 0x01 0x73>;
		hw,lcdkit-panel-checksum-exit-command = <0x15 0x01 0x00 0x00 0x0a 0x00 0x02 0xFF 0x10>;
		hw,lcdkit-panel-checksum-value = <0x08 0x5B 0x5E 0x8E 0xEB 0xE5 0x2B 0x46 0xF9
				0x08 0xBE 0x8A 0x67 0x5C 0x6 0xFA 0xFB 0xDB
				0x08 0xFB 0xCE 0x5C 0x3D 0x4D 0x0F 0x41 0x6
				0x08 0xA6 0x91 0x1B 0xD7 0x71 0x44 0x3F 0x75>;
		hw,lcdkit-panel-checksum-support = <0>;
		hw,lcdkit-panel-esd-reg-command = <0x06 0x01 0x00 0x00 0x0a 0x00 0x01 0x0a>;
		hw,lcdkit-panel-esd-reg-command-state = "dsi_lp_mode";
		hw,lcdkit-panel-esd-value = <0x9c>;
		hw,lcdkit-panel-esd-support = <0>;
		hw,lcdkit-panel-check-reg-command = <0x06 0x01 0x00 0x00 0x0a 0x00 0x04 0x0a 0x0b 0x0c 0x0d>;
		hw,lcdkit-panel-check-reg-value = <0x0c 0x00 0x77 0x00>;
		hw,lcdkit-panel-check-reg-command-state = "dsi_lp_mode";
		hw,lcdkit-panel-check-reg-support = <0>;
		hw,lcdkit-panel-gamma-correct-reg = <0xD3 0xC7 0xC8>;
		hw,lcdkit-panel-gamma-reg-len = <28 30 49>;
		hw,lcdkit-panel-check-on-value = <0x0a>;
		hw,lcdkit-panel-check-reg-expect-value = <0x9c>;
		hw,lcdkit-panel-check-reg-mask-value = <0xff>;
		hw,lcdkit-panel-dynamic-gamma-support = <0>;
		hw,lcdkit-panel-mipi-detect-command = <0x06 0x01 0x00 0x00 0x0a 0x00 0x01 0x0e
				0x06 0x01 0x00 0x00 0x0a 0x00 0x01 0x05
				0x06 0x01 0x00 0x00 0x0a 0x00 0x01 0xab>;
		hw,lcdkit-panel-mipi-detect-value = <0x80 0x00 0x00>;
		hw,lcdkit-panel-mipi-detect-mask = <0xFF 0xFF 0xFFFF>;
		hw,lcdkit-panel-mipi-detect-command-state = "dsi_lp_mode";
		hw,lcdkit-panel-mipi-detect-support = <0>;
		hw,lcdkit-panel-dynamic-sram-check-support = <0>;
		hw,lcdkit-panel-snd-cmd-before-frame-command = <0x23 0x01 0x00 0x00 0x02 0x00 0x02 0xF4 0x1D>;
		hw,lcdkit-panel-snd-cmd-before-frame-command-state = "dsi_hs_mode";
		hw,lcdkit-panel-fps-to-thirty-command = <0x29 0x01 0x00 0x00 0x0a 0x00 0x02 0xb0 0x00
				0x29 0x01 0x00 0x00 0x0a 0x00 0x02 0xf4 0x17>;
		hw,lcdkit-panel-fps-to-thirty-command-state = "dsi_hs_mode";
		hw,lcdkit-panel-fps-to-sixty-command = <0x29 0x01 0x00 0x00 0x0a 0x00 0x02 0xb0 0x00
				0x29 0x01 0x00 0x00 0x0a 0x00 0x02 0xf4 0x16>;
		hw,lcdkit-panel-fps-to-sixty-command-state = "dsi_hs_mode";
		hw,lcdkit-panel-dfr-enable-command = <0x29 0x01 0x00 0x00 0x0a 0x00 0x02 0xb0 0x00
				0x29 0x01 0x00 0x00 0x0a 0x00 0x02 0xf4 0x19>;
		hw,lcdkit-panel-dfr-enable-command-state = "dsi_hs_mode";
		hw,lcdkit-panel-fps-updt-support = <0>;
		hw,lcdkit-panel-fps-func-switch = <0>;
		hw,lcdkit-panel-chip-esd-disable = <1>;
		hw,lcdkit-panel-check-reg-on-support = <1>;
		hw,lcdkit-panel-fps-tscall-support = <0>;
		hw,lcdkit-panel-dis-on-cmds-delay-margin-support = <0>;
		hw,lcdkit-panel-snd-cmd-before-frame-support = <0>;
		hw,lcdkit-panel-ts-resume-ctrl-mode = <0>;
		hw,lcdkit-panel-dis-on-cmds-delay-margin-time = <0>;
		hw,lcdkit-panel-lptohs-mipi-check-support = <0>;
		hw,lcdkit-panel-acl-ctrl-support = <0>;
		hw,lcdkit-panel-hbm-ctrl-support = <0>;
		hw,lcdkit-panel-vr-support = <0>;
		hw,lcdkit-panel-current-detect-support = <0>;
		hw,lcdkit-panel-lv-detect-support = <0>;
		hw,lcdkit-panel-orientation = <1>;
		hw,lcdkit-panel-bpp = <0>;
		hw,lcdkit-panel-bgrfmt = <0>;
		hw,lcdkit-panel-bl-type = <4>;
		hw,lcdkit-panel-blmin = <75>;
		hw,lcdkit-panel-blmax = <9960>;
		hw,lcdkit-panel-bl-def = <4000>;
		hw,lcdkit-panel-bl-maxnit = <530>;
		hw,lcdkit-panel-getblmaxnit-type = <0>;
		hw,lcdkit-panel-cmd-type = <32>;
		hw,lcdkit-panel-dsi1-snd-cmd-panel-support = <1>;
		hw,lcdkit-panel-ifbctype = <0>;
		hw,lcdkit-panel-frc-enable = <0>;
		hw,lcdkit-panel-esd-skip-mipi-check = <1>;
		hw,lcdkit-panel-pxl-clk = <320>;
		hw,lcdkit-panel-pxl-clk-div = <2>;
		hw,lcdkit-panel-tp-resume-nosync = <0>;
		hw,lcdkit-panel-display-on-in-backlight = <0>;
		hw,lcdkit-panel-display-on-new-seq = <0>;
		hw,lcdkit-panel-dirt-updt-support = <0>;
		hw,lcdkit-is-hostprocessing = <0>;
		hw,lcdkit-panel-dsi-upt-support = <1>;
		hw,lcdkit-panel-vsyn-ctr-type = <0>;
		hw,lcdkit-panel-bl-pwm-preci-type = <1>;
		hw,lcdkit-panel-bl-ic-ctrl-type = <7>;
		hw,lcdkit-panel-bl-pwm-out-div-value = <4>;
		hw,lcdkit-panel-fps-updt-only = <0>;
		hw,lcdkit-panel-step-support = <1>;
		hw,lcdkit-ldi-hsync-plr = <0>;
		hw,lcdkit-ldi-vsync-plr = <0>;
		hw,lcdkit-ldi-pixel-clk-plr = <0>;
		hw,lcdkit-ldi-data-en-plr = <0>;
		hw,lcdkit-ldi-dpi-a-overlap-size = <0>;
		hw,lcdkit-ldi-dpi-b-overlap-size = <0>;
		hw,lcdkit-sbl-stren-limit = <128>;
		hw,lcdkit-sbl-cal-a = <60>;
		hw,lcdkit-sbl-cal-b = <95>;
		hw,lcdkit-sbl-cal-c = <5>;
		hw,lcdkit-sbl-cal-d = <1>;
		hw,lcdkit-sbl-tf-ctl = <5>;
		hw,lcdkit-sbl-bl-min = <480>;
		hw,lcdkit-sbl-bl-max = <4096>;
		hw,lcdkit-sbl-bl-scale = <0xff>;
		hw,lcdkit-sbl-am-light-min = <14>;
		hw,lcdkit-sbl-filter-a = <1738>;
		hw,lcdkit-sbl-filter-b = <6>;
		hw,lcdkit-sbl-logo-left = <0>;
		hw,lcdkit-sbl-logo-top = <0>;
		hw,lcdkit-sbl-variance-intensity-space = <145>;
		hw,lcdkit-sbl-slope-max = <54>;
		hw,lcdkit-sbl-slope-min = <160>;
		hw,lcdkit-mipi-lane-nums = <3>;
		hw,lcdkit-mipi-color-mode = <5>;
		hw,lcdkit-mipi-vc = <0>;
		hw,lcdkit-mipi-dsi-bit-clk = <475>;
		hw,lcdkit-mipi-burst-mode = <2>;
		hw,lcdkit-mipi-max-esc-clk = <10>;
		hw,lcdkit-mipi-dsi-bit-clk-val-a = <493>;
		hw,lcdkit-mipi-dsi-bit-clk-val-b = <480>;
		hw,lcdkit-mipi-dsi-bit-clk-val-c = <475>;
		hw,lcdkit-mipi-dsi-bit-clk-val-d = <0>;
		hw,lcdkit-mipi-dsi-bit-clk-val-e = <0>;
		hw,lcdkit-mipi-dsi-bit-clk-upt = <475>;
		hw,lcdkit-mipi-rg-vcm-adjust = <0>;
		hw,lcdkit-mipi-non-continue-enable = <1>;
		hw,lcdkit-mipi-clk-post-adjust = <215>;
		hw,lcdkit-mipi-clk-pre-adjust = <0>;
		hw,lcdkit-mipi-clk-t-hs-prepare-adjust = <0>;
		hw,lcdkit-mipi-clk-t-lpx-adjust = <0>;
		hw,lcdkit-mipi-clk-t-hs-trail-adjust = <0>;
		hw,lcdkit-mipi-clk-t-hs-exit-adjust = <0>;
		hw,lcdkit-mipi-clk-t-hs-zero-adjust = <0>;
		hw,lcdkit-mipi-hs-wr-to-time = <0>;
		hw,lcdkit-dirt-left-align = <2>;
		hw,lcdkit-dirt-right-align = <2>;
		hw,lcdkit-dirt-top-align = <2>;
		hw,lcdkit-dirt-bott-align = <2>;
		hw,lcdkit-dirt-width-align = <2>;
		hw,lcdkit-dirt-height-align = <2>;
		hw,lcdkit-dirt-width-min = <2>;
		hw,lcdkit-dirt-height-min = <2>;
		hw,lcdkit-dirt-top-start = <0xffff>;
		hw,lcdkit-dirt-bott-start = <0xffff>;
		hw,lcdkit-gpios = <&gpio4 5 0>,<&gpio7 1 0>,<&gpio15 5 0>,<&gpio5 0 0>,<&gpio5 6 0>,<&gpio8 3 0>;
		lcdanalog-vcc-supply = <&ldo17>;
		pinctrl-0 = <&gpio037_pmx_func &gpio125_pmx_func &gpio040_pmx_func &gpio046_pmx_func &gpio057_pmx_func &gpio067_pmx_func &gpio037_cfg_func &gpio125_cfg_func &gpio040_cfg_func &gpio046_cfg_func &gpio057_cfg_func &gpio067_cfg_func>;
		pinctrl-1 = <&gpio037_pmx_idle &gpio125_pmx_idle &gpio040_pmx_idle &gpio046_pmx_idle &gpio057_pmx_idle &gpio067_pmx_idle &gpio037_cfg_idle &gpio125_cfg_idle &gpio040_cfg_idle &gpio046_cfg_idle &gpio057_cfg_idle &gpio067_cfg_idle>;
		pinctrl-names = "default","idle";
		status = "disabled";
		hw,lcdkit-sbl-support = <1>;
		hw,lcdkit-gamma-support = <1>;
		hw,lcdkit-gmp-support = <1>;
		hw,lcdkit-colormode-support = <1>;
		hw,lcdkit-color-temp-support = <1>;
		hw,lcdkit-color-temp-rectify-support = <0>;
		hw,lcdkit-comform-mode-support = <1>;
		hw,lcdkit-cinema-mode-support = <0>;
		hw,lcdkit-prefix-sharp-two-d-support = <1>;
		hw,lcdkit-xcc-support = <1>;
		hw,lcdkit-prefix-ce-support = <0>;
		hw,lcdkit-prefix-sharp-one-d-support = <0>;
		hw,lcdkit-acm-support = <1>;
		hw,lcdkit-smart-color-mode-support = <0>;
		hw,lcdkit-acm-ce-support = <0>;
		hw,lcdkit-r_hh0 = <0x7f>;
		hw,lcdkit-r_lh0 = <0x0>;
		hw,lcdkit-r_hh1 = <0xff>;
		hw,lcdkit-r_lh1 = <0x80>;
		hw,lcdkit-r_hh2 = <0x17f>;
		hw,lcdkit-r_lh2 = <0x100>;
		hw,lcdkit-r_hh3 = <0x1ff>;
		hw,lcdkit-r_lh3 = <0x180>;
		hw,lcdkit-r_hh4 = <0x27f>;
		hw,lcdkit-r_lh4 = <0x200>;
		hw,lcdkit-r_hh5 = <0x2ff>;
		hw,lcdkit-r_lh5 = <0x280>;
		hw,lcdkit-r_hh6 = <0x37f>;
		hw,lcdkit-r_lh6 = <0x300>;
		hw,lcdkit-r_video_hh0 = <0x7f>;
		hw,lcdkit-r_video_lh0 = <0x0>;
		hw,lcdkit-r_video_hh1 = <0x101>;
		hw,lcdkit-r_video_lh1 = <0x80>;
		hw,lcdkit-r_video_hh2 = <0x177>;
		hw,lcdkit-r_video_lh2 = <0x102>;
		hw,lcdkit-r_video_hh3 = <0x1ed>;
		hw,lcdkit-r_video_lh3 = <0x178>;
		hw,lcdkit-r_video_hh4 = <0x26f>;
		hw,lcdkit-r_video_lh4 = <0x1ee>;
		hw,lcdkit-r_video_hh5 = <0x2ff>;
		hw,lcdkit-r_video_lh5 = <0x270>;
		hw,lcdkit-r_video_hh6 = <0x37c>;
		hw,lcdkit-r_video_lh6 = <0x300>;
		hw,lcdkit-color-temp-rectify-r = <32768>;
		hw,lcdkit-color-temp-rectify-g = <32768>;
		hw,lcdkit-color-temp-rectify-b = <32768>;
		hw,lcdkit-hiace-support = <1>;
		hw,lcdkit-panel-effect-support = <0>;
		hw,lcdkit-arsr1p-sharpness-support = <1>;
		hw,lcdkit-iglobal-hist-black-pos = <16>;
		hw,lcdkit-iglobal-hist-white-pos = <240>;
		hw,lcdkit-iglobal-hist-black-weight = <51>;
		hw,lcdkit-iglobal-hist-white-weight = <51>;
		hw,lcdkit-iglobal-hist-zero-cut-ratio = <486>;
		hw,lcdkit-iglobal-hist-slope-cut-ratio = <410>;
		hw,lcdkit-imax-lcd-luminance = <500>;
		hw,lcdkit-imin-lcd-luminance = <3>;
		hw,lcdkit-cfg-name = "/product/etc/display/effect/algorithm/hdr_engine.xml";
		hw,lcdkit-effect-support-mode = <65537>;
		hw,lcdkit-delay-af-rst-off = <5>;
		hw,lcdkit-h-back-porch = <80>;
		hw,lcdkit-h-front-porch = <116>;
		hw,lcdkit-h-pulse-width = <4>;
		hw,lcdkit-v-back-porch = <16>;
		hw,lcdkit-v-pulse-width = <80>;
		hw,lcdkit-v-front-porch = <16>;
		hw,lcdkit-h-sync-skew = <0>;
		hw,lcdkit-non-check-ldi-porch = <0>;
		hw,lcdkit-dpi01-set-change = <1>;
		hw,lcdkit-lcd-type = <0>;
		hw,lcdkit-panel-pt-test-support = <0>;
		hw,lcdkit-panel-hkadc-support = <0>;
		hw,lcdkit-bias-power-ctrl-mode = <2>;
		hw,lcdkit-iovcc-power-ctrl-mode = <2>;
		hw,lcdkit-vci-power-ctrl-mode = <0>;
		hw,lcdkit-id0-gpio = <46>;
		hw,lcdkit-id1-gpio = <57>;
		hw,lcdkit-reset-gpio = <40>;
		hw,lcdkit-te-gpio = <23>;
		hw,lcdkit-vsp-gpio = <125>;
		hw,lcdkit-vsn-gpio = <37>;
		hw,lcdkit-iovcc-gpio = <67>;
		hw,lcdkit-vci-gpio = <0>;
		hw,lcdkit-iovcc-on-is-need-reset = <1>;
		hw,lcdkit-vsn-on-is-need-reset = <0>;
		hw,lcdkit-lcdanalog-vcc = <3300000>;
		hw,lcdkit-lcdio-vcc = <1800000>;
		hw,lcdkit-lcd-bias = <5400000>;
		hw,lcdkit-lcd-vsp = <6000000>;
		hw,lcdkit-lcd-vsn = <5900000>;
		hw,lcdkit-lcd-rst-first-high = <1>;
		hw,lcdkit-lcd-rst-low = <2>;
		hw,lcdkit-lcd-rst-second-high = <22>;
		hw,lcdkit-delay-af-vci-on = <0>;
		hw,lcdkit-delay-af-iovcc-on = <16>;
		hw,lcdkit-delay-af-bias-on = <0>;
		hw,lcdkit-delay-af-vsp-on = <2>;
		hw,lcdkit-delay-af-vsn-on = <2>;
		hw,lcdkit-delay-af-display-on = <120>;
		hw,lcdkit-delay-af-display-off = <0>;
		hw,lcdkit-delay-af-display-off-second = <120>;
		hw,lcdkit-delay-af-lp11 = <12>;
		hw,lcdkit-delay-af-tp-reset = <0>;
		hw,lcdkit-delay-af-vsn-off = <2>;
		hw,lcdkit-delay-af-vsp-off = <2>;
		hw,lcdkit-delay-af-bias-off = <0>;
		hw,lcdkit-delay-af-iovcc-off = <0>;
		hw,lcdkit-delay-af-vci-off = <0>;
    };
};