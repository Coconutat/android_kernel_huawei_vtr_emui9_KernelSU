/* DO NOT EDIT - Automatically generated by python */
/ {
		sunwodaatl_4000_39k_4400:sunwodaatl_4000_39k_4400 {
			fcc = <4000>;
			default_rbatt_mohm = <100>;
			identify_type = "id_volt";
			id_identify_min = <1235>;
			id_identify_max = <1759>;
			id_voltage_min = <1420>;
			id_voltage_max = <1562>;
			vbat_max = <4400>;
			temp_para = 
						"-32767","0","-1","0","4100","0",
						"0","5","-1","400","4400","0",
						"5","10","-1","1200","4400","3",
						"10","45","-1","-1","4400","3",
						"45","50","-1","1400","4100","3",
						"50","32767","-1","0","4100","0";
			vbat_para = 
						"-32767","3400","-1","820","0",
						"3400","32767","-1","-1","0";
			segment_para = 
						"-32767","4150","4000","4208","50",
						"4150","4450","2800","4400","0";
			batt_brand = "sunwodaatl";
			fcc_temp = <4060 4065 4065 4085 4075 4042>;
			fcc_sf_x = <0 100 200 300 400 500 600 700 800 1000 1500>;
			fcc_sf_y = <100 96 94 92 90 88 87 84 81 75 50>;
			fcc_sf_cols = <11>;
			pc_sf_rows = <1>;
			pc_sf_cols = <1>;
			pc_sf_row_entries = <0>;
			pc_sf_percent = <100>;
			pc_sf_sf = <100>;
			rbatt_sf_rows = <28>;
			rbatt_sf_cols = <6>;
			rbatt_sf_percent = <100 95 90 85 80 75 70 65 60 55 50 45 40 35 30 25 20 15 10 9 8 7 6 5 4 3 2 1>;
			rbatt_sf_sf = <
			               1885 1107 508 129 99 89
			               1883 1106 508 129 99 89
			               1740 1081 509 129 100 90
			               1620 1053 503 131 102 91
			               1576 1012 502 135 105 93
			               1505 1026 521 143 108 94
			               1378 923 509 152 113 97
			               1364 887 452 161 119 101
			               1336 875 433 163 126 106
			               1332 861 410 130 106 93
			               1363 864 407 124 99 90
			               1399 910 409 127 100 91
			               1444 959 431 131 105 93
			               1496 1017 466 135 109 98
			               1561 1083 514 136 110 99
			               1643 1154 568 132 101 92
			               1744 1241 628 129 100 91
			               1881 1343 717 132 101 92
			               2860 1360 621 127 102 95
			               3117 1484 654 130 102 97
			               3390 1645 720 132 104 97
			               3685 1827 794 133 104 95
			               4006 2039 879 134 105 98
			               4393 2213 979 133 102 95
			               4866 2449 1079 139 104 94
			               5449 2798 1228 161 104 95
			               6283 3293 1480 249 118 97
			               7659 4209 1996 441 186 117
			              >;
			pc_temp_ocv_rows = <29>;
			pc_temp_ocv_cols = <6>;
			pc_temp_ocv_percent = <100 95 90 85 80 75 70 65 60 55 50 45 40 35 30 25 20 15 10 9 8 7 6 5 4 3 2 1>;
			pc_temp_ocv_ocv = <
			                   4389 4388 4384 4377 4372 4366
			                   4286 4301 4308 4315 4311 4306
			                   4212 4230 4246 4256 4252 4248
			                   4146 4172 4187 4198 4195 4191
			                   4101 4113 4132 4141 4138 4135
			                   4042 4072 4086 4088 4084 4081
			                   3958 3991 4028 4037 4035 4032
			                   3916 3937 3961 3987 3987 3987
			                   3874 3895 3917 3942 3943 3943
			                   3841 3857 3873 3888 3889 3888
			                   3820 3825 3840 3853 3854 3854
			                   3803 3808 3813 3828 3829 3828
			                   3790 3795 3797 3808 3809 3808
			                   3778 3785 3785 3790 3791 3790
			                   3765 3774 3776 3775 3774 3771
			                   3752 3758 3766 3759 3751 3741
			                   3736 3740 3747 3738 3730 3718
			                   3718 3719 3719 3712 3706 3694
			                   3693 3695 3690 3690 3683 3672
			                   3685 3689 3687 3688 3682 3671
			                   3676 3685 3684 3686 3680 3669
			                   3666 3681 3681 3683 3678 3666
			                   3652 3675 3675 3676 3672 3661
			                   3630 3657 3660 3655 3655 3642
			                   3597 3623 3626 3614 3616 3604
			                   3549 3572 3573 3559 3563 3554
			                   3481 3500 3500 3491 3495 3487
			                   3384 3403 3399 3396 3397 3389
			                   3200 3200 3200 3200 3200 3200
			                  >;
		};
};
