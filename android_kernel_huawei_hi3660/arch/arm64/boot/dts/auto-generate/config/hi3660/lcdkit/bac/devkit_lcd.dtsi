/*---------------------------------------------------------------------------
 * This file is autogenerated file using huawei LCD parser. Please do not edit it.
 * Update input XML file to add a new entry or update variable in this file
 * Parser location: vendor/huawei/chipset_common/devkit/lcdkit/tools 
 *---------------------------------------------------------------------------*/


/include/ "bac_auo_nt36672_5p5_1080p_video.dtsi"
/include/ "bac_tianma_td4310_5p5_1080p_video.dtsi"