/* Copyright (c) 2013, The Linux Foundation. All rights reserved.
 *
 * This program is free software; you can redistribute it and/or modify
 * it under the terms of the GNU General Public License version 2 and
 * only version 2 as published by the Free Software Foundation.
 *
 * This program is distributed in the hope that it will be useful,
 * but WITHOUT ANY WARRANTY; without even the implied warranty of
 * MERCHANTABILITY or FITNESS FOR A PARTICULAR PURPOSE.  See the
 * GNU General Public License for more details.
 */

/*-------------------------------------------------------------------------
 * This file is autogenerated file using gcdb parser. Please do not edit it.
 * Update input XML file to add a new entry or update variable in this file
 * VERSION = 1.1
 *-----------------------------------------------------------------------*/
/ {
	dsi_hwi_vn2_boe_td4310_5p99_1080p_video: lcdkit_hwi_vn2_boe_td4310_5p99_1080p_video {
		compatible = "boe_td4310_5p99_1080p_video";
		hw,lcdkit-panel-name = "BOE_TD4310 5.99' VIDEO TFT 2160 x 1080";
		hw,lcdkit-panel-type = <0x01>;
		hw,lcdkit-panel-xres = <1080>;
		hw,lcdkit-panel-yres = <2160>;
		hw,lcdkit-panel-width = <68>;
		hw,lcdkit-panel-height = <136>;
		hw,lcdkit-panel-on-command = <0x05 0x01 0x00 0x00 0x50 0x01 0x02 0x11 0x00
		0x29 0x01 0x00 0x00 0x0A 0x00 0x02 0xB0 0x04
		0x29 0x01 0x00 0x00 0x0A 0x00 0x02 0xD6 0x01
		0x29 0x01 0x00 0x00 0x23 0x00 0x1A 0xCE 0x50 0x40 0x60 0x78 0x87 0x94 0x9E 0xAB 0xB8 0xC4 0xCD 0xD6 0xDE 0xE5 0xEC 0xF3 0xFF 0x00 0xE3 0x04 0x04 0x42 0x04 0x69 0x5A
		0x29 0x01 0x00 0x00 0x16 0x00 0x08 0xB8 0x2B 0x4D 0x03 0x00 0x02 0x00 0x00
		0x29 0x01 0x00 0x00 0x16 0x00 0x08 0xB9 0x6F 0x3D 0x28 0x3C 0x14 0xC8 0xC8
		0x29 0x01 0x00 0x00 0x16 0x00 0x08 0xBA 0x91 0x53 0x02 0x00 0x0F 0x00 0x00
		0x29 0x01 0x00 0x00 0x19 0x00 0x0A 0xF9 0x64 0x3F 0xE0 0xBE 0x00 0x8D 0xBF 0x80 0x00
		0x29 0x01 0x00 0x00 0x0a 0x00 0x06 0xB6 0x31 0x3b 0x81 0x10 0x00
		0x29 0x01 0x00 0x00 0x0a 0x00 0x03 0xE7 0x82 0x00
		0x29 0x01 0x00 0x00 0x64 0x00 0x31 0xC1 0x04 0x40 0x10 0xFF 0x5F 0x6B 0x89 0xB0 0x6A 0x85 0x0F 0xA3 0xFC 0xFF 0xFF 0xFF 0x65 0x84 0x1F 0x2C 0x65 0xCB 0xB0 0xF6 0xFE 0x0F 0x10 0x10 0x10 0x10 0x10 0x10 0x10 0x10 0x40 0x02 0x22 0x02 0x06 0x0A 0x00 0x00 0x01 0x00 0x05 0x00 0x00 0x00
		0x29 0x01 0x00 0x00 0x64 0x00 0x1C 0xCB 0xFF 0xFF 0xFF 0xFF 0x0F 0x00 0x00 0x00 0x00 0x00 0x11 0xF0 0x00 0x0D 0x00 0x00 0x00 0x00 0x00 0x00 0x00 0x00 0x00 0x00 0x00 0x00 0x00
		0x29 0x01 0x00 0x00 0x0a 0x00 0x02 0xB0 0x03
		0x15 0x01 0x00 0x00 0x0a 0x00 0x02 0x51 0xFE
		0x15 0x01 0x00 0x00 0x0a 0x00 0x02 0x53 0x24
		0x15 0x01 0x00 0x00 0x0a 0x00 0x02 0x55 0x81
		0x05 0x01 0x00 0x00 0x01 0x01 0x02 0x29 0x00>;
		hw,lcdkit-panel-on-command-state = "dsi_lp_mode";
		hw,lcdkit-panel-off-command = <0x05 0x01 0x00 0x00 0x14 0x01 0x02 0x28 0x00
			0x29 0x01 0x00 0x00 0x0a 0x00 0x02 0xB0 0x00
			0x29 0x01 0x00 0x00 0x64 0x00 0x31 0xC1 0x04 0x40 0x00 0xFF 0xFF 0xFF 0xFF 0xFF 0xEA 0xFF 0xFF 0xFF 0xFF 0xFF 0xFF 0xFF 0xFF 0xFF 0xFF 0x7F 0xF5 0xFF 0xFF 0xFF 0xFF 0x0F 0x00 0x00 0x00 0x00 0x00 0x00 0x00 0x00 0x40 0x02 0x22 0x02 0x06 0x0A 0x00 0x00 0x01 0x00 0x01 0x00 0x00 0x00
			0x29 0x01 0x00 0x00 0x64 0x00 0x1C 0xCB 0xFF 0xFF 0xFF 0xFF 0x0F 0xFC 0x76 0xE0 0xF6 0x03 0x11 0xF0 0x00 0x0D 0x00 0x00 0x00 0x00 0x00 0x00 0x00 0x00 0x00 0x00 0x00 0x00 0x00
			0x29 0x01 0x00 0x00 0x0a 0x00 0x02 0xB0 0x03
			0x05 0x01 0x00 0x00 0x78 0x01 0x02 0x10 0x00>;
		hw,lcdkit-panel-off-command-state = "dsi_lp_mode";
		hw,lcdkit-panel-cabc-off-command = <0x15 0x01 0x00 0x00 0x0a 0x00 0x02 0x55 0x80>;
		hw,lcdkit-panel-cabc-off-command-state = "dsi_lp_mode";
		hw,lcdkit-panel-cabc-ui-command = <0x15 0x01 0x00 0x00 0x0a 0x00 0x02 0x55 0x81
			0x15 0x01 0x00 0x00 0x0a 0x00 0x02 0x53 0x24>;
		hw,lcdkit-panel-cabc-ui-command-state = "dsi_lp_mode";
		hw,lcdkit-panel-cabc-still-command = <0x15 0x01 0x00 0x00 0x0a 0x00 0x02 0x55 0x82
			0x15 0x01 0x00 0x00 0x0a 0x00 0x02 0x53 0x24>;
		hw,lcdkit-panel-cabc-still-command-state = "dsi_lp_mode";
		hw,lcdkit-panel-cabc-moving-command = <0x15 0x01 0x00 0x00 0x0a 0x00 0x02 0x55 0x83
			0x15 0x01 0x00 0x00 0x0a 0x00 0x02 0x53 0x2C>;
		hw,lcdkit-panel-cabc-moving-command-state = "dsi_lp_mode";
		hw,lcdkit-panel-cabc-support = <1>;
		hw,lcdkit-panel-cabc-switch-support = <1>;
		hw,lcdkit-panel-display-on-effect-command = <0x15 0x01 0x00 0x00 0x0a 0x00 0x02 0x51 0xFE>;
		hw,lcdkit-panel-display-on-effect-support = <0>;
		hw,lcdkit-panel-ce-support = <0>;
		hw,lcdkit-panel-dot-inversion-command = <0x29 0x01 0x00 0x00 0x00 0x00 0x02 0xFF 0x24
					0x29 0x01 0x00 0x00 0x00 0x00 0x02 0xFB 0x01
					0x29 0x01 0x00 0x00 0x00 0x00 0x02 0x9B 0x00
					0x29 0x01 0x00 0x00 0x00 0x00 0x02 0xFF 0x10
					0x29 0x01 0x00 0x00 0x00 0x00 0x02 0xFB 0x01>;
		hw,lcdkit-panel-dot-inversion-command-state = "dsi_lp_mode";
		hw,lcdkit-panel-column-inversion-command = <0x29 0x01 0x00 0x00 0x00 0x00 0x02 0xFF 0x24
					0x29 0x01 0x00 0x00 0x00 0x00 0x02 0xFB 0x01
					0x29 0x01 0x00 0x00 0x00 0x00 0x02 0x9B 0x0F
					0x29 0x01 0x00 0x00 0x00 0x00 0x02 0xFF 0x10
					0x29 0x01 0x00 0x00 0x00 0x00 0x02 0xFB 0x01>;
		hw,lcdkit-panel-column-inversion-command-state = "dsi_lp_mode";
		hw,lcdkit-panel-inversion-support = <1>;
		hw,lcdkit-panel-scan-support = <0>;
		hw,lcdkit-panel-display-region-support = <0>;
		hw,lcdkit-panel-checksum-support = <0>;
		hw,lcdkit-panel-esd-reg-command = <0x06 0x01 0x00 0x00 0x0a 0x00 0x01 0x0a>;
		hw,lcdkit-panel-esd-reg-command-state = "dsi_lp_mode";
		hw,lcdkit-panel-esd-value = <0x1c>;
		hw,lcdkit-panel-esd-support = <1>;
		hw,lcdkit-panel-check-reg-command = <0x06 0x01 0x00 0x00 0x0a 0x00 0x01 0x0a>;
		hw,lcdkit-panel-check-reg-value = <0x1c>;
		hw,lcdkit-panel-check-reg-command-state = "dsi_lp_mode";
		hw,lcdkit-panel-check-reg-support = <1>;
		hw,lcdkit-panel-check-on-value = <0x0a>;
		hw,lcdkit-panel-check-reg-expect-value = <0x0c>;
		hw,lcdkit-panel-check-reg-mask-value = <0xff>;
		hw,lcdkit-panel-bl-maxnit-command = <0x06 0x01 0x00 0x00 0x0a 0x00 0x01 0xdb>;
		hw,lcdkit-panel-bl-maxnit-command-state = <>;
		hw,lcdkit-panel-bl-befreadconfig = <0x23 0x01 0x00 0x00 0x0a 0x00 0x02 0xb0 0x00>;
		hw,lcdkit-panel-bl-befreadconfig-state = <>;
		hw,lcdkit-panel-bl-aftreadconfig = <0x23 0x01 0x00 0x00 0x0a 0x00 0x02 0xb0 0x03>;
		hw,lcdkit-panel-bl-aftreadconfig-state = <>;
		hw,lcdkit-panel-dynamic-gamma-support = <0>;
		hw,lcdkit-panel-mipi-detect-command = <0x06 0x01 0x00 0x00 0x0a 0x00 0x01 0x0e
			0x06 0x01 0x00 0x00 0x0a 0x00 0x01 0x05>;
		hw,lcdkit-panel-mipi-detect-value = <0x00 0x00>;
		hw,lcdkit-panel-mipi-detect-mask = <0xFF 0xFF>;
		hw,lcdkit-panel-mipi-detect-command-state = "dsi_lp_mode";
		hw,lcdkit-panel-mipi-detect-support = <1>;
		hw,lcdkit-panel-dynamic-sram-check-support = <0>;
		hw,lcdkit-panel-fps-updt-support = <0>;
		hw,lcdkit-panel-fps-func-switch = <0>;
		hw,lcdkit-panel-chip-esd-disable = <0>;
		hw,lcdkit-panel-check-reg-on-support = <1>;
		hw,lcdkit-panel-fps-tscall-support = <0>;
		hw,lcdkit-panel-dis-on-cmds-delay-margin-support = <0>;
		hw,lcdkit-panel-snd-cmd-before-frame-support = <0>;
		hw,lcdkit-panel-ts-resume-ctrl-mode = <0>;
		hw,lcdkit-panel-dis-on-cmds-delay-margin-time = <0>;
		hw,lcdkit-panel-lptohs-mipi-check-support = <0>;
		hw,lcdkit-panel-acl-ctrl-support = <0>;
		hw,lcdkit-panel-hbm-ctrl-support = <0>;
		hw,lcdkit-panel-vr-support = <0>;
		hw,lcdkit-panel-current-detect-support = <0>;
		hw,lcdkit-panel-lv-detect-support = <0>;
		hw,lcdkit-panel-orientation = <1>;
		hw,lcdkit-panel-bpp = <0>;
		hw,lcdkit-panel-bgrfmt = <0>;
		hw,lcdkit-panel-bl-type = <4>;
		hw,lcdkit-panel-blmin = <25>;
		hw,lcdkit-panel-blmax = <9790>;
		hw,lcdkit-panel-bl-def = <4000>;
		hw,lcdkit-panel-bl-maxnit = <460>;
		hw,lcdkit-panel-getblmaxnit-type = <1>;
		hw,lcdkit-panel-cmd-type = <8>;
		hw,lcdkit-panel-dsi1-snd-cmd-panel-support = <0>;
		hw,lcdkit-panel-ifbctype = <4>;
		hw,lcdkit-panel-frc-enable = <0>;
		hw,lcdkit-panel-esd-skip-mipi-check = <1>;
		hw,lcdkit-panel-pxl-clk = <160>;
		hw,lcdkit-panel-pxl-clk-div = <2>;
		hw,lcdkit-panel-tp-resume-nosync = <1>;
		hw,lcdkit-panel-display-on-in-backlight = <0>;
		hw,lcdkit-panel-display-on-new-seq = <0>;
		hw,lcdkit-panel-dirt-updt-support = <0>;
		hw,lcdkit-is-hostprocessing = <0>;
		hw,lcdkit-panel-dsi-upt-support = <0>;
		hw,lcdkit-panel-vsyn-ctr-type = <0>;
		hw,lcdkit-panel-bl-pwm-preci-type = <2>;
		hw,lcdkit-panel-bl-ic-ctrl-type = <8>;
		hw,lcdkit-panel-fps-updt-only = <0>;
		hw,lcdkit-panel-step-support = <1>;
		hw,lcdkit-ldi-hsync-plr = <0>;
		hw,lcdkit-ldi-vsync-plr = <0>;
		hw,lcdkit-ldi-pixel-clk-plr = <0>;
		hw,lcdkit-ldi-data-en-plr = <0>;
		hw,lcdkit-ldi-dpi-a-overlap-size = <0>;
		hw,lcdkit-ldi-dpi-b-overlap-size = <0>;
		hw,lcdkit-sbl-stren-limit = <128>;
		hw,lcdkit-sbl-cal-a = <60>;
		hw,lcdkit-sbl-cal-b = <95>;
		hw,lcdkit-sbl-cal-c = <5>;
		hw,lcdkit-sbl-cal-d = <1>;
		hw,lcdkit-sbl-tf-ctl = <5>;
		hw,lcdkit-sbl-bl-min = <480>;
		hw,lcdkit-sbl-bl-max = <4096>;
		hw,lcdkit-sbl-bl-scale = <0xff>;
		hw,lcdkit-sbl-am-light-min = <14>;
		hw,lcdkit-sbl-filter-a = <1738>;
		hw,lcdkit-sbl-filter-b = <6>;
		hw,lcdkit-sbl-logo-left = <0>;
		hw,lcdkit-sbl-logo-top = <0>;
		hw,lcdkit-sbl-variance-intensity-space = <145>;
		hw,lcdkit-sbl-slope-max = <54>;
		hw,lcdkit-sbl-slope-min = <160>;
		hw,lcdkit-mipi-lane-nums = <3>;
		hw,lcdkit-mipi-color-mode = <5>;
		hw,lcdkit-mipi-vc = <0>;
		hw,lcdkit-mipi-dsi-bit-clk = <275>;
		hw,lcdkit-mipi-burst-mode = <2>;
		hw,lcdkit-mipi-max-esc-clk = <10>;
		hw,lcdkit-mipi-dsi-bit-clk-val-a = <471>;
		hw,lcdkit-mipi-dsi-bit-clk-val-b = <500>;
		hw,lcdkit-mipi-dsi-bit-clk-val-c = <490>;
		hw,lcdkit-mipi-dsi-bit-clk-val-d = <500>;
		hw,lcdkit-mipi-dsi-bit-clk-val-e = <0>;
		hw,lcdkit-mipi-dsi-bit-clk-upt = <275>;
		hw,lcdkit-mipi-rg-vcm-adjust = <0>;
		hw,lcdkit-mipi-non-continue-enable = <0>;
		hw,lcdkit-mipi-clk-post-adjust = <215>;
		hw,lcdkit-mipi-lp11_flag = <1>;
		hw,lcdkit-mipi-clk-pre-adjust = <0>;
		hw,lcdkit-mipi-clk-t-hs-prepare-adjust = <0>;
		hw,lcdkit-mipi-clk-t-lpx-adjust = <0>;
		hw,lcdkit-mipi-clk-t-hs-trail-adjust = <0>;
		hw,lcdkit-mipi-clk-t-hs-exit-adjust = <0>;
		hw,lcdkit-mipi-clk-t-hs-zero-adjust = <0>;
		hw,lcdkit-mipi-hs-wr-to-time = <0>;
		hw,lcdkit-dirt-left-align = <2>;
		hw,lcdkit-dirt-right-align = <2>;
		hw,lcdkit-dirt-top-align = <2>;
		hw,lcdkit-dirt-bott-align = <2>;
		hw,lcdkit-dirt-width-align = <2>;
		hw,lcdkit-dirt-height-align = <2>;
		hw,lcdkit-dirt-width-min = <2>;
		hw,lcdkit-dirt-height-min = <2>;
		hw,lcdkit-dirt-top-start = <0xffff>;
		hw,lcdkit-dirt-bott-start = <0xffff>;
		hw,lcdkit-gpios = <&gpio4 5 0>,<&gpio6 3 0>,<&gpio15 5 0>,<&gpio5 0 0>,<&gpio5 6 0>,<&gpio6 2 0>,<&gpio8 3 0>;
		lcdio-vcc-supply = <&ldo4>;
		lcdanalog-vcc-supply = <&ldo17>;
		pinctrl-0 = <&gpio037_pmx_func &gpio125_pmx_func &gpio040_pmx_func &gpio046_pmx_func &gpio050_pmx_func &gpio037_cfg_func &gpio125_cfg_func &gpio040_cfg_func &gpio046_cfg_func &gpio050_cfg_func>;
		pinctrl-1 = <&gpio037_pmx_idle &gpio125_pmx_idle &gpio040_pmx_idle &gpio046_pmx_idle &gpio050_pmx_idle &gpio037_cfg_idle &gpio125_cfg_idle &gpio040_cfg_idle &gpio046_cfg_idle &gpio050_cfg_idle>;
		pinctrl-names = "default","idle";
		status = "disabled";
		hw,lcdkit-sbl-support = <0>;
		hw,lcdkit-gamma-support = <1>;
		hw,lcdkit-gmp-support = <0>;
		hw,lcdkit-color-temp-support = <1>;
		hw,lcdkit-color-temp-rectify-support = <1>;
		hw,lcdkit-comform-mode-support = <1>;
		hw,lcdkit-cinema-mode-support = <0>;
		hw,lcdkit-prefix-sharp-two-d-support = <1>;
		hw,lcdkit-xcc-support = <1>;
		hw,lcdkit-prefix-ce-support = <0>;
		hw,lcdkit-prefix-sharp-one-d-support = <0>;
		hw,lcdkit-acm-support = <1>;
		hw,lcdkit-smart-color-mode-support = <0>;
		hw,lcdkit-acm-ce-support = <0>;
		hw,lcdkit-r_hh0 = <0x80>;
		hw,lcdkit-r_lh0 = <0x0>;
		hw,lcdkit-r_hh1 = <0x11f>;
		hw,lcdkit-r_lh1 = <0x81>;
		hw,lcdkit-r_hh2 = <0x17f>;
		hw,lcdkit-r_lh2 = <0x120>;
		hw,lcdkit-r_hh3 = <0x1df>;
		hw,lcdkit-r_lh3 = <0x180>;
		hw,lcdkit-r_hh4 = <0x281>;
		hw,lcdkit-r_lh4 = <0x1e0>;
		hw,lcdkit-r_hh5 = <0x2ff>;
		hw,lcdkit-r_lh5 = <0x282>;
		hw,lcdkit-r_hh6 = <0x380>;
		hw,lcdkit-r_lh6 = <0x300>;
		hw,lcdkit-r_video_hh0 = <0x7f>;
		hw,lcdkit-r_video_lh0 = <0xe>;
		hw,lcdkit-r_video_hh1 = <0xbe>;
		hw,lcdkit-r_video_lh1 = <0x80>;
		hw,lcdkit-r_video_hh2 = <0xff>;
		hw,lcdkit-r_video_lh2 = <0xbf>;
		hw,lcdkit-r_video_hh3 = <0x1c0>;
		hw,lcdkit-r_video_lh3 = <0x100>;
		hw,lcdkit-r_video_hh4 = <0x27f>;
		hw,lcdkit-r_video_lh4 = <0x1c1>;
		hw,lcdkit-r_video_hh5 = <0x323>;
		hw,lcdkit-r_video_lh5 = <0x280>;
		hw,lcdkit-r_video_hh6 = <0x381>;
		hw,lcdkit-r_video_lh6 = <0x324>;
		hw,lcdkit-color-temp-rectify-r = <32768>;
		hw,lcdkit-color-temp-rectify-g = <32768>;
		hw,lcdkit-color-temp-rectify-b = <32768>;
		hw,lcdkit-hiace-support = <1>;
		hw,lcdkit-panel-effect-support = <0>;
		hw,lcdkit-arsr1p-sharpness-support = <1>;
		hw,lcdkit-iglobal-hist-black-pos = <16>;
		hw,lcdkit-iglobal-hist-white-pos = <240>;
		hw,lcdkit-iglobal-hist-black-weight = <51>;
		hw,lcdkit-iglobal-hist-white-weight = <51>;
		hw,lcdkit-iglobal-hist-zero-cut-ratio = <486>;
		hw,lcdkit-iglobal-hist-slope-cut-ratio = <410>;
		hw,lcdkit-imax-lcd-luminance = <500>;
		hw,lcdkit-imin-lcd-luminance = <3>;
		hw,lcdkit-cfg-name = "/product/etc/display/effect/algorithm/hdr_engine.xml";
		hw,lcdkit-effect-support-mode = <65537>;
		hw,lcdkit-delay-af-rst-off = <5>;
		hw,lcdkit-h-back-porch = <16>;
		hw,lcdkit-h-front-porch = <40>;
		hw,lcdkit-h-pulse-width = <2>;
		hw,lcdkit-v-back-porch = <53>;
		hw,lcdkit-v-pulse-width = <10>;
		hw,lcdkit-v-front-porch = <4>;
		hw,lcdkit-h-sync-skew = <0>;
		hw,lcdkit-non-check-ldi-porch = <0>;
		hw,lcdkit-dpi01-set-change = <0>;
		hw,lcdkit-lcd-type = <2>;
		hw,lcdkit-panel-pt-test-support = <1>;
		hw,lcdkit-panel-hkadc-support = <0>;
		hw,lcdkit-bias-power-ctrl-mode = <4>;
		hw,lcdkit-bl-power-ctrl-mode = <0>;
		hw,lcdkit-bl-gpio-ctrl-mode = <0>;
		hw,lcdkit-bl-gpio-suspend-disable = <0>;
		hw,lcdkit-iovcc-power-ctrl-mode = <1>;
		hw,lcdkit-vci-power-ctrl-mode = <0>;
		hw,lcdkit-id0-gpio = <46>;
		hw,lcdkit-id1-gpio = <50>;
		hw,lcdkit-reset-gpio = <40>;
		hw,lcdkit-te-gpio = <23>;
		hw,lcdkit-vsp-gpio = <125>;
		hw,lcdkit-vsn-gpio = <37>;
		hw,lcdkit-iovcc-gpio = <0>;
		hw,lcdkit-vci-gpio = <0>;
		hw,lcdkit-iovcc-on-is-need-reset = <0>;
		hw,lcdkit-vsn-on-is-need-reset = <1>;
		hw,lcdkit-lcdanalog-vcc = <3300000>;
		hw,lcdkit-lcdio-vcc = <1850000>;
		hw,lcdkit-lcd-bias = <5400000>;
		hw,lcdkit-lcd-vsp = <5400000>;
		hw,lcdkit-lcd-vsn = <5400000>;
		hw,lcdkit-lcd-rst-first-high = <5>;
		hw,lcdkit-lcd-rst-low = <5>;
		hw,lcdkit-lcd-rst-second-high = <35>;
		hw,lcdkit-delay-af-vci-on = <0>;
		hw,lcdkit-delay-af-iovcc-on = <3>;
		hw,lcdkit-delay-af-bias-on = <0>;
		hw,lcdkit-delay-af-vsp-on = <5>;
		hw,lcdkit-delay-af-vsn-on = <5>;
		hw,lcdkit-delay-af-display-on = <0>;
		hw,lcdkit-delay-af-display-off = <0>;
		hw,lcdkit-delay-af-display-off-second = <0>;
		hw,lcdkit-delay-af-lp11 = <5>;
		hw,lcdkit-delay-af-tp-reset = <25>;
		hw,lcdkit-delay-af-vsn-off = <15>;
		hw,lcdkit-delay-af-vsp-off = <15>;
		hw,lcdkit-delay-af-bias-off = <0>;
		hw,lcdkit-delay-af-iovcc-off = <10>;
		hw,lcdkit-delay-af-vci-off = <0>;
		hw_tps65132,lcdkit-bias-type = <0x06>;
		hw_tps65132,lcdkit-bias-vpos-reg = <0x00>;
		hw_tps65132,lcdkit-bias-vneg-reg = <0x01>;
		hw_tps65132,lcdkit-bias-vpos-val = <0x0f>;
		hw_tps65132,lcdkit-bias-vneg-val = <0x0f>;
		hw_tps65132,lcdkit-bias-vpos-mask = <0x1f>;
		hw_tps65132,lcdkit-bias-vneg-mask = <0x1f>;
		hw_tps65132,lcdkit-bias-state-reg = <0x03>;
		hw_tps65132,lcdkit-bias-state-val = <0x43>;
		hw_tps65132,lcdkit-bias-state-mask = <0x43>;
		hw_rt4801h,lcdkit-bias-type = <0x0c>;
		hw_rt4801h,lcdkit-bias-vpos-reg = <0x00>;
		hw_rt4801h,lcdkit-bias-vneg-reg = <0x01>;
		hw_rt4801h,lcdkit-bias-vpos-val = <0x0f>;
		hw_rt4801h,lcdkit-bias-vneg-val = <0x0f>;
		hw_rt4801h,lcdkit-bias-vpos-mask = <0x1f>;
		hw_rt4801h,lcdkit-bias-vneg-mask = <0x1f>;
		hw_rt4801h,lcdkit-bias-state-reg = <0x03>;
		hw_rt4801h,lcdkit-bias-state-val = <0x03>;
		hw_rt4801h,lcdkit-bias-state-mask = <0x43>;
		hw_lv52134a,lcdkit-bias-type = <0x04>;
		hw_lv52134a,lcdkit-bias-vpos-reg = <0x00>;
		hw_lv52134a,lcdkit-bias-vneg-reg = <0x01>;
		hw_lv52134a,lcdkit-bias-vpos-val = <0x0f>;
		hw_lv52134a,lcdkit-bias-vneg-val = <0x0f>;
		hw_lv52134a,lcdkit-bias-vpos-mask = <0x1f>;
		hw_lv52134a,lcdkit-bias-vneg-mask = <0x1f>;
		hw_lv52134a,lcdkit-bias-state-reg = <0x00>;
		hw_lv52134a,lcdkit-bias-state-val = <0x00>;
		hw_lv52134a,lcdkit-bias-state-mask = <0x00>;
		hw_lm36923,lcdkit-bl-ic-level = <2047>;
		hw_lm36923,lcdkit-bl-ic-ctrl-mode = <0>;
		hw_lm36923,lcdkit-bl-ic-type = <0>;
		hw_lm36923,lcdkit-bl-ic-before-init-delay = <0>;
		hw_lm36923,lcdkit-bl-ic-init-delay = <0>;
		hw_lm36923,lcdkit-bl-ic-ovp-check = <1>;
		hw_lm36923,lcdkit-bl-ic-fake-lcd-ovp-check = <0>;
		hw_lm36923,lcdkit-bl-ic-init-cmd = <0x02 0x11 0x85 0xff
						0x01 0x13 0x7D 0xff
						0x01 0x10 0x07 0x0f
						0x02 0x12 0xa3 0xff
						0x01 0x15 0xd0 0xff
						0x01 0x16 0xb3 0xff
						0x01 0x1e 0x00 0x0f>;
		hw_lm36923,lcdkit-bl-ic-num-of-init-cmd = <0x07>;
		hw_lm36923,lcdkit-bl-ic-bl-lsb-reg-cmd = <0x03 0x18 0x02 0x07>;
		hw_lm36923,lcdkit-bl-ic-bl-msb-reg-cmd = <0x08 0x19 0x66 0xff>;
		hw_lm36923,lcdkit-bl-ic-bl-enable-cmd = <0x01 0x10 0x07 0x0f>;
		hw_lm36923,lcdkit-bl-ic-bl-disable-cmd = <0x01 0x10 0x00 0x00>;
		hw_lm36923,lcdkit-bl-ic-disable-device-cmd = <0x01 0x10 0x00 0x00>;
		hw_lm36923,lcdkit-bl-ic-fault-flag-cmd = <0x01 0x1f 0x00 0xff>;
		hw_lm36923,lcdkit-bl-ic-bias-disable-cmd = <0x01 0x00 0x00 0x00>;
		hw_lm36923,lcdkit-bl-ic-bias-enable-cmd = <0x01 0x00 0x00 0x00>;
		hw_lm36923,lcdkit-bl-ic-led-open-short-test = <1>;
		hw_lm36923,lcdkit-bl-ic-num-of-led = <2>;
		hw_lm36923,lcdkit-bl-ic-brt-ctrl-cmd = <0x01 0x11 0x00 0xff>;
		hw_lm36923,lcdkit-bl-ic-fault-ctrl-cmd = <0x01 0x1e 0x00 0xff>;
		hw_lm36923,lcdkit-bl-ic-hidden-reg-surpport = <0>;
		hw_lm36923,lcdkit-bl-ic-sec-reg-enable-cmd = <0x00 0x00 0x00 0x00>;
		hw_lm36923,lcdkit-bl-ic-sec-reg-disable-cmd = <0x00 0x00 0x00 0x00>;
		hw_lm36923,lcdkit-bl-ic-hidden-reg-cmd = <0x00 0x00 0x00 0x00>;
		hw_lm36923,lcdkit-bl-ic-hidden-reg-val-mask = <0>;
		hw_lm36923,lcdkit-bl-ic-suspend-disbright-support = <0>;
		hw_lm36923,lcdkit-bl-ic-bl-wq-support = <0>;
		hw_lm36923,lcdkit-bl-ic-bl-enahnce-support = <0>;
		hw_lm36923,lcdkit-bl-ic-bl-lowpower-delay = <0>;
		hw_lm36923,lcdkit-bl-ic-bl-normal-level = <0>;
		hw_lm36923,lcdkit-bl-ic-bl-enhance-level = <0>;
		hw_lm36923,lcdkit-bl-ic-bl-enhance-hrdtimer-time = <0>;
		hw_lm36923,lcdkit-bl-ic-bl-normal-ovp-cmd = <0x00 0x00 0x00 0x00>;
		hw_lm36923,lcdkit-bl-ic-bl-normal-cur-ramp-cmd = <0x00 0x00 0x00 0x00>;
		hw_lm36923,lcdkit-bl-ic-bl-normal-boost-cur-cmd = <0x00 0x00 0x00 0x00>;
		hw_lm36923,lcdkit-bl-ic-bl-normal-sink-cmd = <0x00 0x00 0x00 0x00>;
		hw_lm36923,lcdkit-bl-ic-bl-enhance-ovp-cmd = <0x00 0x00 0x00 0x00>;
		hw_lm36923,lcdkit-bl-ic-bl-enhance-cur-ramp-cmd = <0x00 0x00 0x00 0x00>;
		hw_lm36923,lcdkit-bl-ic-bl-enhance-boost-cur-cmd = <0x00 0x00 0x00 0x00>;
		hw_lm36923,lcdkit-bl-ic-bl-enhance-sink-cmd = <0x00 0x00 0x00 0x00>;
		hw_lm36923,lcdkit-bl-ovp-bit = <0>;
		hw_lm36923,lcdkit-bl-ocp-bit = <0>;
		hw_lm36923,lcdkit-bl-tsd-bit = <0>;
		hw_mp3313,lcdkit-bl-ic-level = <2047>;
		hw_mp3313,lcdkit-bl-ic-ctrl-mode = <0>;
		hw_mp3313,lcdkit-bl-ic-type = <0>;
		hw_mp3313,lcdkit-bl-ic-before-init-delay = <0>;
		hw_mp3313,lcdkit-bl-ic-init-delay = <0>;
		hw_mp3313,lcdkit-bl-ic-ovp-check = <1>;
		hw_mp3313,lcdkit-bl-ic-fake-lcd-ovp-check = <0>;
		hw_mp3313,lcdkit-bl-ic-init-cmd = <0x01 0x11 0x82 0xff
						0x01 0x13 0x7d 0xff
						0x01 0x15 0x00 0xff
						0x01 0x16 0x00 0xff
						0x01 0x1e 0x48 0xff
						0x01 0x10 0x07 0x0f>;
		hw_mp3313,lcdkit-bl-ic-num-of-init-cmd = <0x06>;
		hw_mp3313,lcdkit-bl-ic-bl-lsb-reg-cmd = <0x03 0x18 0x02 0x07>;
		hw_mp3313,lcdkit-bl-ic-bl-msb-reg-cmd = <0x08 0x19 0x66 0xff>;
		hw_mp3313,lcdkit-bl-ic-bl-enable-cmd = <0x01 0x10 0x07 0x0f>;
		hw_mp3313,lcdkit-bl-ic-bl-disable-cmd = <0x01 0x10 0x00 0xff>;
		hw_mp3313,lcdkit-bl-ic-disable-device-cmd = <0x01 0x10 0x00 0xff>;
		hw_mp3313,lcdkit-bl-ic-fault-flag-cmd = <0x01 0x1f 0x00 0xff>;
		hw_mp3313,lcdkit-bl-ic-bias-disable-cmd = <0x01 0x00 0x00 0x00>;
		hw_mp3313,lcdkit-bl-ic-bias-enable-cmd = <0x01 0x00 0x00 0x00>;
		hw_mp3313,lcdkit-bl-ic-led-open-short-test = <0>;
		hw_mp3313,lcdkit-bl-ic-num-of-led = <2>;
		hw_mp3313,lcdkit-bl-ic-brt-ctrl-cmd = <0x01 0x11 0x00 0xff>;
		hw_mp3313,lcdkit-bl-ic-fault-ctrl-cmd = <0x01 0x1e 0x00 0xff>;
		hw_mp3313,lcdkit-bl-ic-hidden-reg-surpport = <0>;
		hw_mp3313,lcdkit-bl-ic-sec-reg-enable-cmd = <0x00 0x00 0x00 0x00>;
		hw_mp3313,lcdkit-bl-ic-sec-reg-disable-cmd = <0x00 0x00 0x00 0x00>;
		hw_mp3313,lcdkit-bl-ic-hidden-reg-cmd = <0x00 0x00 0x00 0x00>;
		hw_mp3313,lcdkit-bl-ic-hidden-reg-val-mask = <0>;
		hw_mp3313,lcdkit-bl-ic-suspend-disbright-support = <0>;
		hw_mp3313,lcdkit-bl-ic-bl-wq-support = <0>;
		hw_mp3313,lcdkit-bl-ic-bl-enahnce-support = <0>;
		hw_mp3313,lcdkit-bl-ic-bl-lowpower-delay = <0>;
		hw_mp3313,lcdkit-bl-ic-bl-normal-level = <0>;
		hw_mp3313,lcdkit-bl-ic-bl-enhance-level = <0>;
		hw_mp3313,lcdkit-bl-ic-bl-enhance-hrdtimer-time = <0>;
		hw_mp3313,lcdkit-bl-ic-bl-normal-ovp-cmd = <0x00 0x00 0x00 0x00>;
		hw_mp3313,lcdkit-bl-ic-bl-normal-cur-ramp-cmd = <0x00 0x00 0x00 0x00>;
		hw_mp3313,lcdkit-bl-ic-bl-normal-boost-cur-cmd = <0x00 0x00 0x00 0x00>;
		hw_mp3313,lcdkit-bl-ic-bl-normal-sink-cmd = <0x00 0x00 0x00 0x00>;
		hw_mp3313,lcdkit-bl-ic-bl-enhance-ovp-cmd = <0x00 0x00 0x00 0x00>;
		hw_mp3313,lcdkit-bl-ic-bl-enhance-cur-ramp-cmd = <0x00 0x00 0x00 0x00>;
		hw_mp3313,lcdkit-bl-ic-bl-enhance-boost-cur-cmd = <0x00 0x00 0x00 0x00>;
		hw_mp3313,lcdkit-bl-ic-bl-enhance-sink-cmd = <0x00 0x00 0x00 0x00>;
		hw_mp3313,lcdkit-bl-ovp-bit = <0>;
		hw_mp3313,lcdkit-bl-ocp-bit = <0>;
		hw_mp3313,lcdkit-bl-tsd-bit = <0>;
    };
};