/* DO NOT EDIT - Automatically generated by python */
/ {
		coslightguangyu_4980_22k_4400:coslightguangyu_4980_22k_4400 {
			fcc = <4980>;
			default_rbatt_mohm = <100>;
			identify_type = "id_volt";
			id_identify_min = <751>;
			id_identify_max = <1235>;
			id_voltage_min = <939>;
			id_voltage_max = <1059>;
			vbat_max = <4400>;
			temp_para = 
						"-32767","0","-1","0","4100","0",
						"0","5","-1","498","4400","0",
						"5","10","-1","1494","4400","3",
						"10","45","-1","-1","4400","3",
						"45","50","-1","1743","4100","3",
						"50","32767","-1","0","4100","0";
			vbat_para = 
						"-32767","3400","-1","820","0",
						"3400","32767","-1","-1","0";
			segment_para = 
						"-32767","4150","4980","4208","50",
						"4150","4450","3486","4400","0";
			batt_brand = "coslightguangyu";
			fcc_temp = <5142 5142 5147 5164 5152 5111>;
			fcc_sf_x = <0 100 200 300 400 500 600 700 800 1000 1500>;
			fcc_sf_y = <100 96 94 92 90 88 87 84 81 75 50>;
			fcc_sf_cols = <11>;
			pc_sf_rows = <1>;
			pc_sf_cols = <1>;
			pc_sf_row_entries = <0>;
			pc_sf_percent = <100>;
			pc_sf_sf = <100>;
			rbatt_sf_rows = <28>;
			rbatt_sf_cols = <6>;
			rbatt_sf_percent = <100 95 90 85 80 75 70 65 60 55 50 45 40 35 30 25 20 15 10 9 8 7 6 5 4 3 2 1>;
			rbatt_sf_sf = <
			               1512 915 404 114 95 89
			               1510 915 404 114 95 89
			               1417 895 404 113 95 90
			               1327 869 395 114 95 90
			               1276 842 397 116 97 91
			               1214 830 409 120 99 92
			               1112 743 399 127 103 93
			               1106 730 357 136 108 96
			               1082 727 355 137 114 100
			               1094 718 343 118 106 97
			               1127 724 341 109 94 90
			               1158 772 345 110 94 90
			               1194 820 364 112 96 91
			               1237 874 398 114 99 93
			               1291 931 440 115 99 92
			               1352 985 489 113 95 89
			               1433 1052 545 113 95 90
			               1549 1152 621 115 96 89
			               2460 1240 554 112 95 92
			               2666 1350 589 112 96 91
			               2797 1505 638 112 96 93
			               3007 1621 716 113 98 94
			               3210 1772 809 116 98 94
			               3456 1935 895 114 98 92
			               3776 2088 972 114 96 91
			               4154 2340 1057 117 97 92
			               4695 2688 1263 122 100 94
			               5674 3283 1646 140 106 95
			              >;
			pc_temp_ocv_rows = <29>;
			pc_temp_ocv_cols = <6>;
			pc_temp_ocv_percent = <100 95 90 85 80 75 70 65 60 55 50 45 40 35 30 25 20 15 10 9 8 7 6 5 4 3 2 1>;
			pc_temp_ocv_ocv = <
			                   4386 4384 4382 4375 4368 4360
			                   4276 4291 4300 4311 4305 4298
			                   4206 4222 4238 4251 4246 4240
			                   4142 4162 4180 4193 4189 4183
			                   4091 4104 4125 4138 4133 4127
			                   4032 4054 4075 4084 4080 4075
			                   3950 3973 4015 4035 4031 4027
			                   3908 3927 3949 3985 3985 3983
			                   3863 3888 3910 3940 3941 3940
			                   3834 3850 3870 3889 3892 3891
			                   3815 3820 3838 3853 3853 3852
			                   3798 3803 3812 3828 3828 3827
			                   3782 3790 3793 3807 3808 3806
			                   3768 3776 3781 3790 3791 3789
			                   3754 3762 3770 3775 3774 3768
			                   3739 3745 3756 3759 3753 3741
			                   3723 3726 3737 3740 3733 3719
			                   3703 3711 3713 3711 3706 3692
			                   3673 3689 3689 3690 3683 3670
			                   3666 3682 3685 3688 3682 3669
			                   3653 3677 3680 3687 3680 3668
			                   3639 3668 3675 3684 3678 3666
			                   3620 3657 3666 3679 3673 3660
			                   3596 3637 3650 3660 3657 3640
			                   3564 3604 3620 3621 3619 3603
			                   3521 3557 3572 3567 3567 3551
			                   3458 3488 3503 3492 3495 3482
			                   3363 3389 3403 3381 3389 3383
			                   3200 3200 3200 3200 3200 3200
			                  >;
		};
};
