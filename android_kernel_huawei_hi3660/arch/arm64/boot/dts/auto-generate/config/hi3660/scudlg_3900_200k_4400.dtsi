/* DO NOT EDIT - Automatically generated by python */
/ {
		scudlg_3900_200k_4400:scudlg_3900_200k_4400 {
			fcc = <3900>;
			default_rbatt_mohm = <100>;
			identify_type = "id_volt";
			id_identify_min = <2786>;
			id_identify_max = <3312>;
			id_voltage_min = <2941>;
			id_voltage_max = <3167>;
			vbat_max = <4400>;
			temp_para = 
						"-32767","0","-1","0","4100","0",
						"0","5","-1","390","4400","0",
						"5","10","-1","1170","4400","3",
						"10","45","-1","-1","4400","3",
						"45","50","-1","1365","4100","3",
						"50","32767","-1","0","4100","0";
			vbat_para = 
						"-32767","3400","-1","820","0",
						"3400","32767","-1","-1","0";
			segment_para = 
						"-32767","4150","3900","4208","50",
						"4150","4450","2730","4400","0";
			batt_brand = "scudlg";
			fcc_temp = <4045 4048 4046 4065 4050 4027>;
			fcc_sf_x = <0 100 200 300 400 500 600 700 800 1000 1500>;
			fcc_sf_y = <100 96 94 92 90 88 87 84 81 75 50>;
			fcc_sf_cols = <11>;
			pc_sf_rows = <1>;
			pc_sf_cols = <1>;
			pc_sf_row_entries = <0>;
			pc_sf_percent = <100>;
			pc_sf_sf = <100>;
			rbatt_sf_rows = <28>;
			rbatt_sf_cols = <6>;
			rbatt_sf_percent = <100 95 90 85 80 75 70 65 60 55 50 45 40 35 30 25 20 15 10 9 8 7 6 5 4 3 2 1>;
			rbatt_sf_sf = <
			               1494 575 278 104 86 80
			               1491 575 278 104 86 80
			               1400 577 283 105 86 80
			               1292 564 290 107 87 81
			               1225 587 299 110 89 82
			               1131 597 320 117 91 84
			               1036 553 326 127 96 85
			               1033 519 290 139 104 89
			               1036 519 278 137 110 94
			               1039 512 263 111 96 90
			               1059 517 258 102 86 81
			               1093 529 260 103 85 81
			               1138 552 264 105 87 82
			               1203 587 272 108 92 85
			               1291 636 286 108 91 84
			               1409 706 306 105 86 81
			               1562 815 330 104 86 83
			               1771 1039 371 106 87 84
			               2374 966 344 104 85 81
			               2715 1054 357 105 87 82
			               3128 1197 378 108 89 84
			               3601 1362 411 110 90 86
			               4176 1616 456 111 91 86
			               4880 1943 513 112 88 83
			               5684 2354 569 121 85 83
			               6503 2954 668 207 100 97
			               7405 3858 725 283 175 113
			               8140 4722 939 305 154 104
			              >;
			pc_temp_ocv_rows = <29>;
			pc_temp_ocv_cols = <6>;
			pc_temp_ocv_percent = <100 95 90 85 80 75 70 65 60 55 50 45 40 35 30 25 20 15 10 9 8 7 6 5 4 3 2 1>;
			pc_temp_ocv_ocv = <
			                   4386 4385 4382 4376 4369 4363
			                   4296 4308 4311 4312 4307 4301
			                   4230 4245 4249 4252 4246 4242
			                   4168 4182 4191 4193 4188 4183
			                   4118 4132 4135 4136 4131 4127
			                   4051 4081 4086 4083 4077 4074
			                   3962 4000 4025 4034 4028 4024
			                   3919 3940 3956 3980 3982 3979
			                   3883 3903 3917 3935 3936 3935
			                   3848 3865 3877 3884 3886 3886
			                   3822 3834 3844 3850 3849 3848
			                   3804 3810 3819 3825 3824 3822
			                   3791 3794 3798 3805 3804 3802
			                   3779 3783 3784 3788 3788 3786
			                   3768 3774 3775 3773 3771 3765
			                   3755 3762 3766 3758 3750 3740
			                   3742 3745 3750 3741 3731 3719
			                   3726 3725 3725 3714 3705 3693
			                   3700 3702 3699 3689 3681 3670
			                   3694 3697 3697 3688 3680 3669
			                   3688 3694 3695 3687 3679 3668
			                   3679 3689 3692 3684 3677 3666
			                   3665 3682 3688 3679 3672 3661
			                   3645 3668 3678 3660 3659 3644
			                   3614 3639 3649 3621 3622 3608
			                   3571 3591 3601 3571 3571 3559
			                   3518 3529 3533 3508 3507 3493
			                   3420 3424 3426 3407 3404 3394
			                   3200 3200 3200 3200 3200 3200
			                  >;
		};
};
