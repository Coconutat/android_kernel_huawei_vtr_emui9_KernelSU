/* DO NOT EDIT - Automatically generated by python */
/ {
		sunwodaatl_3900_39k_4400:sunwodaatl_3900_39k_4400 {
			fcc = <3900>;
			default_rbatt_mohm = <100>;
			identify_type = "id_volt";
			id_identify_min = <1235>;
			id_identify_max = <1759>;
			id_voltage_min = <1420>;
			id_voltage_max = <1562>;
			vbat_max = <4400>;
			temp_para = 
						"-32767","0","-1","0","4100","0",
						"0","5","-1","390","4400","0",
						"5","10","-1","1170","4400","3",
						"10","45","-1","-1","4400","3",
						"45","50","-1","1365","4100","3",
						"50","32767","-1","0","4100","0";
			vbat_para = 
						"-32767","3400","-1","820","0",
						"3400","32767","-1","-1","0";
			segment_para = 
						"-32767","4150","3900","4208","50",
						"4150","4450","2730","4400","0";
			batt_brand = "sunwodaatl";
			fcc_temp = <3934 3935 3925 3965 3949 3920>;
			fcc_sf_x = <0 100 200 300 400 500 600 700 800 1000 1500>;
			fcc_sf_y = <100 96 94 92 90 88 87 84 81 75 50>;
			fcc_sf_cols = <11>;
			pc_sf_rows = <1>;
			pc_sf_cols = <1>;
			pc_sf_row_entries = <0>;
			pc_sf_percent = <100>;
			pc_sf_sf = <100>;
			rbatt_sf_rows = <28>;
			rbatt_sf_cols = <6>;
			rbatt_sf_percent = <100 95 90 85 80 75 70 65 60 55 50 45 40 35 30 25 20 15 10 9 8 7 6 5 4 3 2 1>;
			rbatt_sf_sf = <
			               1749 1028 422 117 92 84
			               1748 1028 422 117 92 84
			               1610 1010 421 117 93 85
			               1478 946 417 118 94 85
			               1417 943 412 120 96 86
			               1310 937 438 125 98 89
			               1206 830 442 133 102 91
			               1191 797 399 143 107 94
			               1186 785 385 150 117 100
			               1181 768 367 119 97 88
			               1202 774 363 112 92 85
			               1238 801 367 113 92 86
			               1284 842 381 116 94 86
			               1340 893 410 119 98 91
			               1411 958 448 120 101 93
			               1492 1038 497 117 93 86
			               1593 1133 561 114 91 86
			               1733 1237 652 116 92 87
			               2279 1121 624 116 93 88
			               2607 1194 567 117 94 89
			               2936 1330 613 118 95 89
			               3305 1514 684 120 94 91
			               3719 1707 758 123 95 90
			               4192 1970 871 122 94 88
			               4726 2205 979 123 94 88
			               5405 2553 1107 132 94 89
			               6317 3090 1367 143 98 90
			               7665 3975 1887 235 107 93
			              >;
			pc_temp_ocv_rows = <29>;
			pc_temp_ocv_cols = <6>;
			pc_temp_ocv_percent = <100 95 90 85 80 75 70 65 60 55 50 45 40 35 30 25 20 15 10 9 8 7 6 5 4 3 2 1>;
			pc_temp_ocv_ocv = <
			                   4338 4368 4375 4380 4374 4367
			                   4282 4305 4312 4322 4316 4310
			                   4226 4245 4253 4264 4258 4252
			                   4166 4177 4196 4205 4200 4194
			                   4123 4131 4138 4148 4143 4138
			                   4056 4090 4093 4094 4089 4085
			                   3973 4004 4035 4044 4040 4035
			                   3927 3947 3968 3994 3992 3990
			                   3889 3906 3924 3948 3949 3947
			                   3852 3865 3880 3892 3892 3891
			                   3826 3833 3846 3857 3857 3856
			                   3808 3812 3818 3831 3831 3830
			                   3794 3798 3799 3810 3811 3809
			                   3781 3788 3787 3793 3794 3792
			                   3768 3777 3778 3776 3777 3773
			                   3754 3765 3768 3759 3752 3742
			                   3740 3748 3751 3738 3731 3720
			                   3723 3723 3724 3713 3707 3696
			                   3700 3701 3695 3690 3683 3672
			                   3693 3696 3691 3688 3682 3671
			                   3684 3690 3687 3686 3680 3669
			                   3674 3686 3683 3684 3678 3667
			                   3661 3677 3676 3677 3673 3662
			                   3642 3663 3662 3655 3658 3643
			                   3614 3633 3633 3612 3621 3607
			                   3569 3586 3584 3554 3570 3557
			                   3504 3516 3514 3476 3501 3490
			                   3404 3412 3411 3356 3399 3392
			                   3200 3200 3200 3200 3200 3200
			                  >;
		};
};
