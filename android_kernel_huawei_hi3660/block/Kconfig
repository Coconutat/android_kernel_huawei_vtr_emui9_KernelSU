## android_kernel_huawei_hi3660/drivers/devfreq/hisi/Kconfig
```kconfig
config HISI_DEVFREQ
    tristate "Hisilicon DEVFREQ Driver"
    depends on ARCH_HISI && PM_DEVFREQ
    select PM_OPP
    help
      This enables the hisilicon DDRfreq driver.

config HISI_DDR_DEVFREQ
    tristate "Hisilicon DDR DEVFREQ Driver"
    depends on ARCH_HISI && PM_DEVFREQ
    select PM_OPP
    select DEVFREQ_GOV_PM_QOS
    select HISI_DEVFREQ
    help
      This enables the hisilicon DDRfreq driver.

config DEVFREQ_GOV_PM_QOS
	bool "PM QOS"
	help
	  Sets the frequency based on pm_qos throughput constraints.

config DEVFREQ_GOV_MALI_ONDEMAND
    tristate "Hisilicon GPU DEVFREQ Driver"
    depends on ARCH_HISI && PM_DEVFREQ
    select PM_OPP
    select HISI_DEVFREQ
    help
      This enables the hisilicon MALI GPU driver.

config DEVFREQ_GOV_GPU_SCENE_AWARE
    tristate "Hisilicon GPU Scene Aware"
    depends on ARCH_HISI && PM_DEVFREQ
    select PM_OPP

config DEVFREQ_GOV_NPU_PM_QOS
    tristate "Hisilicon NPU PM QOS"
    depends on ARCH_HISI && PM_DEVFREQ
    select PM_OPP

config HISI_DDR_CHINTLV
    bool "Hisilicon ddr devfreq chintlv"
    default n
    help
      Deliver register address of GLB_ADDR_INTLV to ATF.

config HISI_DDR_DEVFREQ_DEBUGFS
	bool "Hisilicon ddr devfreq debugfs"
	depends on HI3650_DDR_DEVFREQ && DEBUG_FS
	default n
	help
	  This is a testing driver for HISI ddr devfreq function.

config ARM_MEMLAT_MON
        tristate "ARM CPU Memory Latency monitor hardware"
        help
          The PMU present on these ARM cores allow for the use of counters to
          monitor the memory latency characteristics of an ARM CPU workload.
          This driver uses these counters to implement the APIs needed by
          the mem_latency devfreq governor.

config DEVFREQ_GOV_MEMLAT
        tristate "HW monitor based governor for device BW"
        depends on ARM_MEMLAT_MON
        help
          HW monitor based governor for device to DDR bandwidth voting.
          This governor sets the CPU BW vote based on stats obtained from memalat
          monitor if it determines that a workload is memory latency bound. Since
          this uses target specific counters it can conflict with existing profiling
          tools.

config HISI_DEVFREQ_DEVBW
        bool "HISI DEVFREQ device for device BW/FREQ voting"
        select DEVFREQ_GOV_PERFORMANCE
        select DEVFREQ_GOV_MEMLAT
        select ARM_MEMLAT_MON
        default n
        help
          Different devfreq governors use this devfreq device to make CPU to
          DDR bandwidth votes. This driver provides a SoC topology
          agnostic interface to so that some of the devfreq governors can be
          shared across SoCs.

config DDR_HW_VOTE_15BITS
        bool "Hisilicon ddr dfs hardware vote 15 bits"
        depends on HISI_DDR_DEVFREQ
        default n
        help
          Hisilicon ddr dfs "hardware vote 15 bits" enbale.

source "drivers/devfreq/hisi/dsu_pctrl/Kconfig"
source "drivers/devfreq/hisi/l3c_devfreq/Kconfig"
source "drivers/devfreq/hisi/l3p_karma/Kconfig"
```

## android_kernel_huawei_hi3660/drivers/devfreq/hisi/l3p_karma/Kconfig
```kconfig
config HISI_L3P_KARMA
		tristate "L3 PREFETCH KARMA DEVFREQ Driver"
		depends on ARCH_HISI && PM_DEVFREQ
		select PM_OPP
	    help
			This enables the hisi l3p karma devfreq driver.

config HISI_L3P_KARMA_DEBUG
		tristate "L3P KARMA SYSFS DEBUG"
		depends on HISI_L3P_KARMA
		default n
	    help
		  l3p karma devfreq driver sysfs debug
```

## android_kernel_huawei_hi3660/drivers/devkit/audiokit/Kconfig
```kconfig
#
# Audiokit configuration
#
config AUDIOKIT
bool "Audio Kit"
default n
help
 choose y to open Audio Kit
if AUDIOKIT
source "drivers/devkit/audiokit/dsm_audio/Kconfig"
source "drivers/devkit/audiokit/deviceboxID/Kconfig"
source "drivers/devkit/audiokit/smartpakit/Kconfig"
endif
```

## android_kernel_huawei_hi3660/drivers/devkit/audiokit/smartpakit/Kconfig
```kconfig
config HUAWEI_SMARTPAKIT_AUDIO
	tristate "smartpakit driver"
	default n
	help
		Say Y to enable smartpakit driver support
```

## android_kernel_huawei_hi3660/drivers/devkit/lcdkit/lcdkit1.0/Kconfig
```kconfig
#
# lcdkit driver configuration
#

source "drivers/devkit/lcdkit/lcdkit1.0/core/common/Kconfig"
```

## android_kernel_huawei_hi3660/drivers/devkit/lcdkit/lcdkit3.0/Kconfig
```kconfig
#
# lcdkit hisi driver configuration
#

menuconfig LCD_KIT_DRIVER
	bool "lcd kit 3.0 driver"
	default n
	help
	    If you say yes here you get support for lcd kit driver.

source "drivers/devkit/lcdkit/lcdkit3.0/kernel/common/src/Kconfig"
source "drivers/devkit/lcdkit/lcdkit3.0/kernel/hisi/src/Kconfig"
source "drivers/devkit/lcdkit/lcdkit3.0/kernel/hisi/adapt/Kconfig"
source "drivers/devkit/lcdkit/lcdkit3.0/kernel/mtk/src/Kconfig"
source "drivers/devkit/lcdkit/lcdkit3.0/kernel/mtk/adapt/Kconfig"
```

## android_kernel_huawei_hi3660/drivers/devkit/lcdkit/lcdkit3.0/kernel/common/src/Kconfig
```kconfig
#
# lcdkit common configuration
#

menuconfig LCD_KIT_COMMON
	bool "lcd kit 3.0 common"
	default n
	help
	   If you say yes here you get support for lcd kit common.
```

## android_kernel_huawei_hi3660/drivers/devkit/lcdkit/lcdkit3.0/kernel/hisi/src/Kconfig
```kconfig
#
# lcdkit hisi driver configuration
#

menuconfig LCD_KIT_HISI
	bool "lcd kit 3.0 hisi driver"
	default n
	help
	   If you say yes here you get support for lcd kit hisi driver.
```

## android_kernel_huawei_hi3660/drivers/devkit/lcdkit/lcdkit3.0/kernel/mtk/adapt/Kconfig
```kconfig
#
# lcdkit mtk driver configuration
#

menuconfig LCD_KIT_MTK
	bool "lcd kit 3.0 mtk driver"
	default n
	help
	   If you say yes here you get support for lcd kit mtk driver.
```

## android_kernel_huawei_hi3660/drivers/devkit/tpkit/3_0/panel/Kconfig
```kconfig
#
# huawei touchscreen driver configuration
#


source "drivers/devkit/tpkit/3_0/panel/synaptics/Kconfig"
source "drivers/devkit/tpkit/3_0/panel/gt1x/Kconfig"
source "drivers/devkit/tpkit/3_0/panel/samsung/Kconfig"
source "drivers/devkit/tpkit/3_0/panel/synaptics_tcm/Kconfig"
source "drivers/devkit/tpkit/3_0/panel/gt8x/Kconfig"
source "drivers/devkit/tpkit/3_0/panel/focaltech/Kconfig"
source "drivers/devkit/tpkit/3_0/panel/novatek/Kconfig"
source "drivers/devkit/tpkit/3_0/panel/atmel/Kconfig"
```

## android_kernel_huawei_hi3660/drivers/devkit/tpkit/3_0/panel/focaltech/Kconfig
```kconfig
#
# huawei touchscreen driver configuration
#

menuconfig FOCAL_TS_KIT_3_0
	tristate "TS_KIT_3_0 focaltech drivers"
	default n
	help
	  If you say yes here you get support for huawei touchscreen.
```

## android_kernel_huawei_hi3660/drivers/devkit/tpkit/3_0/panel/novatek/Kconfig
```kconfig
#
# huawei touchscreen driver configuration
#

menuconfig NOVATEK_TS_KIT_3_0
	tristate "novatek ts kit 3_0 drivers"
	default n
	help
	  If you say yes here you get support for huawei touchscreen.
```

## android_kernel_huawei_hi3660/drivers/devkit/tpkit/3_0/panel/samsung/Kconfig
```kconfig
#
# huawei touchscreen driver configuration
#

menuconfig SAMSUNG_TS_KIT_3_0
	tristate "SAMSUNG_TS_KIT_3_0 samsung.lsi touch drivers"
	default n
	help
	  If you say yes here you get support for huawei touchscreen.
```

## android_kernel_huawei_hi3660/drivers/devkit/tpkit/3_0/panel/synaptics/Kconfig
```kconfig
#
# huawei touchscreen driver configuration
#

menuconfig SYNAPTICS_TS_KIT_3_0
	tristate "SYNAPTICS_TS_KIT_3_0 drivers"
	default n
	help
	  If you say yes here you get support for huawei touchscreen.
```

## android_kernel_huawei_hi3660/drivers/devkit/tpkit/hostprocessing/Kconfig
```kconfig
#
# huawei hostprocessing ts driver configuration
#

menuconfig JDI_HOST_TS_KIT
	tristate "JDI_HOST ts drivers"
	default n
	help
	  If you say yes here you get support for jdi hostprocessing ts touchscreen.

menuconfig HUAWEI_THP
	tristate "HUAWEI thp core drivers"
	default n
	help
	  If you say yes here you get support for core capacity hostprocessing touchscreen.

menuconfig HUAWEI_THP_NOVATECH
	tristate "Novatech thp drivers"
	default n
	help
	  If you say yes here you get support for novatech hostprocessing touchscreen.

menuconfig HUAWEI_THP_HIMAX
	tristate "Himax thp drivers"
	default n
	help
	  If you say yes here you get support for himax hostprocessing touchscreen

menuconfig HUAWEI_THP_SYNAPTICS
	tristate "Synaptics thp drivers"
	default n
	help
	  If you say yes here you get support for Synaptics hostprocessing touchscreen.

menuconfig HUAWEI_THP_GOODIX
	tristate "Goodix thp drivers"
	default n
	help
	  If you say yes here you get support for Synaptics hostprocessing touchscreen.

menuconfig HUAWEI_THP_SOLOMON
	tristate "Solomon thp drivers"
	default n
	help
	  If you say yes here you get support for Synaptics hostprocessing touchscreen.
```

## android_kernel_huawei_hi3660/drivers/devkit/tpkit/panel/Kconfig
```kconfig
#
# huawei touchscreen driver configuration
#


source "drivers/devkit/tpkit/panel/focaltech/Kconfig"
source "drivers/devkit/tpkit/panel/synaptics/Kconfig"
source "drivers/devkit/tpkit/panel/parade/Kconfig"
source "drivers/devkit/tpkit/panel/novatek/Kconfig"
source "drivers/devkit/tpkit/panel/ilitek/Kconfig"
source "drivers/devkit/tpkit/panel/ilitek_tddi/Kconfig"
source "drivers/devkit/tpkit/panel/novatek_hybrid/Kconfig"
source "drivers/devkit/tpkit/panel/himax/Kconfig"
source "drivers/devkit/tpkit/panel/goodix/Kconfig"
source "drivers/devkit/tpkit/panel/atmel/Kconfig"
source "drivers/devkit/tpkit/panel/wacom/Kconfig"
source "drivers/devkit/tpkit/panel/gt1x/Kconfig"
source "drivers/devkit/tpkit/panel/samsung/Kconfig"
source "drivers/devkit/tpkit/panel/st/Kconfig"
source "drivers/devkit/tpkit/panel/himax_64/Kconfig"
source "drivers/devkit/tpkit/panel/elan/Kconfig"
source "drivers/devkit/tpkit/panel/synaptics_tcm/Kconfig"
source "drivers/devkit/tpkit/panel/mstar/Kconfig"
```
