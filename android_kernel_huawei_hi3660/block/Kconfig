## android_kernel_huawei_hi3660/block/Kconfig
```kconfig
#
# Block layer core configuration
#
menuconfig BLOCK
       bool "Enable the block layer" if EXPERT
       default y
       select SBITMAP
       help
	 Provide block layer support for the kernel.

	 Disable this option to remove the block layer support from the
	 kernel. This may be useful for embedded devices.

	 If this option is disabled:

	   - block device files will become unusable
	   - some filesystems (such as ext3) will become unavailable.

	 Also, SCSI character devices and USB storage will be disabled since
	 they make use of various block layer definitions and facilities.

	 Say Y here unless you know you really don't want to mount disks and
	 suchlike.

if BLOCK

config LBDAF
	bool "Support for large (2TB+) block devices and files"
	depends on !64BIT
	default y
	help
	  Enable block devices or files of size 2TB and larger.

	  This option is required to support the full capacity of large
	  (2TB+) block devices, including RAID, disk, Network Block Device,
	  Logical Volume Manager (LVM) and loopback.
	
	  This option also enables support for single files larger than
	  2TB.

	  The ext4 filesystem requires that this feature be enabled in
	  order to support filesystems that have the huge_file feature
	  enabled.  Otherwise, it will refuse to mount in the read-write
	  mode any filesystems that use the huge_file feature, which is
	  enabled by default by mke2fs.ext4.

	  The GFS2 filesystem also requires this feature.

	  If unsure, say Y.

config BLK_DEV_BSG
	bool "Block layer SG support v4"
	default y
	help
	  Saying Y here will enable generic SG (SCSI generic) v4 support
	  for any block device.

	  Unlike SG v3 (aka block/scsi_ioctl.c drivers/scsi/sg.c), SG v4
	  can handle complicated SCSI commands: tagged variable length cdbs
	  with bidirectional data transfers and generic request/response
	  protocols (e.g. Task Management Functions and SMP in Serial
	  Attached SCSI).

	  This option is required by recent UDEV versions to properly
	  access device serial numbers, etc.

	  If unsure, say Y.

config BLK_DEV_BSGLIB
	bool "Block layer SG support v4 helper lib"
	default n
	select BLK_DEV_BSG
	help
	  Subsystems will normally enable this if needed. Users will not
	  normally need to manually enable this.

	  If unsure, say N.

config BLK_DEV_INTEGRITY
	bool "Block layer data integrity support"
	select CRC_T10DIF if BLK_DEV_INTEGRITY
	---help---
	Some storage devices allow extra information to be
	stored/retrieved to help protect the data.  The block layer
	data integrity option provides hooks which can be used by
	filesystems to ensure better data integrity.

	Say yes here if you have a storage device that provides the
	T10/SCSI Data Integrity Field or the T13/ATA External Path
	Protection.  If in doubt, say N.

config BLK_DEV_THROTTLING
	bool "Block layer bio throttling support"
	depends on BLK_CGROUP=y
	default n
	---help---
	Block layer bio throttling support. It can be used to limit
	the IO rate to a device. IO rate policies are per cgroup and
	one needs to mount and use blkio cgroup controller for creating
	cgroups and specifying per device IO rate policies.

	See Documentation/cgroups/blkio-controller.txt for more information.

config BLK_DEV_HI_PRIO_FOR_FG
	bool "Block layer high priority for foreground requests support"
	depends on BLK_DEV_THROTTLING=y
	default n
	---help---
	Give high priority for foreground requests, reserve some tags for
	forground requests to make sure these requests have low lantency.

config BLK_CMDLINE_PARSER
	bool "Block device command line partition parser"
	default n
	---help---
	Enabling this option allows you to specify the partition layout from
	the kernel boot args.  This is typically of use for embedded devices
	which don't otherwise have any standardized method for listing the
	partitions on a block device.

	See Documentation/block/cmdline-partition.txt for more information.


config HISI_BLOCK_FREQUENCE_CONTROL
        bool "add ddr frequence request base on block layer."
        depends on BLOCK
        default n

config MMC_BLOCK_IOMMU_64BIT
        bool "Block bounce limit"
        depends on BLOCK
        default n
        help
        Blk-setting will use address >4G for IOMMU.

config HISI_BLK
	bool "HISI Block feature"
	depends on BLOCK
	default n
	help
		HISI Block feature
		
config HISI_BLK_DEBUG
	bool "HISI Block Debug Mode"
	depends on HISI_BLK
	default n
	help
		HISI Block Debug Mode

config HISI_BK_OPS
	bool "HISI BKOPS"
	depends on HISI_BLK
	default n
	help
		HISI BKOPS feature

config HISI_PARTITION
        bool "hisi partition"
        default n

config HW_SYSTEM_WR_PROTECT
	bool "write protection function of system partitions."
	depends on BLOCK
	default n

config HISI_PARTITION_HI3650
        bool "hi3650 partition"
        depends on HISI_PARTITION
        default n
        help
           config partition for hi3650 platform

config HISI_PARTITION_HI6250
        bool "hi6250 partition"
        depends on HISI_PARTITION
        default n
        help
           config partition for hi6250 platform

config HISI_PARTITION_HI3660
        bool "hi3660 partition"
        depends on HISI_PARTITION
        default n
        help
           config partition for hi3660 platform

config HISI_PARTITION_CAPRICORN
        bool "capricorn partition"
        depends on HISI_PARTITION
        default n
        help
          config partition for capricorn platform

config HISI_PARTITION_LIBRA
	bool "libra partition"
	depends on HISI_PARTITION
	default n
	help
	  config partition for libra platform

config HISI_PARTITION_KIRIN970
        bool "kirin970 partition"
        depends on HISI_PARTITION
        default n
        help
	  config partition for kirin970 platform

config HISI_PARTITION_CANCER
        bool "cancer partition"
        depends on HISI_PARTITION
        default n
        help
           config partition for cancer platform

config HISI_PARTITION_TAURUS
        bool "taurus partition"
        depends on HISI_PARTITION
        default n
        help
           config partition for taurus platform

config MMC_BLOCK_IOMMU_64BIT
	bool "Block bounce limit"
	depends on BLOCK
	default n
	help
	Blk-setting will use address >4G for IOMMU.

config HISI_PARTITION
	bool "hisi partition"
	default n

config HISI_AB_PARTITION
        bool "AB partition support"
        default n
        help
          Say Y here if storage uses ab partition table.

menu "Partition Types"

source "block/partitions/Kconfig"

endmenu

endif # BLOCK

config BLOCK_COMPAT
	bool
	depends on BLOCK && COMPAT
	default y

config BLK_MQ_PCI
	bool
	depends on BLOCK && PCI
	default y

source block/Kconfig.iosched
```

## android_kernel_huawei_hi3660/drivers/bootdevice/Kconfig
```kconfig
menu "Hisilicon Bootdevice"

config HISI_BOOTDEVICE
        bool "Support multiple bootdevice, eMMC or UFS"
        default n
        help
          Used to dynamic select boot device from eMMC or UFS

endmenu
```

## android_kernel_huawei_hi3660/drivers/clk/hisi/dvfs/Kconfig
```kconfig
config HISI_PERIDVFS
	bool "HISI PERIDVFS"
	default n
config HISI_CLK_LOW_TEMPERATURE_JUDGE_BY_VOLT
	depends on HISI_PERIDVFS
	bool "HISI CLK LOW TEMPERATURE PROPERTY JUDGE BY VOLTAGE"
	default n
config HISI_PERI_FAST_AVS
	depends on HISI_PERIDVFS
	depends on HISI_MAILBOX
	bool "HISI PERI FAST AVS"
	default n
config HISI_PERI_AVS_IPC_NOTIFY
	depends on HISI_PERIDVFS
	depends on HISI_MAILBOX
	bool "HISI PERI AVS IPC NOTIFY"
	default n
```

## android_kernel_huawei_hi3660/drivers/contexthub/Kconfig
```kconfig
config CONTEXTHUB
	bool "Sensor CONTEXTHUB driver"
	depends on INPUTHUB || INPUTHUB_20
	default n
	help
	Sensor CONTEXTHUB driver.

config CONTEXTHUB_SHMEM
	bool "Sensor CONTEXTHUB SHMEM driver"
	depends on INPUTHUB || INPUTHUB_20
	default y
	help
	Say yes here if you want to configure contexthub share memory

config CONTEXTHUB_SHELL
	bool "Sensor CONTEXTHUB SHELL DBG driver"
	depends on CONTEXTHUB
	default n
	help
	Say yes here if you want to use contexthub shell dbg function

config CONTEXTHUB_PLAYBACK
	bool "Sensor CONTEXTHUB playback driver"
	depends on CONTEXTHUB
	default n
	help
	Say yes here if you want to use contexthub playback function

config CONTEXTHUB_LOADMONITOR
	bool "Sensor CONTEXTHUB LOADMONITOR driver"
	depends on CONTEXTHUB
	default n
	help
	Say yes here if you want to use contexthub shell dbg function

config CONTEXTHUB_CHRE
	bool "Sensor CONTEXTHUB CHRE driver"
	depends on CONTEXTHUB
	default n
	help
	Say yes here if you want to use contexthub shell dbg function

config INPUTHUB_MOCK_SENSOR
	bool "mock sensor feature support"
	depends on INPUTHUB_20
	default n
	help
	Say yes here if you want to configure INPUTHUB_MOCK_SENSOR

source "drivers/contexthub/flp/Kconfig"
```

## android_kernel_huawei_hi3660/drivers/cpufreq/hisi/Kconfig.arm
```kconfig
config ARCH_HISI_MAXFREQ
	bool "Hisilicon platform cpu max freq recognition"
	depends on PM_OPP
	default n
	help
	  Hisilicon platform cpu max freq recognition.

config HISI_ENABLE_GET_VAL
	bool "Hisilicon get cpufreq param"
	default n
	help
	  Hisilicon get cpufreq param.

config HISI_ENABLE_HPM_DATA_COLLECT
	bool "Hisilicon get hpm volt param"
	depends on HISI_ENABLE_GET_VAL
	default n
	help
	  Hisilicon get avs hpm volt param.

config HISI_BIG_MAXFREQ_HOTPLUG
	tristate "Specific flow for Hisilicon Platform CPUfreq driver"
	depends on CPUFREQ_DT && HOTPLUG_CPU
	help
	  This add Hotplug Flow in CPUfreq for Hisilicon Big-little Platform with boost freq.

config HISI_CPUFREQ_DT
	bool "Hisilicon cpufreq-dt enable"
	depends on CPUFREQ_DT
	default n
	help
	  Hisilicon cpufreq-dt enable.

config HISI_HW_VOTE_CPU_FREQ
	bool "Hisilicon cpufreq-hw_vote enable"
	depends on HISI_CPUFREQ_DT && HISI_HW_VOTE
	default n
	help
	  Hisilicon cpufreq-hw_vote enable.

config HISI_L2_DYNAMIC_RETENTION
	bool "Hisilicon l2 dynamic retention by freq"
	depends on HISI_HW_VOTE_CPU_FREQ
	default n
	help
	  Hisilicon l2 dynamic retention.

config HISI_CPUDDR_FREQ_LINK
	bool "Hisilicon cpu ddr freq link enable"
	depends on CPUFREQ_DT
	default n
	help
	  Hisilicon cpu ddr freq link enable.

config CPU_FREQ_POWER_STAT
	bool "Estimation of task power consumption"
	depends on CPU_FREQ_STAT
	select CPU_FREQ_TIMES
	default n
	help
	  Keep track of amount of power each task consumes and report power per uid

config HISI_CPU_FREQ_GOV_SCHEDUTIL
	bool "Hisilicon 'schedutil' cpufreq governor optimize"
	depends on CPU_FREQ_GOV_SCHEDUTIL
	default n
	help
	  This extends the functionality of existing schedutil governor.

config HISI_CPU_FREQ_LOCK_DETECT
	bool "Hisilicon schedutil detect freq lock&unlock"
	depends on HISI_CPU_FREQ_GOV_SCHEDUTIL
	default n
	help
	  This extends min_sample_time when boost scene finish


config HISI_CPUFREQ_LOWTEMP
	bool "Hisilicon low temperature cpu frequency set enable"
	depends on CPUFREQ_DT
	default n
	help
	  Hisilicon low temperature cpu frequency set enable.

config HISI_CPUFREQ_LOWTEMP_DEBUG
	bool "Hisilicon low temperature cpu frequency set debug enable"
	depends on HISI_CPUFREQ_LOWTEMP && HISI_DEBUG_FS
	default n
	help
	  Hisilicon low temperature cpu frequency set debug enable.
```

## android_kernel_huawei_hi3660/drivers/cpuidle/Kconfig
```kconfig
menu "CPU Idle"

config CPU_IDLE
	bool "CPU idle PM support"
	default y if ACPI || PPC_PSERIES
	select CPU_IDLE_GOV_LADDER if (!NO_HZ && !NO_HZ_IDLE)
	select CPU_IDLE_GOV_MENU if (NO_HZ || NO_HZ_IDLE)
	help
	  CPU idle is a generic framework for supporting software-controlled
	  idle processor power management.  It includes modular cross-platform
	  governors that can be swapped during runtime.

	  If you're using an ACPI-enabled platform, you should say Y here.

if CPU_IDLE

config CPU_IDLE_MULTIPLE_DRIVERS
        bool "Support multiple cpuidle drivers"
        depends on CPU_IDLE
        default n
        help
         Allows the cpuidle framework to use different drivers for each CPU.
         This is useful if you have a system with different CPU latencies and
         states. If unsure say N.

config CPU_IDLE_TRIPPLE_DRIVERS
        bool "Support tripple cpuidle drivers"
        depends on CPU_IDLE_MULTIPLE_DRIVERS
        default n
        help
         Allows the cpuidle framework to use different drivers for three clusters.
		 If unsure say N.

config HISI_IDLE_SLEEP
        bool "Support cpu idlesleep vote"
        depends on CPU_IDLE_MULTIPLE_DRIVERS
        default n
        help
         Only used for s1 state(32k).

config CPU_IDLE_GOV_LADDER
	bool "Ladder governor (for periodic timer tick)"

config CPU_IDLE_GOV_MENU
	bool "Menu governor (for tickless system)"

config DT_IDLE_STATES
	bool

menu "ARM CPU Idle Drivers"
depends on ARM || ARM64
source "drivers/cpuidle/Kconfig.arm"
endmenu

menu "ARM64 CPU Idle Drivers"
depends on ARM64
source "drivers/cpuidle/Kconfig.arm64"
endmenu

menu "MIPS CPU Idle Drivers"
depends on MIPS
source "drivers/cpuidle/Kconfig.mips"
endmenu

menu "POWERPC CPU Idle Drivers"
depends on PPC
source "drivers/cpuidle/Kconfig.powerpc"
endmenu

endif

config ARCH_NEEDS_CPU_IDLE_COUPLED
	def_bool n
endmenu
```

## android_kernel_huawei_hi3660/drivers/cpuload/Kconfig
```kconfig
config HW_CPULOAD_NOTI
    bool "notify cpu load"
    default n
    help
      if set, the cpu load will be reported to the cpufeature
```
