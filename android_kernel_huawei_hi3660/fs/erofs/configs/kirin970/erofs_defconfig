## android_kernel_huawei_hi3660/fs/erofs/configs/kirin970/erofs_defconfig
```kconfig
# erofs file system configuration

CONFIG_EROFS_FS=y
CONFIG_EROFS_FS_DEBUG=y
CONFIG_EROFS_FS_XATTR=y
CONFIG_EROFS_FS_POSIX_ACL=y
CONFIG_EROFS_FS_SECURITY=y
CONFIG_EROFS_FS_USE_VM_MAP_RAM=y
CONFIG_EROFS_FAULT_INJECTION=y
CONFIG_EROFS_FS_ZIP=y
CONFIG_EROFS_FS_CLUSTER_PAGE_LIMIT=1
# CONFIG_EROFS_FS_ZIP_NO_CACHE is not set
# CONFIG_EROFS_FS_ZIP_CACHE_UNIPOLAR is not set
CONFIG_EROFS_FS_ZIP_CACHE_BIPOLAR=y
CONFIG_EROFS_FS_HUAWEI_EXTENSION=y
```

## android_kernel_huawei_hi3660/include/hwnet/chr/Kconfig
```kconfig
config CHR_NETLINK_MODULE
	tristate "kernel space communicate with user space use chr netlink socket."
    default n
    help
	  This module adds support for data speed slow detecting funtion based on
	  Balong V3R3 chipset.
config CHR_MTK_NETLINK
	tristate "kernel MTK CHR."
    default n
    help
	  This module adds support for data speed slow detecting funtion based on.
```

## android_kernel_huawei_hi3660/include/hwnet/hw_dpi_mark/Kconfig
```kconfig
config HW_DPIMARK_MODULE
	tristate "kernel huawei custom packet mark based on DPI rules"
    default n
    help
	  This module adds support mark packets based on DPI rules
```

## android_kernel_huawei_hi3660/kernel/cgroup_huawei/Kconfig
```kconfig
#
# add cgroup pids limit
#

config HW_CGROUP_PIDS
	bool "PIDs cgroup subsystem"
	help
	  Provides enforcement of process number limits in the scope of a
	  cgroup. Any attempt to fork more processes than is allowed in the
	  cgroup will fail. PIDs are fundamentally a global resource because it
	  is fairly trivial to reach PID exhaustion before you reach even a
	  conservative kmemcg limit. As a result, it is possible to grind a
	  system to halt without being limited by other cgroup policies. The
	  PIDs cgroup subsystem is designed to stop this from happening.
	  It should be noted that organisational operations (such as attaching
	  to a cgroup hierarchy will *not* be blocked by the PIDs subsystem),
	  since the PIDs limit only affects a process's ability to fork, not to
	  attach to a cgroup.
```

## android_kernel_huawei_hi3660/kernel/cpu_netlink/Kconfig
```kconfig
config HW_IAWARE_THREAD_BOOST
    bool "iaware 2.0 binder thread boost"
    default n
    help
      if set, binder thread will be set to new group. if thread is in background group, set it to foreground group, else set it to boost group.
```

## android_kernel_huawei_hi3660/kernel/hwcfs/Kconfig
```kconfig
config HW_VIP_THREAD
    bool "iaware 2.0 vip thread"
    default n
    help
      if set, vip thread is pick first in cfs sched policy
```

## android_kernel_huawei_hi3660/kernel/sched/frame/Kconfig
```kconfig
menu "IProvision Scheduling v1.0"

config FRAME_RTG
	bool "Frame rtg control"
	depends on HISI_RTG && HISI_PERF_CTRL
	default n
	help
	  Frame RTG Process Control and Per Frame Load Tracking.
	  If you say Y here, you can set the task to rtg group of
	  DEFAULT_RT_FRAME_ID 8, and then kernel will statistic
	  the load per frame.

config FRAME_RTG_DEBUG
	bool "Frame rtg control debugging info"
	depends on DEBUG_KERNEL && PROC_FS && FRAME_RTG && HISI_DEBUG_FS
	default n
	help
	  If you say Y here, the /proc/sched_frame_debug file will be provided
	  that can help debug the frame scheduler.
	  The runtime overhead of this option is minimal.

config TRACE_FRAME_SYSTRACE
	bool "Frame systrace trace_clock_set_rate"
	depends on ARM64 && FRAME_RTG
	default n
	help
	  Frame Systrace used clock_set_rate for chrome systrace.
	  If you say Y here, the FRAME_SYATRACE will be enabled,
	  you can see all the load tracking from chrome systrace.

endmenu #"IProvision Scheduling v1.0"
```

## android_kernel_huawei_hi3660/mm/hisi/Kconfig
```kconfig
menuconfig HISI_MM
	bool "Hisilicon MM support"
	---help---
	  This option add some hisilicon mm codes, needed by following modules.

if HISI_MM

config HISI_SLOW_PATH_COUNT
	bool "page alloc enter slow path count"
	default n
	help
	  Say 'Y' here is you want to count page alloc slow path.

endif

config HISI_PMALLOC
	bool "Protectable Memory Allocator"
	default y
	depends on MMU
	depends on HISI_MM
	select  GENERIC_ALLOCATOR
	help
	It allows to write-protect variables allocated dynamically
	ls /sys/kernel/pmalloc

config DEBUG_HISI_PMALLOC
	bool "Tests for Protectable Memory Allocator"
	default y
	depends on HISI_PMALLOC && HISI_HHEE_DEBUG
	help
	Various entries are listed under /sys/kernel/debug/pmalloc
```

## drivers/cfi/Kconfig
```kconfig
#
# CFI configuration
#

config HUAWEI_CFI_TAG
    hex "huawei cfi tag"
    default "0x0035c000"
    help
      It configs the 4-byte value used to tag function entry.
      Note, for ARM architecture, not all integer constants can be encoded in one instruction.
      Refer to "Flexible second operand" in ARM Instruction Reference for more info.

config HUAWEI_CFI
    bool "HUAWEI CFI support"
    default n
    help
      Say yes here to support the HUAWEI CFI feature

config HUAWEI_CFI_DEBUG
    bool "HUAWEI CFI test support"
    default n
    help
      Say yes here to support the HUAWEI CFI debug
```

## drivers/char/acm/Kconfig
```kconfig
menu "Access Control Module"

config ACM
    bool "Enable Access Control Module"
    default n
    ---help---
        Access Control Module device driver

config ACM_DSM
	bool "Enable ACM dsm features"
	depends on HUAWEI_DSM && ACM
	default n
	---help---
		Enable dsm features for ACM

config ACM_DEBUG
	bool "Enable ACM debug features"
	depends on ACM
	default n
	---help---
		Enable debug info print and debugfs
		features for ACM

config ACM_TIME_COST
	bool "Enable ACM time measurement"
	depends on ACM_DEBUG
	default n
	---help---
		Enable time measurement for ACM
endmenu
```

## drivers/clk/hisi/Kconfig
```kconfig
config HI3xxx_CLK_CORE
	bool "Core clock driver of Hi3xxx Soc"
	default n if COMMON_CLK

config HI3620_CLK_MIPI_DSI
	bool "MIPI DSI clock driver of Hi3620 SoC"
	default y if COMMON_CLK && FB_HI3620

config HISI_CLK
	bool "clock driver of Soc"
	default n

config HISI_CLK_ALWAYS_ON
	bool "all clocks of Hisi Soc are always on"
	default n

config HISI_CLK_PM_MONITOR
	bool "clock pm_monitor spec"
	default n

config HISI_CLK_HI3660
	bool "hi3660 clock spec"
	default n

config HISI_CLK_KIRIN
        bool "boston and the version behind of boston clock spec"
        default n

config HISI_HI6250_CLK
	bool "6250 clock spec"
	default n

config HISI_CLK_MAILBOX_SUPPORT
	depends on HISI_CLK
	depends on HISI_MAILBOX
	bool "clk driver support mailbox communication"
	default n

config HISI_CLK_DEBUG
	depends on DEBUG_FS
	bool "HiSilicon clock driver debug"
	default n
```

## drivers/connectivity/Kconfig
```kconfig
#
# Generic huawei hisi misc drivers configuration
#
menuconfig CONNECTIVITY_HI110X
	bool "Hisilicon Wireless Connectivity Support"
	---help---
	  If you want to use Hisilicon  Wireless Connectivity, you should set this,
	  and choose one product

if CONNECTIVITY_HI110X
config CONNECTIVITY_HI1102
	bool "Connectivity Hi1102 support"
	default y
config CONNECTIVITY_HI11XX
	bool "Connectivity Hi11XX support"
	default n
config CONNECTIVITY_HI1103
	depends on CONNECTIVITY_HI11XX
	bool "Connectivity Hi1103 support"
	default n
config HI110X_DRIVER_PATH
	string "Hi1102 Kernel Driver Path"
	default "drivers/connectivity/hisi"
config HI11XX_DRIVER_PATH
	string "Hi1103 Kernel Driver Path"
	default "drivers/connectivity/hi11xx"
config ARCH_KIRIN_PCIE
    bool "kirin pcie interface support"
    default n
    depends on PCI

config HI110X_GPS_REFCLK
  bool "Hisilicon 110X gps refclk feature"
  default y
  ---help---
    Hisilicon 110X gps refclk feature

config HI110X_GPS_REFCLK_INTERFACE
  bool "Hisilicon 110X gps refclk interface with hwgps"
  default n
  ---help---
    Hisilicon 110X gps refclk interface with hwgps

choice
  prompt "GPS RefClk Type"
  default HI110X_GPS_REFCLK_SRC_3
  config HI110X_GPS_REFCLK_SRC_1
    bool "modem provide gps one ref clk source, like plat A"
  config HI110X_GPS_REFCLK_SRC_2
    bool "modem provide gps two ref clk source, like plat D"
  config HI110X_GPS_REFCLK_SRC_3
    bool "modem provide gps three ref clk source, other plat"
endchoice

config HI110X_GPS_SYNC
  bool "Hisilicon 110X gps sync feature"
  default y
  ---help---
    Hisilicon 110X gps sync feature temp default n till sync feature of other module complete
endif

if CONNECTIVITY_HI1102
source "drivers/connectivity/hisi/Kconfig"
source "drivers/connectivity/hisi/platform/Kconfig"
source "drivers/connectivity/hisi/wifi/Kconfig"
endif

if CONNECTIVITY_HI1103
source "drivers/connectivity/hi11xx/Kconfig"
endif
```

## drivers/connectivity/hi11xx/Kconfig
```kconfig
#
# Generic huawei hisi misc drivers configuration
#
source "drivers/connectivity/hi11xx/hi1103/Kconfig"
source "drivers/connectivity/hi11xx/hi1103/platform/Kconfig"
source "drivers/connectivity/hi11xx/hi1103/wifi/Kconfig"
```

## drivers/contexthub/flp/Kconfig
```kconfig
#
# FLP driver configuration
#

menu "HISI FLP configuration"

config HISI_FLP
	bool "HISI FLP support"
	depends on  CONTEXTHUB
	default n
	---help---
	  Enable support for FLP driver

config HISI_GEOFENCE_TRAJECTORY_FEATURE
	bool "HISI GEOFENCE TRAJECTORY support"
	depends on  CONTEXTHUB
	default n
	---help---
	  Enable support for GEOFENCE TRAJECTORY driver

endmenu
```

## drivers/devfreq/hisi/dsu_pctrl/Kconfig
```kconfig
config ARM64_DSU_PCTRL_DEVFREQ
		tristate "ARM DSU Cache Portion Control DEVFREQ Driver"
		depends on ARCH_HISI && PM_DEVFREQ
		depends on ARM64
		select PM_OPP
	    help
		  This adds the DevFreq driver for energy-cost-justified demand-driven
		  portion control of the ARM DSU cache.
		  This driver does not control frequency.

		  It uses architecture specific instructions which might cause
		  fault when some ARM64 platform does not support it.
		  Make sure this driver works with your ARM64 platform.

		  If unsure, say N.

config HISI_DSU_PCTRL_DEBUG
		tristate "DSU Cache Portion Control SYSFS DEBUG"
		depends on ARM64_DSU_PCTRL_DEVFREQ
		default n
	    help
		  dsu pctrl driver sysfs debug
```

## drivers/devfreq/hisi/l3c_devfreq/Kconfig
```kconfig
config HISI_L3C_DEVFREQ
		tristate "L3 cache DEVFREQ Driver"
		depends on ARCH_HISI && PM_DEVFREQ && ARM_DSU_PMU
		select PM_OPP
	    help
			This enables the hisilicon l3c devfreq driver.

config HISI_HW_VOTE_L3C_FREQ
		bool "Enable hardware vote l3c dvfs feature"
		depends on HISI_L3C_DEVFREQ && HISI_HW_VOTE
		default n
		help
		  enable hardware vote l3c dvfs feature

config HISI_CPUFREQ_LINK_L3CACHE
		bool "Enable CPUFREQ LINK L3CACHE feature"
		depends on HISI_L3C_DEVFREQ
		default n
		help
		  enable cpufreq link l3cache feature

config HISI_L3C_DEVFREQ_DEBUG
		tristate "L3C DEVFREQ SYSFS DEBUG"
		depends on HISI_L3C_DEVFREQ
		default n
	    help
		  l3c devfreq driver sysfs debug
```

## drivers/devkit/audiokit/deviceboxID/Kconfig
```kconfig
menuconfig HUAWEI_DEVICEBOX_AUDIO
	tristate "deviceboxID driver"
	default n
	help
		Say Y to enable deviceboxID driver support
```

## drivers/devkit/audiokit/dsm_audio/Kconfig
```kconfig
###################################################
#                                                 #
# huawei device state monitor audio configuration #
#                                                 #
###################################################

config HUAWEI_DSM_AUDIO
	bool "huawei dsm audio"
	default n
	depends on HUAWEI_DSM
	help
	  If you say yes here you get support for huawei dsm audio.
```

## drivers/devkit/lcdkit/Kconfig
```kconfig
#
# lcdkit driver configuration
#
source "drivers/devkit/lcdkit/lcdkit1.0/Kconfig"
source "drivers/devkit/lcdkit/lcdkit3.0/Kconfig"
```

## drivers/devkit/lcdkit/lcdkit1.0/core/common/Kconfig
```kconfig
#
# lcdkit driver configuration
#

menuconfig LCDKIT_DRIVER
	bool "lcdkit driver"
	default n
	help
	   If you say yes here you get support for lcdkit driver.
```

## drivers/devkit/tpkit/3_0/Kconfig
```kconfig
#
# huawei touchscreen driver configuration
#

menuconfig HUAWEI_HOST_TS_KIT_3_0
	tristate "huawei HOST_TS_KIT 3.0 touchscreen"
	default n
	help
	  If you say yes here you get support for hostprocessing touchscreen.
menuconfig HUAWEI_TS_KIT_3_0
	tristate "huawei TS_KIT 3.0 drivers"
	default n
	help
	  If you say yes here you get support for huawei touchscreen.
menuconfig HUAWEI_TS_KIT_TEST_3_0
	bool "huawei TS_KIT 3.0 test"
	default n
	help
	  If you say yes here you get support for huawei touchscreen.
menuconfig HUAWEI_TS_KIT_COMMON_3_0
	bool "huawei TS_KIT 3.0 common"
	default n
	help
	  If you say yes here you get support for huawei touchscreen.
menuconfig HUAWEI_DEVKIT_HISI_3_0
	tristate "huawei CONFIG_DEVKIT_HISI 3.0"
	default n
	help
	  If you say yes here you get support for huawei touchscreen.
menuconfig HUAWEI_DEVKIT_QCOM_3_0
	tristate "huawei CONFIG_DEVKIT_QCOM 3.0"
	default n
	help
	  If you say yes here you get support for huawei touchscreen.
menuconfig HUAWEI_DEVKIT_MTK_3_0
	tristate "huawei CONFIG_DEVKIT_MTK 3.0"
	default n
	help
	  If you say yes here you get support for huawei touchscreen.
source "drivers/devkit/tpkit/3_0/panel/Kconfig"

#sensor unification for differ platform
menuconfig HUAWEI_TP_KIT_COLOR_INFO_3_0
	tristate "huawei TS_KIT 3.0 tp color info"
	default n
	help
		get the huawei TS_KIT tp color information.
```

## drivers/devkit/tpkit/3_0/panel/atmel/Kconfig
```kconfig
#
# huawei touchscreen driver configuration
#

menuconfig ATMEL_TS_KIT_3_0
	tristate "huawei  ts kit atmel 3.0 drivers"
	default n
	help
	  If you say yes here you get support for huawei touchscreen.
```

## drivers/devkit/tpkit/3_0/panel/gt1x/Kconfig
```kconfig
#
# huawei touchscreen driver configuration
#

menuconfig GOODIX_GT1X_TS_KIT_3_0
	tristate "TS_KIT_3_0 goodix GT1X drivers"
	default n
	help
	  If you say yes here you get support for huawei touchscreen.
```

## drivers/devkit/tpkit/3_0/panel/gt8x/Kconfig
```kconfig
#
# huawei touchscreen driver configuration
#

menuconfig GOODIX_GTX8_TS_KIT
	bool "TS_KIT GTX8 drivers"
	default n
	help
	  If you say yes here you get support for huawei touchscreen.
```
