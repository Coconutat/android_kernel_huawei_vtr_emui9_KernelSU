/* DO NOT EDIT - Automatically generated by python */
		&desayatl_3900_68k_4400 {
			fcc = <3900>;
			default_rbatt_mohm = <100>;
			identify_type = "id_volt";
			id_identify_min = <1759>;
			id_identify_max = <2281>;
			id_voltage_min = <1956>;
			id_voltage_max = <2135>;
			vbat_max = <4400>;
			temp_para = 
						"-32767","0","-1","0","4100","0",
						"0","5","-1","390","4400","0",
						"5","10","-1","1170","4400","3",
						"10","45","-1","-1","4400","3",
						"45","50","-1","1365","4100","3",
						"50","32767","-1","0","4100","0";
			vbat_para = 
						"-32767","3400","-1","820","0",
						"3400","32767","-1","-1","0";
			segment_para = 
						"-32767","4150","3900","4208","50",
						"4150","4450","2730","4400","0";
			batt_brand = "desayatl";
			fcc_temp = <3956 3954 3955 3981 3966 3936>;
			fcc_sf_x = <0 100 200 300 400 500 600 700 800 1000 1500>;
			fcc_sf_y = <100 96 94 92 90 88 87 84 81 75 50>;
			fcc_sf_cols = <11>;
			pc_sf_rows = <1>;
			pc_sf_cols = <1>;
			pc_sf_row_entries = <0>;
			pc_sf_percent = <100>;
			pc_sf_sf = <100>;
			rbatt_sf_rows = <28>;
			rbatt_sf_cols = <6>;
			rbatt_sf_percent = <100 95 90 85 80 75 70 65 60 55 50 45 40 35 30 25 20 15 10 9 8 7 6 5 4 3 2 1>;
			rbatt_sf_sf = <
			               1804 934 437 122 99 90
			               1802 934 437 122 99 90
			               1671 930 435 123 99 91
			               1570 916 430 125 101 92
			               1516 902 424 129 103 94
			               1448 927 447 134 107 95
			               1309 856 459 143 112 97
			               1291 803 415 153 117 101
			               1264 798 401 158 124 106
			               1240 777 379 129 107 94
			               1266 768 367 119 99 92
			               1303 810 364 122 100 93
			               1350 864 375 126 104 95
			               1406 924 405 131 109 98
			               1467 996 442 132 109 99
			               1543 1079 487 127 102 93
			               1639 1172 536 123 100 93
			               1769 1283 599 124 100 93
			               2510 1227 519 125 102 95
			               2730 1315 526 126 101 96
			               2938 1428 554 127 102 97
			               3138 1556 594 128 103 97
			               3351 1702 642 129 104 95
			               3577 1841 681 127 101 92
			               3811 1975 706 131 101 93
			               4102 2158 744 141 103 97
			               4480 2421 840 176 109 97
			               5114 2831 1040 371 160 119
			              >;
			pc_temp_ocv_rows = <29>;
			pc_temp_ocv_cols = <6>;
			pc_temp_ocv_percent = <100 95 90 85 80 75 70 65 60 55 50 45 40 35 30 25 20 15 10 9 8 7 6 5 4 3 2 1>;
			pc_temp_ocv_ocv = <
			                   4393 4388 4385 4378 4373 4368
			                   4295 4309 4315 4318 4314 4309
			                   4224 4244 4255 4260 4256 4252
			                   4165 4186 4198 4203 4199 4195
			                   4119 4131 4142 4147 4144 4140
			                   4063 4092 4097 4093 4090 4087
			                   3973 4019 4045 4044 4042 4038
			                   3931 3952 3976 3994 3994 3993
			                   3889 3911 3930 3950 3951 3950
			                   3851 3869 3886 3896 3897 3895
			                   3828 3831 3849 3859 3860 3860
			                   3811 3813 3821 3833 3834 3833
			                   3797 3800 3801 3811 3813 3811
			                   3784 3790 3789 3794 3795 3793
			                   3770 3780 3780 3777 3777 3772
			                   3756 3769 3769 3759 3752 3741
			                   3740 3750 3751 3738 3730 3718
			                   3722 3724 3722 3711 3705 3693
			                   3698 3695 3693 3688 3681 3670
			                   3692 3691 3691 3687 3680 3669
			                   3685 3687 3688 3685 3678 3667
			                   3676 3684 3685 3681 3675 3664
			                   3664 3677 3680 3674 3668 3656
			                   3643 3661 3665 3648 3648 3632
			                   3610 3627 3629 3605 3608 3592
			                   3562 3575 3576 3549 3556 3540
			                   3493 3505 3505 3476 3486 3472
			                   3392 3407 3404 3379 3389 3374
			                   3200 3200 3200 3200 3200 3200
			                  >;
		};
