/*---------------------------------------------------------------------------
 * This file is autogenerated file using huawei LCD parser. Please do not edit it.
 * Update input XML file to add a new entry or update variable in this file
 * Parser location: vendor/huawei/chipset_common/devkit/lcdkit/tools 
 *---------------------------------------------------------------------------*/


/include/ "hwi_auo_otm1901a_5p2_1080p_video_default_1.dtsi"
/include/ "hwi_boe_td4310_5p99_1080p_video.dtsi"
/include/ "hwi_ctc_td4310_5p99_1080p_video.dtsi"
/include/ "hwi_tianma_nt36672_5p99_1080p_video.dtsi"
/include/ "hwi_truly_nt36672_5p99_1080p_video.dtsi"