/*---------------------------------------------------------------------------
 * This file is autogenerated file using huawei LCD parser. Please do not edit it.
 * Update input XML file to add a new entry or update variable in this file
 * Parser location: vendor/huawei/chipset_common/devkit/lcdkit/tools 
 *---------------------------------------------------------------------------*/


/include/ "vicky_va_jdi_otm2503b_5p5_2k_cmd.dtsi"
/include/ "vicky_va_jdi_s6d1ha2_5p5_2k_cmd.dtsi"