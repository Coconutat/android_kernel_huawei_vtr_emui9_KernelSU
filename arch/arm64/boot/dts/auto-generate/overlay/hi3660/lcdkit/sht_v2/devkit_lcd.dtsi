/*---------------------------------------------------------------------------
 * This file is autogenerated file using huawei LCD parser. Please do not edit it.
 * Update input XML file to add a new entry or update variable in this file
 * Parser location: vendor/huawei/chipset_common/devkit/lcdkit/tools 
 *---------------------------------------------------------------------------*/


/include/ "sht_v2_sharp_nt35523_8p4_1600p_video.dtsi"
/include/ "sht_v2_tianma_r63319_8p4_1600p_video.dtsi"