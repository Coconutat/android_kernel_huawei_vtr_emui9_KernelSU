/*
 * Copyright (c) 2012-2013, The Linux Foundation. All rights reserved.
 *
 * This program is free software; you can redistribute it and/or modify
 * it under the terms of the GNU General Public License version 2 and
 * only version 2 as published by the Free Software Foundation.
 *
 * This program is distributed in the hope that it will be useful,
 * but WITHOUT ANY WARRANTY; without even the implied warranty of
 * MERCHANTABILITY or FITNESS FOR A PARTICULAR PURPOSE.  See the
 * GNU General Public License for more details.
 */

/{

	amba{
		i2c3: i2c@FDF0C000 {
			gpio33: pca6416-gpio@20{
				compatible = "ti,tca6416";
				reg = <0x20>;
				linux,gpio-base = <256>;
				gpios = <&gpio15 7 0>;
				gpio-controller;
				interrupt-controller;
				interrupts;
				polarity = <0>;
				#gpio-cells = <2>;
				/*pinctrl-names = "default";*/
				/*pinctrl-0 = <&pinctrl_pca9505>;*/
				interrupt-parent = <&gpio15>;
				status = "disabled";
			};
		};

	};

};
