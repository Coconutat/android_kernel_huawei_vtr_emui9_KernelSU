/* DO NOT EDIT - Automatically generated by python */
		&desaysony_3900_110k_4400 {
			fcc = <3900>;
			default_rbatt_mohm = <100>;
			identify_type = "id_volt";
			id_identify_min = <2281>;
			id_identify_max = <2786>;
			id_voltage_min = <2426>;
			id_voltage_max = <2631>;
			vbat_max = <4400>;
			temp_para = 
						"-32767","0","-1","0","4100","0",
						"0","5","-1","390","4400","0",
						"5","10","-1","1170","4400","3",
						"10","45","-1","-1","4400","3",
						"45","50","-1","1365","4100","3",
						"50","32767","-1","0","4100","0";
			vbat_para = 
						"-32767","3400","-1","820","0",
						"3400","32767","-1","-1","0";
			segment_para = 
						"-32767","4150","3900","4208","50",
						"4150","4450","2730","4400","0";
			batt_brand = "desaysony";
			fcc_temp = <3958 3974 3987 4035 4020 3995>;
			fcc_sf_x = <0 100 200 300 400 500 600 700 800 1000 1500>;
			fcc_sf_y = <100 96 94 92 90 88 87 84 81 75 50>;
			fcc_sf_cols = <11>;
			pc_sf_rows = <1>;
			pc_sf_cols = <1>;
			pc_sf_row_entries = <0>;
			pc_sf_percent = <100>;
			pc_sf_sf = <100>;
			rbatt_sf_rows = <28>;
			rbatt_sf_cols = <6>;
			rbatt_sf_percent = <100 95 90 85 80 75 70 65 60 55 50 45 40 35 30 25 20 15 10 9 8 7 6 5 4 3 2 1>;
			rbatt_sf_sf = <
			               1408 709 370 130 97 87
			               1409 709 370 130 97 87
			               1433 723 377 132 99 87
			               1402 704 385 135 100 88
			               1408 737 387 139 103 89
			               1337 747 410 144 104 91
			               1319 709 406 152 108 92
			               1309 707 396 160 115 96
			               1317 705 388 157 118 100
			               1328 703 378 138 105 92
			               1363 718 379 132 98 88
			               1410 747 387 133 98 88
			               1466 790 403 138 101 88
			               1533 842 430 143 106 92
			               1621 905 466 145 106 92
			               1736 985 507 143 101 88
			               1909 1107 558 144 102 90
			               2235 1338 648 147 103 92
			               4083 1702 646 143 101 90
			               4690 1882 691 147 103 91
			               5475 2164 759 152 105 92
			               6539 2496 832 157 105 94
			               8071 3035 979 160 108 94
			               11029 3753 1160 163 106 93
			               19606 4972 1407 170 105 94
			               38052 7018 1824 196 111 96
			               69097 12821 2805 345 138 112
			               120176 32493 5126 484 271 154
			              >;
			pc_temp_ocv_rows = <29>;
			pc_temp_ocv_cols = <6>;
			pc_temp_ocv_percent = <100 95 90 85 80 75 70 65 60 55 50 45 40 35 30 25 20 15 10 9 8 7 6 5 4 3 2 1>;
			pc_temp_ocv_ocv = <
			                   4382 4381 4380 4375 4370 4365
			                   4286 4303 4307 4305 4302 4297
			                   4219 4239 4244 4244 4241 4236
			                   4151 4169 4184 4184 4181 4177
			                   4102 4119 4123 4126 4125 4120
			                   4031 4068 4073 4072 4071 4068
			                   3970 4001 4018 4022 4022 4019
			                   3916 3947 3964 3976 3977 3974
			                   3873 3899 3916 3928 3931 3930
			                   3835 3856 3872 3882 3884 3883
			                   3807 3823 3836 3847 3848 3847
			                   3783 3798 3809 3822 3823 3822
			                   3762 3779 3787 3801 3803 3801
			                   3741 3762 3772 3784 3787 3784
			                   3722 3746 3758 3768 3768 3763
			                   3703 3728 3743 3748 3744 3733
			                   3683 3704 3720 3726 3722 3710
			                   3657 3669 3684 3695 3694 3684
			                   3620 3631 3643 3665 3663 3653
			                   3607 3620 3636 3660 3659 3649
			                   3592 3609 3629 3654 3654 3644
			                   3576 3595 3619 3646 3647 3638
			                   3558 3582 3608 3634 3637 3627
			                   3535 3563 3590 3609 3614 3602
			                   3503 3534 3560 3567 3572 3562
			                   3457 3487 3507 3511 3518 3510
			                   3412 3412 3437 3446 3449 3444
			                   3298 3327 3344 3358 3362 3353
			                   3200 3200 3200 3200 3200 3200
			                  >;
		};
