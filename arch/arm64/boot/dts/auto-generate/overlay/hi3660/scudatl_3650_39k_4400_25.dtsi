/* DO NOT EDIT - Automatically generated by python */
		&scudatl_3650_39k_4400_25 {
			fcc = <3650>;
			default_rbatt_mohm = <100>;
			identify_type = "id_volt";
			id_identify_min = <1235>;
			id_identify_max = <1759>;
			id_voltage_min = <1420>;
			id_voltage_max = <1562>;
			vbat_max = <4400>;
			temp_para = 
						"-32767","0","-1","0","4100","0",
						"0","5","-1","365","4400","0",
						"5","10","-1","1095","4400","3",
						"10","45","-1","-1","4400","3",
						"45","50","-1","1277","4100","3",
						"50","32767","-1","0","4100","0";
			vbat_para = 
						"-32767","3400","-1","820","0",
						"3400","32767","-1","-1","0";
			segment_para = 
						"-32767","4150","3650","4208","50",
						"4150","4450","2555","4400","0";
			batt_brand = "scudatl";
			fcc_temp = <3655 3658 3648 3649 3643 3616>;
			fcc_sf_x = <0 100 200 300 400 500 600 700 800 1000 1500>;
			fcc_sf_y = <100 96 94 92 90 88 87 84 81 75 50>;
			fcc_sf_cols = <11>;
			pc_sf_rows = <1>;
			pc_sf_cols = <1>;
			pc_sf_row_entries = <0>;
			pc_sf_percent = <100>;
			pc_sf_sf = <100>;
			rbatt_sf_rows = <28>;
			rbatt_sf_cols = <6>;
			rbatt_sf_percent = <100 95 90 85 80 75 70 65 60 55 50 45 40 35 30 25 20 15 10 9 8 7 6 5 4 3 2 1>;
			rbatt_sf_sf = <
			               1899 1122 511 138 109 101
			               1848 1112 512 138 109 101
			               1678 1078 512 138 110 102
			               1556 1038 505 140 112 103
			               1494 1017 508 143 114 104
			               1396 982 521 149 118 106
			               1320 888 490 158 122 110
			               1310 863 455 172 130 114
			               1298 849 437 162 128 113
			               1299 835 422 135 112 103
			               1316 846 416 131 109 102
			               1352 877 420 133 111 103
			               1404 921 434 137 114 105
			               1474 987 462 141 118 109
			               1563 1073 504 140 116 108
			               1665 1173 561 135 109 102
			               1780 1275 637 133 109 102
			               1922 1381 740 135 110 102
			               2763 1267 606 136 108 104
			               3076 1383 628 137 111 103
			               3390 1520 674 138 112 105
			               3760 1697 718 140 114 107
			               4163 1908 783 141 116 108
			               4583 2195 849 141 113 102
			               5074 2445 928 153 112 103
			               5686 2778 1074 193 119 106
			               6566 3382 1316 289 155 128
			               7539 4007 1595 319 200 130
			              >;
			pc_temp_ocv_rows = <29>;
			pc_temp_ocv_cols = <6>;
			pc_temp_ocv_percent = <100 95 90 85 80 75 70 65 60 55 50 45 40 35 30 25 20 15 10 9 8 7 6 5 4 3 2 1>;
			pc_temp_ocv_ocv = <
			                   4347 4359 4357 4351 4346 4340
			                   4266 4286 4290 4292 4288 4281
			                   4201 4222 4230 4235 4231 4225
			                   4145 4164 4172 4178 4174 4169
			                   4096 4115 4119 4123 4120 4115
			                   4026 4063 4071 4072 4068 4063
			                   3957 3988 4011 4023 4020 4016
			                   3914 3936 3953 3978 3977 3972
			                   3874 3893 3909 3928 3928 3926
			                   3843 3853 3870 3879 3879 3878
			                   3820 3825 3838 3848 3848 3846
			                   3805 3807 3813 3824 3824 3822
			                   3792 3795 3796 3804 3804 3802
			                   3779 3785 3785 3788 3788 3785
			                   3766 3774 3776 3772 3769 3764
			                   3752 3761 3764 3754 3747 3736
			                   3738 3742 3745 3734 3726 3714
			                   3721 3719 3719 3708 3702 3690
			                   3697 3696 3691 3688 3680 3669
			                   3691 3691 3689 3686 3679 3667
			                   3682 3687 3686 3684 3677 3666
			                   3674 3682 3683 3681 3675 3663
			                   3662 3673 3677 3674 3670 3656
			                   3644 3659 3662 3652 3651 3635
			                   3614 3629 3631 3611 3613 3596
			                   3569 3580 3581 3559 3561 3544
			                   3510 3516 3514 3493 3494 3477
			                   3410 3415 3408 3390 3397 3378
			                   3200 3200 3200 3200 3200 3200
			                  >;
		};
