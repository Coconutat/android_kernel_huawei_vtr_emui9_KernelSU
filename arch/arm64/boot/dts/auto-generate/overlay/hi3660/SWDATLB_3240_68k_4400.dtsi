/* DO NOT EDIT - Automatically generated by python */
		&SWDATLB_3240_68k_4400 {
			fcc = <3240>;
			default_rbatt_mohm = <100>;
			identify_type = "id_volt";
			id_identify_min = <1759>;
			id_identify_max = <2281>;
			id_voltage_min = <1956>;
			id_voltage_max = <2135>;
			vbat_max = <4400>;
			temp_para = 
						"-32767","0","-1","0","4100","0",
						"0","5","-1","324","4400","0",
						"5","10","-1","972","4400","3",
						"10","45","-1","-1","4400","3",
						"45","50","-1","1134","4100","3",
						"50","32767","-1","0","4100","0";
			vbat_para = 
						"-32767","3400","-1","820","0",
						"3400","32767","-1","-1","0";
			segment_para = 
						"-32767","4150","3240","4208","50",
						"4150","4450","2268","4400","0";
			batt_brand = "SWDATLB";
			fcc_temp = <3205 3195 3194 3207 3204 3180>;
			fcc_sf_x = <0 100 200 300 400 500 600 700 800 1000 1500>;
			fcc_sf_y = <100 96 94 92 90 88 87 84 81 75 50>;
			fcc_sf_cols = <11>;
			pc_sf_rows = <1>;
			pc_sf_cols = <1>;
			pc_sf_row_entries = <0>;
			pc_sf_percent = <100>;
			pc_sf_sf = <100>;
			rbatt_sf_rows = <28>;
			rbatt_sf_cols = <6>;
			rbatt_sf_percent = <100 95 90 85 80 75 70 65 60 55 50 45 40 35 30 25 20 15 10 9 8 7 6 5 4 3 2 1>;
			rbatt_sf_sf = <
			               1914 1235 545 138 105 95
			               1914 1235 545 138 105 95
			               1824 1199 540 132 106 95
			               1713 1157 537 134 108 96
			               1705 1130 525 137 110 98
			               1602 1138 572 142 113 99
			               1493 1022 539 149 118 102
			               1481 1011 526 160 126 106
			               1445 989 503 167 133 110
			               1447 970 481 134 110 99
			               1476 980 480 128 106 96
			               1517 1017 483 130 107 97
			               1570 1069 513 134 109 98
			               1638 1133 554 139 115 102
			               1719 1209 605 141 114 98
			               1818 1299 669 135 108 96
			               1947 1405 748 135 107 98
			               2129 1523 859 139 108 97
			               2430 1689 1061 146 111 101
			               2612 1724 1107 147 112 102
			               3360 1598 869 144 113 104
			               3906 1750 902 144 110 104
			               4407 2018 1026 142 111 101
			               4978 2314 1124 143 106 98
			               5682 2612 1257 142 109 99
			               6511 2975 1455 145 111 101
			               7748 3653 1705 151 113 100
			               11395 4662 2262 167 119 102
			              >;
			pc_temp_ocv_rows = <29>;
			pc_temp_ocv_cols = <6>;
			pc_temp_ocv_percent = <100 95 90 85 80 75 70 65 60 55 50 45 40 35 30 25 20 15 10 9 8 7 6 5 4 3 2 1>;
			pc_temp_ocv_ocv = <
			                   4365 4361 4358 4351 4347 4340
			                   4274 4283 4287 4293 4289 4283
			                   4209 4219 4227 4234 4232 4227
			                   4144 4162 4172 4178 4176 4172
			                   4106 4110 4116 4124 4123 4119
			                   4038 4067 4074 4074 4072 4068
			                   3964 3988 4011 4025 4024 4022
			                   3923 3943 3962 3980 3982 3979
			                   3879 3898 3915 3936 3937 3935
			                   3847 3858 3873 3884 3885 3885
			                   3826 3830 3841 3851 3853 3853
			                   3809 3812 3814 3827 3828 3828
			                   3795 3800 3799 3808 3808 3808
			                   3783 3790 3788 3791 3792 3791
			                   3769 3780 3779 3776 3774 3767
			                   3754 3767 3768 3759 3751 3740
			                   3737 3749 3749 3740 3731 3718
			                   3720 3721 3719 3713 3704 3690
			                   3698 3699 3694 3691 3684 3672
			                   3692 3695 3690 3687 3680 3669
			                   3682 3689 3684 3685 3678 3667
			                   3672 3683 3679 3682 3675 3663
			                   3658 3675 3671 3676 3669 3655
			                   3637 3658 3652 3659 3649 3632
			                   3604 3624 3617 3622 3609 3593
			                   3553 3571 3565 3570 3558 3542
			                   3481 3499 3492 3502 3490 3475
			                   3379 3393 3391 3404 3391 3378
			                   3200 3200 3200 3200 3200 3200
			                  >;
		};
