/* DO NOT EDIT - Automatically generated by python */
		&sunwodalg_4980_470k_4400 {
			fcc = <4980>;
			default_rbatt_mohm = <100>;
			identify_type = "id_volt";
			id_identify_min = <3312>;
			id_identify_max = <3767>;
			id_voltage_min = <3457>;
			id_voltage_max = <3696>;
			vbat_max = <4400>;
			temp_para = 
						"-32767","0","-1","0","4100","0",
						"0","5","-1","498","4400","0",
						"5","10","-1","1494","4400","3",
						"10","45","-1","-1","4400","3",
						"45","50","-1","1743","4100","3",
						"50","32767","-1","0","4100","0";
			vbat_para = 
						"-32767","3400","-1","820","0",
						"3400","32767","-1","-1","0";
			segment_para = 
						"-32767","4150","4980","4208","50",
						"4150","4450","3486","4400","0";
			batt_brand = "sunwodalg";
			fcc_temp = <5154 5151 5147 5178 5141 5103>;
			fcc_sf_x = <0 100 200 300 400 500 600 700 800 1000 1500>;
			fcc_sf_y = <100 96 94 92 90 88 87 84 81 75 50>;
			fcc_sf_cols = <11>;
			pc_sf_rows = <1>;
			pc_sf_cols = <1>;
			pc_sf_row_entries = <0>;
			pc_sf_percent = <100>;
			pc_sf_sf = <100>;
			rbatt_sf_rows = <28>;
			rbatt_sf_cols = <6>;
			rbatt_sf_percent = <100 95 90 85 80 75 70 65 60 55 50 45 40 35 30 25 20 15 10 9 8 7 6 5 4 3 2 1>;
			rbatt_sf_sf = <
			               1415 900 386 89 67 57
			               1412 899 386 89 67 57
			               1313 859 390 90 66 57
			               1231 833 393 91 67 58
			               1210 813 397 93 68 59
			               1065 787 417 97 71 60
			               1046 666 373 104 73 62
			               1033 674 343 110 78 64
			               1026 652 337 114 84 67
			               1056 641 318 97 81 68
			               1108 666 311 85 66 59
			               1173 715 314 85 66 59
			               1249 783 345 87 68 60
			               1322 861 398 89 70 61
			               1392 932 470 89 69 61
			               1457 994 549 87 66 57
			               1528 1049 632 89 66 58
			               1622 1112 736 94 66 58
			               3118 1373 610 89 67 58
			               3355 1490 674 89 66 59
			               3590 1650 733 90 67 60
			               3856 1798 846 95 67 59
			               4123 1983 937 98 68 60
			               4419 2173 1055 96 66 59
			               4748 2370 1158 101 67 59
			               5125 2604 1235 111 69 61
			               5573 2956 1435 140 75 61
			               6245 3464 1795 339 90 64
			              >;
			pc_temp_ocv_rows = <29>;
			pc_temp_ocv_cols = <6>;
			pc_temp_ocv_percent = <100 95 90 85 80 75 70 65 60 55 50 45 40 35 30 25 20 15 10 9 8 7 6 5 4 3 2 1>;
			pc_temp_ocv_ocv = <
			                   4393 4389 4387 4379 4370 4363
			                   4263 4281 4293 4307 4299 4294
			                   4185 4207 4227 4246 4238 4234
			                   4116 4148 4168 4188 4181 4177
			                   4074 4097 4113 4132 4125 4122
			                   3972 4044 4066 4080 4073 4069
			                   3927 3949 3996 4031 4024 4020
			                   3880 3913 3941 3978 3979 3976
			                   3840 3869 3900 3937 3937 3935
			                   3817 3831 3858 3887 3891 3890
			                   3803 3810 3825 3849 3849 3848
			                   3791 3798 3802 3824 3823 3823
			                   3779 3788 3791 3803 3804 3802
			                   3767 3778 3782 3787 3788 3786
			                   3755 3766 3773 3773 3771 3766
			                   3742 3752 3760 3758 3753 3741
			                   3728 3733 3740 3740 3733 3719
			                   3710 3714 3716 3710 3706 3692
			                   3682 3692 3691 3688 3682 3669
			                   3674 3686 3686 3687 3681 3668
			                   3665 3680 3679 3685 3679 3667
			                   3656 3674 3672 3682 3677 3665
			                   3640 3666 3661 3674 3672 3659
			                   3617 3650 3646 3651 3659 3642
			                   3584 3621 3622 3606 3623 3606
			                   3540 3573 3579 3547 3571 3556
			                   3477 3505 3514 3466 3503 3488
			                   3381 3402 3414 3353 3402 3388
			                   3200 3200 3200 3200 3200 3200
			                  >;
		};
