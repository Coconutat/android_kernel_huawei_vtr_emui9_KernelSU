/* DO NOT EDIT - Automatically generated by python */
		&scudlg_4000_200k_4400 {
			fcc = <4000>;
			default_rbatt_mohm = <100>;
			identify_type = "id_volt";
			id_identify_min = <2786>;
			id_identify_max = <3312>;
			id_voltage_min = <2941>;
			id_voltage_max = <3167>;
			vbat_max = <4400>;
			temp_para = 
						"-32767","0","-1","0","4100","0",
						"0","5","-1","400","4400","0",
						"5","10","-1","1200","4400","3",
						"10","45","-1","-1","4400","3",
						"45","50","-1","1400","4100","3",
						"50","32767","-1","0","4100","0";
			vbat_para = 
						"-32767","3400","-1","820","0",
						"3400","32767","-1","-1","0";
			segment_para = 
						"-32767","4150","4000","4208","50",
						"4150","4450","2800","4400","0";
			batt_brand = "scudlg";
			fcc_temp = <4052 4054 4046 4078 4045 4017>;
			fcc_sf_x = <0 100 200 300 400 500 600 700 800 1000 1500>;
			fcc_sf_y = <100 96 94 92 90 88 87 84 81 75 50>;
			fcc_sf_cols = <11>;
			pc_sf_rows = <1>;
			pc_sf_cols = <1>;
			pc_sf_row_entries = <0>;
			pc_sf_percent = <100>;
			pc_sf_sf = <100>;
			rbatt_sf_rows = <28>;
			rbatt_sf_cols = <6>;
			rbatt_sf_percent = <100 95 90 85 80 75 70 65 60 55 50 45 40 35 30 25 20 15 10 9 8 7 6 5 4 3 2 1>;
			rbatt_sf_sf = <
			               1864 1128 519 107 74 62
			               1862 1127 519 108 74 62
			               1694 1065 529 108 74 62
			               1570 1013 526 111 77 63
			               1534 961 523 115 79 64
			               1446 961 561 123 81 66
			               1383 857 495 133 86 68
			               1373 843 449 142 91 71
			               1357 836 435 143 100 76
			               1363 829 415 112 85 68
			               1400 830 414 103 74 62
			               1455 868 418 105 75 63
			               1535 917 440 109 78 65
			               1630 992 478 112 81 68
			               1739 1087 541 112 83 70
			               1855 1190 623 111 74 62
			               1976 1302 722 110 74 62
			               2129 1425 854 115 75 63
			               3932 1702 720 113 77 64
			               4469 1930 786 113 76 64
			               4951 2177 875 116 77 64
			               5468 2451 1014 120 77 64
			               5948 2735 1139 125 78 64
			               6478 3000 1277 125 78 65
			               7007 3266 1425 139 79 67
			               7565 3639 1600 167 84 68
			               8222 4096 1848 312 91 68
			               9887 4849 2313 716 149 81
			              >;
			pc_temp_ocv_rows = <29>;
			pc_temp_ocv_cols = <6>;
			pc_temp_ocv_percent = <100 95 90 85 80 75 70 65 60 55 50 45 40 35 30 25 20 15 10 9 8 7 6 5 4 3 2 1>;
			pc_temp_ocv_ocv = <
			                   4390 4388 4384 4377 4369 4362
			                   4280 4292 4296 4310 4302 4297
			                   4201 4218 4229 4249 4242 4238
			                   4130 4158 4169 4191 4185 4181
			                   4082 4099 4113 4134 4129 4125
			                   4007 4053 4071 4082 4075 4072
			                   3940 3970 3999 4032 4026 4023
			                   3898 3925 3944 3978 3980 3978
			                   3855 3884 3903 3936 3938 3937
			                   3823 3847 3861 3884 3887 3886
			                   3803 3815 3830 3849 3849 3849
			                   3788 3798 3806 3824 3824 3824
			                   3777 3785 3792 3804 3804 3803
			                   3766 3774 3781 3788 3788 3786
			                   3754 3763 3772 3773 3773 3769
			                   3741 3747 3760 3758 3751 3739
			                   3725 3731 3740 3738 3731 3718
			                   3706 3714 3714 3711 3706 3693
			                   3679 3693 3691 3688 3681 3669
			                   3670 3686 3686 3686 3680 3668
			                   3658 3679 3679 3683 3678 3666
			                   3646 3671 3673 3679 3675 3664
			                   3629 3661 3663 3670 3670 3657
			                   3607 3643 3645 3642 3653 3638
			                   3576 3610 3616 3597 3617 3601
			                   3533 3564 3573 3538 3566 3551
			                   3472 3497 3508 3467 3498 3483
			                   3384 3404 3409 3377 3399 3384
			                   3200 3200 3200 3200 3200 3200
			                  >;
		};
