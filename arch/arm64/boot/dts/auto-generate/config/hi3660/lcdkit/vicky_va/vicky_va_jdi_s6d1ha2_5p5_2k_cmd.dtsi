/* Copyright (c) 2013, The Linux Foundation. All rights reserved.
 *
 * This program is free software; you can redistribute it and/or modify
 * it under the terms of the GNU General Public License version 2 and
 * only version 2 as published by the Free Software Foundation.
 *
 * This program is distributed in the hope that it will be useful,
 * but WITHOUT ANY WARRANTY; without even the implied warranty of
 * MERCHANTABILITY or FITNESS FOR A PARTICULAR PURPOSE.  See the
 * GNU General Public License for more details.
 */

/*-------------------------------------------------------------------------
 * This file is autogenerated file using gcdb parser. Please do not edit it.
 * Update input XML file to add a new entry or update variable in this file
 * VERSION = 1.1
 *-----------------------------------------------------------------------*/
/ {
	dsi_vicky_va_jdi_s6d1ha2_5p5_2k_cmd: lcdkit_vicky_va_jdi_s6d1ha2_5p5_2k_cmd {
		compatible = "jdi_s6d1ha2_5p5_2k_cmd";
		hw,lcdkit-panel-name = "JDI_S6D1HA2 5.5' CMD TFT 2560 x 1440";
		hw,lcdkit-panel-type = <0x01>;
		hw,lcdkit-panel-xres = <1440>;
		hw,lcdkit-panel-yres = <2560>;
		hw,lcdkit-panel-width = <68>;
		hw,lcdkit-panel-height = <121>;
		hw,lcdkit-panel-on-command = <0x15 0x01 0x00 0x00 0x0a 0x00 0x02 0x35 0x00
				0x15 0x01 0x00 0x00 0x0a 0x00 0x02 0x9d 0x01
				0x39 0x01 0x00 0x00 0x0a 0x00 0x59 0x9e 0x11 0x00 0x00 0x89 0x30 0x80 0x0a 0x00 0x05 0xa0 0x00 0x20 0x02 0xd0 0x02 0xd0 0x02 0x00 0x02 0x68 0x00 0x20 0x03 0x87 0x00 0x0a 0x00 0x0c 0x03 0x19 0x02 0x63 0x18 0x00 0x10 0xf0 0x03 0x0c 0x20 0x00 0x06 0x0b 0x0b 0x33 0x0e 0x1c 0x2a 0x38 0x46 0x54 0x62 0x69 0x70 0x77 0x79 0x7b 0x7d 0x7e 0x01 0x02 0x01 0x00 0x09 0x40 0x09 0xbe 0x19 0xfc 0x19 0xfa 0x19 0xf8 0x1a 0x38 0x1a 0x78 0x1a 0xb6 0x2a 0xf6 0x2b 0x34 0x2b 0x74 0x3b 0x74 0x6b 0xf4
				0x39 0x01 0x00 0x00 0x0a 0x00 0x03 0x51 0x0f 0xff
				0x15 0x01 0x00 0x00 0x0a 0x00 0x02 0x53 0x2c
				0x15 0x01 0x00 0x00 0x0a 0x00 0x02 0x55 0x00
				0x39 0x01 0x00 0x00 0x0a 0x00 0x05 0x2a 0x00 0x00 0x05 0x9f
				0x39 0x01 0x00 0x00 0x0a 0x00 0x05 0x2b 0x00 0x00 0x09 0xff
				0x05 0x01 0x00 0x00 0x78 0x01 0x01 0x11
				0x05 0x01 0x00 0x00 0x78 0x01 0x01 0x29
				0x29 0x01 0x00 0x00 0x0a 0x00 0x03 0xf0 0x5a 0x5a
				0x29 0x01 0x00 0x00 0x0a 0x00 0x14 0xc4 0x01 0x00 0xff 0x41 0x91 0x03 0x72 0x40 0x0f 0xff 0x06 0x5b 0xe0 0x11 0x41 0xff 0x06 0x5b 0xe0
				0x29 0x01 0x00 0x00 0x0a 0x00 0x02 0xb0 0x13
				0x29 0x01 0x00 0x00 0x0a 0x00 0x17 0xc4 0xb0 0x00 0xdf 0xdf 0x94 0x25 0x66 0x7d 0x8c 0x96 0xa3 0xae 0xb4 0xb8 0xc0 0xc3 0xcb 0xd4 0xde 0xf0 0xfa 0xfe
				0x29 0x01 0x00 0x00 0x0a 0x00 0x02 0xb0 0x29
				0x29 0x01 0x00 0x00 0x0a 0x00 0x11 0xc4 0xee 0xf0 0xf2 0xf4 0xf5 0xf7 0xf7 0xf8 0xf8 0xf9 0xfa 0xfb 0xfc 0xfc 0xfd 0xff
				0x05 0x01 0x00 0x00 0x0a 0x00 0x01 0x20>;
		hw,lcdkit-panel-on-command-state = "dsi_lp_mode";
		hw,lcdkit-panel-display-on-command = <0x05 0x01 0x00 0x00 0x64 0x00 0x02 0x29 0x00>;
		hw,lcdkit-panel-off-command = <0x05 0x01 0x00 0x00 0x3c 0x01 0x02 0x28 0x00
				0x05 0x01 0x00 0x00 0x64 0x01 0x02 0x10 0x00>;
		hw,lcdkit-panel-off-command-state = "dsi_lp_mode";
		hw,lcdkit-panel-backlight-command = <0x15 0x01 0x00 0x00 0x00 0x00 0x02 0x51 0x00>;
		hw,lcdkit-panel-backlight-command-state = "dsi_lp_mode";
		hw,lcdkit-panel-cabc-off-command = <0x15 0x01 0x00 0x00 0x0a 0x00 0x02 0x55 0x00>;
		hw,lcdkit-panel-cabc-off-command-state = "dsi_lp_mode";
		hw,lcdkit-panel-cabc-ui-command = <0x15 0x01 0x00 0x00 0x0a 0x00 0x02 0x55 0x01
			0x15 0x01 0x00 0x00 0x0a 0x00 0x02 0x53 0x24>;
		hw,lcdkit-panel-cabc-ui-command-state = "dsi_lp_mode";
		hw,lcdkit-panel-cabc-still-command = <0x15 0x01 0x00 0x00 0x0a 0x00 0x02 0x55 0x02
			0x15 0x01 0x00 0x00 0x0a 0x00 0x02 0x53 0x2C>;
		hw,lcdkit-panel-cabc-still-command-state = "dsi_lp_mode";
		hw,lcdkit-panel-cabc-moving-command = <0x15 0x01 0x00 0x00 0x0a 0x00 0x02 0x55 0x03
			0x15 0x01 0x00 0x00 0x0a 0x00 0x02 0x53 0x2C>;
		hw,lcdkit-panel-cabc-moving-command-state = "dsi_lp_mode";
		hw,lcdkit-panel-cabc-support = <1>;
		hw,lcdkit-panel-cabc-switch-support = <1>;
		hw,lcdkit-panel-display-on-effect-command = <0x15 0x01 0x00 0x00 0x0a 0x00 0x02 0x55 0x81>;
		hw,lcdkit-panel-display-on-effect-support = <1>;
		hw,lcdkit-panel-ce-off-command = <0x15 0x01 0x00 0x00 0x0a 0x00 0x02 0x55 0x81>;
		hw,lcdkit-panel-ce-srgb-command = <0x15 0x01 0x00 0x00 0x0a 0x00 0x02 0x55 0x91>;
		hw,lcdkit-panel-ce-user-command = <0x15 0x01 0x00 0x00 0x0a 0x00 0x02 0x55 0xB3>;
		hw,lcdkit-panel-ce-vivid-command = <0x15 0x01 0x00 0x00 0x0a 0x00 0x02 0x55 0xB3>;
		hw,lcdkit-panel-ce-support = <1>;
		hw,lcdkit-panel-dot-inversion-command = <0x29 0x01 0x00 0x00 0x00 0x00 0x02 0xB0 0x04
				0x29 0x01 0x00 0x00 0x00 0x00 0x03 0xC2 0x00 0x00
				0x29 0x01 0x00 0x00 0x00 0x00 0x02 0xB0 0x03>;
		hw,lcdkit-panel-dot-inversion-command-state = "dsi_lp_mode";
		hw,lcdkit-panel-column-inversion-command = <0x29 0x01 0x00 0x00 0x00 0x00 0x02 0xB0 0x04
				0x29 0x01 0x00 0x00 0x00 0x00 0x03 0xC2 0x00 0xF0
				0x29 0x01 0x00 0x00 0x00 0x00 0x02 0xB0 0x03>;
		hw,lcdkit-panel-column-inversion-command-state = "dsi_lp_mode";
		hw,lcdkit-panel-inversion-support = <0>;
		hw,lcdkit-panel-forword-scan-command = <0x29 0x01 0x00 0x00 0x0a 0x00 0x02 0xB0 0x04
				0x29 0x01 0x00 0x00 0x0a 0x00 0x02 0x36 0xC0
				0x29 0x01 0x00 0x00 0x0a 0x00 0x02 0xB0 0x03>;
		hw,lcdkit-panel-forword-scan-command-state = "dsi_lp_mode";
		hw,lcdkit-panel-revert-scan-command = <0x29 0x01 0x00 0x00 0x0a 0x00 0x02 0xB0 0x04
				0x29 0x01 0x00 0x00 0x0a 0x00 0x02 0x36 0x00
				0x29 0x01 0x00 0x00 0x0a 0x00 0x02 0xB0 0x03>;
		hw,lcdkit-panel-revert-scan-command-state = "dsi_lp_mode";
		hw,lcdkit-panel-scan-support = <0>;
		hw,lcdkit-panel-display-region-command = <0x39 0x01 0x00 0x00 0x05 0x00 0x05 0x2A 0x00 0x00 0x04 0x37
				0x39 0x01 0x00 0x00 0x05 0x00 0x05 0x2B 0x00 0x00 0x07 0x7F>;
		hw,lcdkit-panel-display-region-command-state = "dsi_lp_mode";
		hw,lcdkit-panel-display-region-support = <0>;
		hw,lcdkit-panel-checksum-support = <0>;
		hw,lcdkit-panel-esd-reg-command = <0x06 0x01 0x00 0x00 0x0a 0x00 0x01 0x0a>;
		hw,lcdkit-panel-esd-reg-command-state = "dsi_lp_mode";
		hw,lcdkit-panel-esd-value = <0x9c>;
		hw,lcdkit-panel-esd-support = <1>;
		hw,lcdkit-panel-check-reg-command = <0x06 0x01 0x00 0x00 0x0a 0x00 0x01 0x0a>;
		hw,lcdkit-panel-check-reg-value = <0x9c>;
		hw,lcdkit-panel-check-reg-command-state = "dsi_lp_mode";
		hw,lcdkit-panel-check-reg-support = <0>;
		hw,lcdkit-panel-dynamic-gamma-support = <0>;
		hw,lcdkit-panel-mipi-detect-support = <0>;
		hw,lcdkit-panel-dynamic-sram-check-support = <0>;
		hw,lcdkit-panel-fps-to-thirty-command = <
				
				0x15 0x01 0x00 0x00 0x0a 0x00 0x02 0x00 0x00
				0x39 0x01 0x00 0x00 0x0a 0x00 0x04 0xff 0x25 0x03 0x01
				0x15 0x01 0x00 0x00 0x0a 0x00 0x02 0x00 0x80
				0x39 0x01 0x00 0x00 0x0a 0x00 0x03 0xff 0x25 0x03
				0x15 0x01 0x00 0x00 0x0a 0x00 0x02 0x00 0xf0
				0x39 0x01 0x00 0x00 0x0a 0x00 0x03 0xc0 0x40 0x00
				0x15 0x01 0x00 0x00 0x0a 0x00 0x02 0x00 0x00
				0x15 0x01 0x00 0x00 0x0a 0x00 0x02 0xfb 0x01
				0x15 0x01 0x00 0x00 0x0a 0x00 0x02 0x00 0x00
				0x39 0x01 0x00 0x00 0x0a 0x00 0x04 0xff 0x00 0x00 0x00
				>;
		hw,lcdkit-panel-fps-to-thirty-command-state = "dsi_lp_mode";
		hw,lcdkit-panel-fps-to-sixty-command = <
				
				0x15 0x01 0x00 0x00 0x0a 0x00 0x02 0x00 0x00
				0x39 0x01 0x00 0x00 0x0a 0x00 0x04 0xff 0x25 0x03 0x01
				0x15 0x01 0x00 0x00 0x0a 0x00 0x02 0x00 0x80
				0x39 0x01 0x00 0x00 0x0a 0x00 0x03 0xff 0x25 0x03
				0x15 0x01 0x00 0x00 0x0a 0x00 0x02 0x00 0xf0
				0x39 0x01 0x00 0x00 0x0a 0x00 0x03 0xc0 0x80 0x00
				0x15 0x01 0x00 0x00 0x0a 0x00 0x02 0x00 0x00
				0x15 0x01 0x00 0x00 0x0a 0x00 0x02 0xfb 0x01
				0x15 0x01 0x00 0x00 0x0a 0x00 0x02 0x00 0x00
				0x39 0x01 0x00 0x00 0x0a 0x00 0x04 0xff 0x00 0x00 0x00
				>;
		hw,lcdkit-panel-fps-to-sixty-command-state = "dsi_lp_mode";
		hw,lcdkit-panel-dfr-enable-command = <
				
				0x15 0x01 0x00 0x00 0x0a 0x00 0x02 0x00 0x00
				0x39 0x01 0x00 0x00 0x0a 0x00 0x04 0xff 0x25 0x03 0x01
				0x15 0x01 0x00 0x00 0x0a 0x00 0x02 0x00 0x80
				0x39 0x01 0x00 0x00 0x0a 0x00 0x03 0xff 0x25 0x03
				0x15 0x01 0x00 0x00 0x0a 0x00 0x02 0x00 0xf0
				0x39 0x01 0x00 0x00 0x0a 0x00 0x03 0xc0 0x80 0x02
				0x15 0x01 0x00 0x00 0x0a 0x00 0x02 0x00 0x00
				0x15 0x01 0x00 0x00 0x0a 0x00 0x02 0xfb 0x01
				0x15 0x01 0x00 0x00 0x0a 0x00 0x02 0x00 0x00
				0x39 0x01 0x00 0x00 0x0a 0x00 0x04 0xff 0x00 0x00 0x00
				>;
		hw,lcdkit-panel-dfr-enable-command-state = "dsi_lp_mode";
		hw,lcdkit-panel-fps-updt-support = <0>;
		hw,lcdkit-panel-fps-func-switch = <1>;
		hw,lcdkit-panel-chip-esd-disable = <0>;
		hw,lcdkit-panel-check-reg-on-support = <0>;
		hw,lcdkit-panel-fps-tscall-support = <0>;
		hw,lcdkit-panel-dis-on-cmds-delay-margin-support = <0>;
		hw,lcdkit-panel-snd-cmd-before-frame-support = <0>;
		hw,lcdkit-panel-ts-resume-ctrl-mode = <0>;
		hw,lcdkit-panel-dis-on-cmds-delay-margin-time = <0>;
		hw,lcdkit-panel-lptohs-mipi-check-support = <0>;
		hw,lcdkit-panel-acl-ctrl-support = <0>;
		hw,lcdkit-panel-hbm-ctrl-support = <0>;
		hw,lcdkit-panel-vr-support = <0>;
		hw,lcdkit-panel-current-detect-enter-command = <0x15 0x01 0x00 0x00 0x0a 0x00 0x02 0xFF 0x20
						0x15 0x01 0x00 0x00 0x0a 0x00 0x02 0xFB 0x01
						0x15 0x01 0x00 0x00 0x0a 0x00 0x02 0x56 0x70
						0x15 0x01 0x00 0x00 0x0a 0x00 0x02 0x57 0x02>;
		hw,lcdkit-panel-current-detect-exit-command = <0x15 0x01 0x00 0x00 0x0a 0x00 0x02 0x56 0x00
						0x15 0x01 0x00 0x00 0x0a 0x00 0x02 0x57 0x00
						0x15 0x01 0x00 0x00 0x0a 0x00 0x02 0xFF 0x10>;
		hw,lcdkit-panel-current-detect-command = <0x06 0x01 0x00 0x00 0x0a 0x00 0x01 0x53>;
		hw,lcdkit-panel-current-detect-support = <0>;
		hw,lcdkit-panel-lv-detect-support = <0>;
		hw,lcdkit-panel-orientation = <1>;
		hw,lcdkit-panel-bpp = <0>;
		hw,lcdkit-panel-bgrfmt = <0>;
		hw,lcdkit-panel-bl-type = <4>;
		hw,lcdkit-panel-blmin = <33>;
		hw,lcdkit-panel-blmax = <8100>;
		hw,lcdkit-panel-bl-def = <4000>;
		hw,lcdkit-panel-bl-maxnit = <500>;
		hw,lcdkit-panel-getblmaxnit-type = <0>;
		hw,lcdkit-panel-cmd-type = <16>;
		hw,lcdkit-panel-dsi1-snd-cmd-panel-support = <0>;
		hw,lcdkit-panel-ifbctype = <7>;
		hw,lcdkit-panel-frc-enable = <0>;
		hw,lcdkit-panel-esd-skip-mipi-check = <1>;
		hw,lcdkit-panel-pxl-clk = <288>;
		hw,lcdkit-panel-pxl-clk-div = <1>;
		hw,lcdkit-panel-tp-resume-nosync = <1>;
		hw,lcdkit-panel-display-on-in-backlight = <0>;
		hw,lcdkit-panel-display-on-new-seq = <0>;
		hw,lcdkit-panel-dirt-updt-support = <0>;
		hw,lcdkit-is-hostprocessing = <0>;
		hw,lcdkit-panel-dsi-upt-support = <0>;
		hw,lcdkit-panel-vsyn-ctr-type = <7>;
		hw,lcdkit-panel-bl-pwm-preci-type = <2>;
		hw,lcdkit-panel-bl-ic-ctrl-type = <1>;
		hw,lcdkit-panel-fps-updt-only = <0>;
		hw,lcdkit-panel-step-support = <1>;
		hw,lcdkit-ldi-hsync-plr = <0>;
		hw,lcdkit-ldi-vsync-plr = <0>;
		hw,lcdkit-ldi-pixel-clk-plr = <0>;
		hw,lcdkit-ldi-data-en-plr = <0>;
		hw,lcdkit-ldi-dpi-a-overlap-size = <0>;
		hw,lcdkit-ldi-dpi-b-overlap-size = <0>;
		hw,lcdkit-sbl-stren-limit = <128>;
		hw,lcdkit-sbl-cal-a = <60>;
		hw,lcdkit-sbl-cal-b = <95>;
		hw,lcdkit-sbl-cal-c = <5>;
		hw,lcdkit-sbl-cal-d = <1>;
		hw,lcdkit-sbl-tf-ctl = <5>;
		hw,lcdkit-sbl-bl-min = <480>;
		hw,lcdkit-sbl-bl-max = <4096>;
		hw,lcdkit-sbl-bl-scale = <0xff>;
		hw,lcdkit-sbl-am-light-min = <14>;
		hw,lcdkit-sbl-filter-a = <1738>;
		hw,lcdkit-sbl-filter-b = <6>;
		hw,lcdkit-sbl-logo-left = <0>;
		hw,lcdkit-sbl-logo-top = <0>;
		hw,lcdkit-sbl-variance-intensity-space = <145>;
		hw,lcdkit-sbl-slope-max = <54>;
		hw,lcdkit-sbl-slope-min = <160>;
		hw,lcdkit-mipi-lane-nums = <3>;
		hw,lcdkit-mipi-color-mode = <5>;
		hw,lcdkit-mipi-vc = <0>;
		hw,lcdkit-mipi-dsi-bit-clk = <490>;
		hw,lcdkit-mipi-burst-mode = <0>;
		hw,lcdkit-mipi-max-esc-clk = <10>;
		hw,lcdkit-mipi-dsi-bit-clk-val-a = <471>;
		hw,lcdkit-mipi-dsi-bit-clk-val-b = <500>;
		hw,lcdkit-mipi-dsi-bit-clk-val-c = <490>;
		hw,lcdkit-mipi-dsi-bit-clk-val-d = <500>;
		hw,lcdkit-mipi-dsi-bit-clk-val-e = <0>;
		hw,lcdkit-mipi-dsi-bit-clk-upt = <490>;
		hw,lcdkit-mipi-rg-vcm-adjust = <0>;
		hw,lcdkit-mipi-non-continue-enable = <1>;
		hw,lcdkit-mipi-clk-post-adjust = <215>;
		hw,lcdkit-mipi-clk-pre-adjust = <0>;
		hw,lcdkit-mipi-clk-t-hs-prepare-adjust = <0>;
		hw,lcdkit-mipi-clk-t-lpx-adjust = <0>;
		hw,lcdkit-mipi-clk-t-hs-trail-adjust = <0>;
		hw,lcdkit-mipi-clk-t-hs-exit-adjust = <0>;
		hw,lcdkit-mipi-clk-t-hs-zero-adjust = <0>;
		hw,lcdkit-mipi-hs-wr-to-time = <0>;
		hw,lcdkit-dirt-left-align = <2>;
		hw,lcdkit-dirt-right-align = <2>;
		hw,lcdkit-dirt-top-align = <2>;
		hw,lcdkit-dirt-bott-align = <2>;
		hw,lcdkit-dirt-width-align = <2>;
		hw,lcdkit-dirt-height-align = <2>;
		hw,lcdkit-dirt-width-min = <2>;
		hw,lcdkit-dirt-height-min = <2>;
		hw,lcdkit-dirt-top-start = <0xffff>;
		hw,lcdkit-dirt-bott-start = <0xffff>;
		hw,lcdkit-gpios = <&gpio4 5 0>,<&gpio6 3 0>,<&gpio15 5 0>,<&gpio5 0 0>,<&gpio5 6 0>,<&gpio6 2 0>,<&gpio8 3 0>;
		lcdanalog-vcc-supply = <&ldo17>;
		pinctrl-0 = <&gpio037_pmx_func &gpio125_pmx_func &gpio040_pmx_func &gpio046_pmx_func &gpio050_pmx_func &gpio037_cfg_func &gpio125_cfg_func &gpio040_cfg_func &gpio046_cfg_func &gpio050_cfg_func>;
		pinctrl-1 = <&gpio037_pmx_idle &gpio125_pmx_idle &gpio040_pmx_idle &gpio046_pmx_idle &gpio050_pmx_idle &gpio037_cfg_idle &gpio125_cfg_idle &gpio040_cfg_idle &gpio046_cfg_idle &gpio050_cfg_idle>;
		pinctrl-names = "default","idle";
		status = "disabled";
		hw,lcdkit-sbl-support = <0>;
		hw,lcdkit-gamma-support = <1>;
		hw,lcdkit-gmp-support = <1>;
		hw,lcdkit-color-temp-support = <1>;
		hw,lcdkit-color-temp-rectify-support = <0>;
		hw,lcdkit-comform-mode-support = <1>;
		hw,lcdkit-cinema-mode-support = <0>;
		hw,lcdkit-prefix-sharp-two-d-support = <1>;
		hw,lcdkit-xcc-support = <1>;
		hw,lcdkit-prefix-ce-support = <0>;
		hw,lcdkit-prefix-sharp-one-d-support = <0>;
		hw,lcdkit-acm-support = <0>;
		hw,lcdkit-smart-color-mode-support = <0>;
		hw,lcdkit-acm-ce-support = <0>;
		hw,lcdkit-r_hh0 = <0x7f>;
		hw,lcdkit-r_lh0 = <0xe>;
		hw,lcdkit-r_hh1 = <0xbe>;
		hw,lcdkit-r_lh1 = <0x80>;
		hw,lcdkit-r_hh2 = <0xff>;
		hw,lcdkit-r_lh2 = <0xbf>;
		hw,lcdkit-r_hh3 = <0x1c0>;
		hw,lcdkit-r_lh3 = <0x100>;
		hw,lcdkit-r_hh4 = <0x27f>;
		hw,lcdkit-r_lh4 = <0x1c1>;
		hw,lcdkit-r_hh5 = <0x323>;
		hw,lcdkit-r_lh5 = <0x280>;
		hw,lcdkit-r_hh6 = <0x381>;
		hw,lcdkit-r_lh6 = <0x324>;
		hw,lcdkit-r_video_hh0 = <0x7f>;
		hw,lcdkit-r_video_lh0 = <0xe>;
		hw,lcdkit-r_video_hh1 = <0xbe>;
		hw,lcdkit-r_video_lh1 = <0x80>;
		hw,lcdkit-r_video_hh2 = <0xff>;
		hw,lcdkit-r_video_lh2 = <0xbf>;
		hw,lcdkit-r_video_hh3 = <0x1c0>;
		hw,lcdkit-r_video_lh3 = <0x100>;
		hw,lcdkit-r_video_hh4 = <0x27f>;
		hw,lcdkit-r_video_lh4 = <0x1c1>;
		hw,lcdkit-r_video_hh5 = <0x323>;
		hw,lcdkit-r_video_lh5 = <0x280>;
		hw,lcdkit-r_video_hh6 = <0x381>;
		hw,lcdkit-r_video_lh6 = <0x324>;
		hw,lcdkit-color-temp-rectify-r = <32768>;
		hw,lcdkit-color-temp-rectify-g = <32768>;
		hw,lcdkit-color-temp-rectify-b = <32768>;
		hw,lcdkit-hiace-support = <1>;
		hw,lcdkit-panel-effect-support = <0>;
		hw,lcdkit-arsr1p-sharpness-support = <1>;
		hw,lcdkit-iglobal-hist-black-pos = <16>;
		hw,lcdkit-iglobal-hist-white-pos = <240>;
		hw,lcdkit-iglobal-hist-black-weight = <51>;
		hw,lcdkit-iglobal-hist-white-weight = <51>;
		hw,lcdkit-iglobal-hist-zero-cut-ratio = <486>;
		hw,lcdkit-iglobal-hist-slope-cut-ratio = <410>;
		hw,lcdkit-imax-lcd-luminance = <500>;
		hw,lcdkit-imin-lcd-luminance = <3>;
		hw,lcdkit-cfg-name = "/product/etc/display/effect/algorithm/hdr_engine.xml";
		hw,lcdkit-effect-support-mode = <65537>;
		hw,lcdkit-delay-af-rst-off = <5>;
		hw,lcdkit-h-back-porch = <66>;
		hw,lcdkit-h-front-porch = <75>;
		hw,lcdkit-h-pulse-width = <30>;
		hw,lcdkit-v-back-porch = <35>;
		hw,lcdkit-v-pulse-width = <8>;
		hw,lcdkit-v-front-porch = <14>;
		hw,lcdkit-h-sync-skew = <0>;
		hw,lcdkit-non-check-ldi-porch = <0>;
		hw,lcdkit-dpi01-set-change = <0>;
		hw,lcdkit-lcd-type = <1>;
		hw,lcdkit-panel-pt-test-support = <0>;
		hw,lcdkit-panel-hkadc-support = <0>;
		hw,lcdkit-bias-power-ctrl-mode = <2>;
		hw,lcdkit-iovcc-power-ctrl-mode = <2>;
		hw,lcdkit-vci-power-ctrl-mode = <1>;
		hw,lcdkit-id0-gpio = <46>;
		hw,lcdkit-id1-gpio = <50>;
		hw,lcdkit-reset-gpio = <40>;
		hw,lcdkit-te-gpio = <23>;
		hw,lcdkit-vsp-gpio = <125>;
		hw,lcdkit-vsn-gpio = <37>;
		hw,lcdkit-iovcc-gpio = <67>;
		hw,lcdkit-vci-gpio = <0>;
		hw,lcdkit-iovcc-on-is-need-reset = <0>;
		hw,lcdkit-vsn-on-is-need-reset = <1>;
		hw,lcdkit-lcdanalog-vcc = <3300000>;
		hw,lcdkit-lcdio-vcc = <1800000>;
		hw,lcdkit-lcd-bias = <5400000>;
		hw,lcdkit-lcd-vsp = <5400000>;
		hw,lcdkit-lcd-vsn = <5400000>;
		hw,lcdkit-lcd-rst-first-high = <3>;
		hw,lcdkit-lcd-rst-low = <2>;
		hw,lcdkit-lcd-rst-second-high = <20>;
		hw,lcdkit-delay-af-vci-on = <2>;
		hw,lcdkit-delay-af-iovcc-on = <10>;
		hw,lcdkit-delay-af-bias-on = <0>;
		hw,lcdkit-delay-af-vsp-on = <11>;
		hw,lcdkit-delay-af-vsn-on = <0>;
		hw,lcdkit-delay-af-display-on = <0>;
		hw,lcdkit-delay-af-display-off = <0>;
		hw,lcdkit-delay-af-display-off-second = <0>;
		hw,lcdkit-delay-af-lp11 = <0>;
		hw,lcdkit-delay-af-tp-reset = <0>;
		hw,lcdkit-delay-af-vsn-off = <15>;
		hw,lcdkit-delay-af-vsp-off = <15>;
		hw,lcdkit-delay-af-bias-off = <0>;
		hw,lcdkit-delay-af-iovcc-off = <10>;
		hw,lcdkit-delay-af-vci-off = <0>;
    };
};