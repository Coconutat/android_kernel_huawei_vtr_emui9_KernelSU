/*---------------------------------------------------------------------------
 * This file is autogenerated file using huawei LCD parser. Please do not edit it.
 * Update input XML file to add a new entry or update variable in this file
 * Parser location: vendor/huawei/chipset_common/devkit/lcdkit/tools 
 *---------------------------------------------------------------------------*/


/include/ "stf_boe_td4310_5p2_1080p_video.dtsi"
/include/ "stf_jdi_35596s_5p2_1080p_video.dtsi"
/include/ "stf_jdi_r63452_5p2_1080p_cmd.dtsi"
/include/ "stf_lg_nt36672_5p2_1080p_video.dtsi"
/include/ "stf_tianma_td4310_5p2_1080p_video.dtsi"