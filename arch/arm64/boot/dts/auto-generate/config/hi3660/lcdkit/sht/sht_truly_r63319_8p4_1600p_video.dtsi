/* Copyright (c) 2013, The Linux Foundation. All rights reserved.
 *
 * This program is free software; you can redistribute it and/or modify
 * it under the terms of the GNU General Public License version 2 and
 * only version 2 as published by the Free Software Foundation.
 *
 * This program is distributed in the hope that it will be useful,
 * but WITHOUT ANY WARRANTY; without even the implied warranty of
 * MERCHANTABILITY or FITNESS FOR A PARTICULAR PURPOSE.  See the
 * GNU General Public License for more details.
 */

/*-------------------------------------------------------------------------
 * This file is autogenerated file using gcdb parser. Please do not edit it.
 * Update input XML file to add a new entry or update variable in this file
 * VERSION = 1.1
 *-----------------------------------------------------------------------*/
/ {
	dsi_sht_truly_r63319_8p4_1600p_video: lcdkit_sht_truly_r63319_8p4_1600p_video {
		compatible = "truly_r63319_8p4_1600p_video";
		hw,lcdkit-panel-name = "TRULY_R63319 8p4 VIDEO TFT 1600 x 2560";
		hw,lcdkit-panel-type = <0x01>;
		hw,lcdkit-panel-xres = <1600>;
		hw,lcdkit-panel-yres = <2560>;
		hw,lcdkit-panel-width = <113>;
		hw,lcdkit-panel-height = <181>;
		hw,lcdkit-panel-on-command = <0x23 0x01 0x00 0x00 0x0a 0x00 0x02 0xB0 0x04
		0x23 0x01 0x00 0x00 0x0a 0x00 0x02 0xD6 0x01
		0x29 0x01 0x00 0x00 0x0a 0x00 0x24 0xC1 0x88 0x60 0xC0 0x40 0x0C 0x52 0xCC 0x41 0x00 0x00 0xF8 0x1A 0x03 0x80 0xB5 0x07 0x01 0x00 0xE8 0x98 0x42 0x86 0x00 0x11 0x11 0x11 0x11 0x00 0x6A 0x01 0x22 0x02 0x00 0x01 0x11
		0x29 0x01 0x00 0x00 0x0a 0x00 0x05 0xD3 0x1B 0x33 0xBB 0xBB
		0x15 0x01 0x00 0x00 0x0a 0x00 0x02 0x51 0xFE
		0x15 0x01 0x00 0x00 0x0a 0x00 0x02 0x53 0x24
		0x29 0x01 0x00 0x00 0x0a 0x00 0x07 0xB8 0x07 0x8B 0x1E 0x00 0x1E 0x32
		0x29 0x01 0x00 0x00 0x0a 0x00 0x07 0xBA 0x07 0x90 0x1E 0x08 0x20 0x68
		0x29 0x01 0x00 0x00 0x0a 0x00 0x18 0xCE 0x7D 0x40 0x43 0x49 0x55 0x62 0x71 0x82 0x94 0xA8 0xB9 0xCB 0xDB 0xE9 0xF5 0xFC 0xFF 0x04 0x00 0x04 0x04 0x00 0x20
		0x15 0x01 0x00 0x00 0x0a 0x00 0x02 0x55 0x01
		0x05 0x01 0x00 0x00 0x32 0x01 0x02 0x29 0x00
		0x05 0x01 0x00 0x00 0x78 0x01 0x02 0x11 0x00>;
		hw,lcdkit-panel-on-command-state = "dsi_lp_mode";
		hw,lcdkit-panel-display-on-command = <0x05 0x01 0x00 0x00 0x78 0x00 0x02 0x29 0x00>;
		hw,lcdkit-panel-off-command = <0x05 0x01 0x00 0x00 0x32 0x01 0x02 0x28 0x00
			0x29 0x01 0x00 0x00 0x0a 0x00 0x02 0xB0 0x04
			0x29 0x01 0x00 0x00 0x0a 0x00 0x05 0xD3 0x13 0x33 0xBB 0xB3
			0x05 0x01 0x00 0x00 0x78 0x01 0x02 0x10 0x00
			0x29 0x01 0x00 0x00 0x0a 0x00 0x02 0xB1 0x01>;
		hw,lcdkit-panel-off-command-state = "dsi_lp_mode";
		hw,lcdkit-panel-backlight-command = <0x15 0x01 0x00 0x00 0x00 0x00 0x02 0x51 0x00>;
		hw,lcdkit-panel-backlight-command-state = "dsi_lp_mode";
		hw,lcdkit-panel-cabc-off-command = <0x15 0x01 0x00 0x00 0x0a 0x00 0x02 0x55 0x00>;
		hw,lcdkit-panel-cabc-off-command-state = "dsi_lp_mode";
		hw,lcdkit-panel-cabc-ui-command = <0x15 0x01 0x00 0x00 0x0a 0x00 0x02 0x55 0x01>;
		hw,lcdkit-panel-cabc-ui-command-state = "dsi_lp_mode";
		hw,lcdkit-panel-cabc-still-command = <0x15 0x01 0x00 0x00 0x0a 0x00 0x02 0x55 0x02>;
		hw,lcdkit-panel-cabc-still-command-state = "dsi_lp_mode";
		hw,lcdkit-panel-cabc-moving-command = <0x15 0x01 0x00 0x00 0x0a 0x00 0x02 0x55 0x03>;
		hw,lcdkit-panel-cabc-moving-command-state = "dsi_lp_mode";
		hw,lcdkit-panel-cabc-support = <1>;
		hw,lcdkit-panel-cabc-switch-support = <1>;
		hw,lcdkit-panel-bias-change-lm36274-from-panel-support = <1>;
		hw,lcdkit-panel-display-on-effect-command = <0x15 0x01 0x00 0x00 0x0a 0x00 0x02 0x55 0x81>;
		hw,lcdkit-panel-display-on-effect-support = <0>;
		hw,lcdkit-panel-ce-off-command = <>;
		hw,lcdkit-panel-ce-srgb-command = <>;
		hw,lcdkit-panel-ce-user-command = <>;
		hw,lcdkit-panel-ce-vivid-command = <>;
		hw,lcdkit-panel-ce-support = <0>;
		hw,lcdkit-panel-inversion-support = <0>;
		hw,lcdkit-panel-scan-support = <0>;
		hw,lcdkit-panel-display-region-command = <0x39 0x01 0x00 0x00 0x05 0x00 0x05 0x2A 0x00 0x00 0x04 0x37
				0x39 0x01 0x00 0x00 0x05 0x00 0x05 0x2B 0x00 0x00 0x07 0x7F>;
		hw,lcdkit-panel-display-region-command-state = "dsi_lp_mode";
		hw,lcdkit-panel-display-region-support = <0>;
		hw,lcdkit-panel-checksum-enter-command = <0x15 0x01 0x00 0x00 0x0a 0x00 0x02 0xFF 0xF0>;
		hw,lcdkit-panel-checksum-command = <0x06 0x01 0x00 0x00 0x14 0x00 0x01 0x73>;
		hw,lcdkit-panel-checksum-exit-command = <0x15 0x01 0x00 0x00 0x0a 0x00 0x02 0xFF 0x10>;
		hw,lcdkit-panel-checksum-value = <0x08 0x5B 0x5E 0x8E 0xEB 0xE5 0x2B 0x46 0xF9
				0x08 0xBE 0x8A 0x67 0x5C 0x6 0xFA 0xFB 0xDB
				0x08 0xFB 0xCE 0x5C 0x3D 0x4D 0x0F 0x41 0x6
				0x08 0xA6 0x91 0x1B 0xD7 0x71 0x44 0x3F 0x75>;
		hw,lcdkit-panel-checksum-support = <0>;
		hw,lcdkit-panel-esd-reg-command = <0x06 0x01 0x00 0x00 0x0a 0x00 0x01 0x0a>;
		hw,lcdkit-panel-esd-reg-command-state = "dsi_lp_mode";
		hw,lcdkit-panel-esd-value = <0x0c>;
		hw,lcdkit-panel-esd-support = <0>;
		hw,lcdkit-panel-check-reg-command = <0x06 0x01 0x00 0x00 0x0a 0x00 0x04 0x0a 0x0b 0x0c 0x0d>;
		hw,lcdkit-panel-check-reg-value = <0x0c 0x00 0x77 0x00>;
		hw,lcdkit-panel-check-reg-command-state = "dsi_lp_mode";
		hw,lcdkit-panel-check-reg-support = <0>;
		hw,lcdkit-panel-gamma-correct-reg = <0xD3 0xC7 0xC8>;
		hw,lcdkit-panel-gamma-reg-len = <28 30 49>;
		hw,lcdkit-panel-check-on-value = <0x0a>;
		hw,lcdkit-panel-check-reg-expect-value = <0x0c>;
		hw,lcdkit-panel-check-reg-mask-value = <0xff>;
		hw,lcdkit-panel-dynamic-gamma-support = <0>;
		hw,lcdkit-panel-mipi-detect-command = <0x06 0x01 0x00 0x00 0x0a 0x00 0x01 0x0e
				0x06 0x01 0x00 0x00 0x0a 0x00 0x01 0x05
				0x06 0x01 0x00 0x00 0x0a 0x00 0x01 0xab>;
		hw,lcdkit-panel-mipi-detect-value = <0x80 0x00 0x00>;
		hw,lcdkit-panel-mipi-detect-mask = <0xFF 0xFF 0xFFFF>;
		hw,lcdkit-panel-mipi-detect-command-state = "dsi_lp_mode";
		hw,lcdkit-panel-mipi-detect-support = <0>;
		hw,lcdkit-panel-dynamic-sram-check-support = <0>;
		hw,lcdkit-panel-snd-cmd-before-frame-command = <0x23 0x01 0x00 0x00 0x02 0x00 0x02 0xF4 0x1D>;
		hw,lcdkit-panel-snd-cmd-before-frame-command-state = "dsi_hs_mode";
		hw,lcdkit-panel-fps-updt-support = <0>;
		hw,lcdkit-panel-fps-func-switch = <0>;
		hw,lcdkit-panel-chip-esd-disable = <1>;
		hw,lcdkit-panel-check-reg-on-support = <1>;
		hw,lcdkit-panel-fps-tscall-support = <0>;
		hw,lcdkit-panel-dis-on-cmds-delay-margin-support = <0>;
		hw,lcdkit-panel-snd-cmd-before-frame-support = <0>;
		hw,lcdkit-panel-ts-resume-ctrl-mode = <0>;
		hw,lcdkit-panel-dis-on-cmds-delay-margin-time = <0>;
		hw,lcdkit-panel-lptohs-mipi-check-support = <0>;
		hw,lcdkit-panel-acl-ctrl-support = <0>;
		hw,lcdkit-panel-hbm-ctrl-support = <0>;
		hw,lcdkit-panel-vr-support = <0>;
		hw,lcdkit-panel-current-detect-support = <0>;
		hw,lcdkit-panel-lv-detect-support = <0>;
		hw,lcdkit-panel-orientation = <1>;
		hw,lcdkit-panel-bpp = <0>;
		hw,lcdkit-panel-bgrfmt = <0>;
		hw,lcdkit-panel-bl-type = <4>;
		hw,lcdkit-panel-blmin = <51>;
		hw,lcdkit-panel-blmax = <6690>;
		hw,lcdkit-panel-bl-def = <4000>;
		hw,lcdkit-panel-bl-maxnit = <530>;
		hw,lcdkit-panel-getblmaxnit-type = <0>;
		hw,lcdkit-panel-cmd-type = <32>;
		hw,lcdkit-panel-dsi1-snd-cmd-panel-support = <0>;
		hw,lcdkit-panel-ifbctype = <0>;
		hw,lcdkit-panel-frc-enable = <0>;
		hw,lcdkit-panel-esd-skip-mipi-check = <1>;
		hw,lcdkit-panel-pxl-clk = <320>;
		hw,lcdkit-panel-pxl-clk-div = <2>;
		hw,lcdkit-panel-tp-resume-nosync = <0>;
		hw,lcdkit-panel-display-on-in-backlight = <0>;
		hw,lcdkit-panel-display-on-new-seq = <0>;
		hw,lcdkit-panel-dirt-updt-support = <0>;
		hw,lcdkit-is-hostprocessing = <0>;
		hw,lcdkit-panel-dsi-upt-support = <1>;
		hw,lcdkit-panel-vsyn-ctr-type = <0>;
		hw,lcdkit-panel-bl-pwm-preci-type = <1>;
		hw,lcdkit-panel-bl-ic-ctrl-type = <6>;
		hw,lcdkit-panel-fps-updt-only = <0>;
		hw,lcdkit-panel-step-support = <1>;
		hw,lcdkit-ldi-hsync-plr = <0>;
		hw,lcdkit-ldi-vsync-plr = <0>;
		hw,lcdkit-ldi-pixel-clk-plr = <0>;
		hw,lcdkit-ldi-data-en-plr = <0>;
		hw,lcdkit-ldi-dpi-a-overlap-size = <0>;
		hw,lcdkit-ldi-dpi-b-overlap-size = <0>;
		hw,lcdkit-sbl-stren-limit = <128>;
		hw,lcdkit-sbl-cal-a = <60>;
		hw,lcdkit-sbl-cal-b = <95>;
		hw,lcdkit-sbl-cal-c = <5>;
		hw,lcdkit-sbl-cal-d = <1>;
		hw,lcdkit-sbl-tf-ctl = <5>;
		hw,lcdkit-sbl-bl-min = <480>;
		hw,lcdkit-sbl-bl-max = <4096>;
		hw,lcdkit-sbl-bl-scale = <0xff>;
		hw,lcdkit-sbl-am-light-min = <14>;
		hw,lcdkit-sbl-filter-a = <1738>;
		hw,lcdkit-sbl-filter-b = <6>;
		hw,lcdkit-sbl-logo-left = <0>;
		hw,lcdkit-sbl-logo-top = <0>;
		hw,lcdkit-sbl-variance-intensity-space = <145>;
		hw,lcdkit-sbl-slope-max = <54>;
		hw,lcdkit-sbl-slope-min = <160>;
		hw,lcdkit-mipi-lane-nums = <3>;
		hw,lcdkit-mipi-color-mode = <5>;
		hw,lcdkit-mipi-vc = <0>;
		hw,lcdkit-mipi-dsi-bit-clk = <475>;
		hw,lcdkit-mipi-burst-mode = <2>;
		hw,lcdkit-mipi-max-esc-clk = <10>;
		hw,lcdkit-mipi-dsi-bit-clk-val-a = <486>;
		hw,lcdkit-mipi-dsi-bit-clk-val-b = <475>;
		hw,lcdkit-mipi-dsi-bit-clk-val-c = <0>;
		hw,lcdkit-mipi-dsi-bit-clk-val-d = <0>;
		hw,lcdkit-mipi-dsi-bit-clk-val-e = <0>;
		hw,lcdkit-mipi-dsi-bit-clk-upt = <475>;
		hw,lcdkit-mipi-rg-vcm-adjust = <0>;
		hw,lcdkit-mipi-rg-vcm-clk-adjust = <3>;
		hw,lcdkit-mipi-rg-vcm-data-adjust = <3>;
		hw,lcdkit-mipi-non-continue-enable = <1>;
		hw,lcdkit-mipi-clk-post-adjust = <215>;
		hw,lcdkit-mipi-clk-pre-adjust = <0>;
		hw,lcdkit-mipi-clk-t-hs-prepare-adjust = <0>;
		hw,lcdkit-mipi-clk-t-lpx-adjust = <0>;
		hw,lcdkit-mipi-clk-t-hs-trail-adjust = <0>;
		hw,lcdkit-mipi-clk-t-hs-exit-adjust = <0>;
		hw,lcdkit-mipi-clk-t-hs-zero-adjust = <0>;
		hw,lcdkit-mipi-hs-wr-to-time = <0>;
		hw,lcdkit-dirt-left-align = <2>;
		hw,lcdkit-dirt-right-align = <2>;
		hw,lcdkit-dirt-top-align = <2>;
		hw,lcdkit-dirt-bott-align = <2>;
		hw,lcdkit-dirt-width-align = <2>;
		hw,lcdkit-dirt-height-align = <2>;
		hw,lcdkit-dirt-width-min = <2>;
		hw,lcdkit-dirt-height-min = <2>;
		hw,lcdkit-dirt-top-start = <0xffff>;
		hw,lcdkit-dirt-bott-start = <0xffff>;
		hw,lcdkit-gpios = <&gpio4 5 0>,<&gpio2 0 0>,<&gpio15 5 0>,<&gpio5 0 0>,<&gpio5 6 0>;
		lcdio-vcc-supply = <&ldo4>;
		lcdanalog-vcc-supply = <&ldo17>;
		pinctrl-0 = <&gpio037_pmx_func &gpio125_pmx_func &gpio040_pmx_func &gpio046_pmx_func &gpio037_cfg_func &gpio125_cfg_func &gpio040_cfg_func &gpio046_cfg_func>;
		pinctrl-1 = <&gpio037_pmx_idle &gpio125_pmx_idle &gpio040_pmx_idle &gpio046_pmx_idle &gpio037_cfg_idle &gpio125_cfg_idle &gpio040_cfg_idle &gpio046_cfg_idle>;
		pinctrl-names = "default","idle";
		status = "disabled";
		hw,lcdkit-sbl-support = <1>;
		hw,lcdkit-gamma-support = <1>;
		hw,lcdkit-gmp-support = <1>;
		hw,lcdkit-colormode-support = <1>;
		hw,lcdkit-color-temp-support = <1>;
		hw,lcdkit-color-temp-rectify-support = <0>;
		hw,lcdkit-comform-mode-support = <1>;
		hw,lcdkit-cinema-mode-support = <0>;
		hw,lcdkit-prefix-sharp-two-d-support = <1>;
		hw,lcdkit-xcc-support = <1>;
		hw,lcdkit-prefix-ce-support = <0>;
		hw,lcdkit-prefix-sharp-one-d-support = <0>;
		hw,lcdkit-acm-support = <1>;
		hw,lcdkit-smart-color-mode-support = <0>;
		hw,lcdkit-acm-ce-support = <0>;
		hw,lcdkit-r_hh0 = <0x80>;
		hw,lcdkit-r_lh0 = <0x0>;
		hw,lcdkit-r_hh1 = <0xff>;
		hw,lcdkit-r_lh1 = <0x81>;
		hw,lcdkit-r_hh2 = <0x17f>;
		hw,lcdkit-r_lh2 = <0x100>;
		hw,lcdkit-r_hh3 = <0x1ff>;
		hw,lcdkit-r_lh3 = <0x180>;
		hw,lcdkit-r_hh4 = <0x281>;
		hw,lcdkit-r_lh4 = <0x200>;
		hw,lcdkit-r_hh5 = <0x2ff>;
		hw,lcdkit-r_lh5 = <0x282>;
		hw,lcdkit-r_hh6 = <0x380>;
		hw,lcdkit-r_lh6 = <0x300>;
		hw,lcdkit-r_video_hh0 = <0x7f>;
		hw,lcdkit-r_video_lh0 = <0x0>;
		hw,lcdkit-r_video_hh1 = <0x101>;
		hw,lcdkit-r_video_lh1 = <0x80>;
		hw,lcdkit-r_video_hh2 = <0x177>;
		hw,lcdkit-r_video_lh2 = <0x102>;
		hw,lcdkit-r_video_hh3 = <0x1ed>;
		hw,lcdkit-r_video_lh3 = <0x178>;
		hw,lcdkit-r_video_hh4 = <0x26f>;
		hw,lcdkit-r_video_lh4 = <0x1ee>;
		hw,lcdkit-r_video_hh5 = <0x2ff>;
		hw,lcdkit-r_video_lh5 = <0x270>;
		hw,lcdkit-r_video_hh6 = <0x37c>;
		hw,lcdkit-r_video_lh6 = <0x300>;
		hw,lcdkit-color-temp-rectify-r = <32768>;
		hw,lcdkit-color-temp-rectify-g = <32768>;
		hw,lcdkit-color-temp-rectify-b = <32768>;
		hw,lcdkit-hiace-support = <1>;
		hw,lcdkit-panel-effect-support = <0>;
		hw,lcdkit-arsr1p-sharpness-support = <1>;
		hw,lcdkit-iglobal-hist-black-pos = <16>;
		hw,lcdkit-iglobal-hist-white-pos = <240>;
		hw,lcdkit-iglobal-hist-black-weight = <51>;
		hw,lcdkit-iglobal-hist-white-weight = <51>;
		hw,lcdkit-iglobal-hist-zero-cut-ratio = <486>;
		hw,lcdkit-iglobal-hist-slope-cut-ratio = <410>;
		hw,lcdkit-imax-lcd-luminance = <500>;
		hw,lcdkit-imin-lcd-luminance = <3>;
		hw,lcdkit-cfg-name = "/product/etc/display/effect/algorithm/hdr_engine.xml";
		hw,lcdkit-effect-support-mode = <65537>;
		hw,lcdkit-delay-af-rst-off = <6>;
		hw,lcdkit-h-back-porch = <76>;
		hw,lcdkit-h-front-porch = <150>;
		hw,lcdkit-h-pulse-width = <24>;
		hw,lcdkit-v-back-porch = <26>;
		hw,lcdkit-v-pulse-width = <5>;
		hw,lcdkit-v-front-porch = <14>;
		hw,lcdkit-h-sync-skew = <0>;
		hw,lcdkit-non-check-ldi-porch = <1>;
		hw,lcdkit-dpi01-set-change = <0>;
		hw,lcdkit-lcd-type = <0>;
		hw,lcdkit-panel-pt-test-support = <0>;
		hw,lcdkit-panel-hkadc-support = <0>;
		hw,lcdkit-bias-power-ctrl-mode = <2>;
		hw,lcdkit-iovcc-power-ctrl-mode = <1>;
		hw,lcdkit-vci-power-ctrl-mode = <0>;
		hw,lcdkit-id0-gpio = <46>;
		hw,lcdkit-id1-gpio = <16>;
		hw,lcdkit-reset-gpio = <40>;
		hw,lcdkit-te-gpio = <23>;
		hw,lcdkit-vsp-gpio = <125>;
		hw,lcdkit-vsn-gpio = <37>;
		hw,lcdkit-iovcc-gpio = <0>;
		hw,lcdkit-vci-gpio = <0>;
		hw,lcdkit-iovcc-on-is-need-reset = <0>;
		hw,lcdkit-vsn-on-is-need-reset = <1>;
		hw,lcdkit-lcdanalog-vcc = <3300000>;
		hw,lcdkit-lcdio-vcc = <1850000>;
		hw,lcdkit-lcd-bias = <5400000>;
		hw,lcdkit-lcd-vsp = <5800000>;
		hw,lcdkit-lcd-vsn = <5800000>;
		hw,lcdkit-lcd-rst-first-high = <2>;
		hw,lcdkit-lcd-rst-low = <6>;
		hw,lcdkit-lcd-rst-second-high = <5>;
		hw,lcdkit-delay-af-vci-on = <0>;
		hw,lcdkit-delay-af-iovcc-on = <3>;
		hw,lcdkit-delay-af-bias-on = <0>;
		hw,lcdkit-delay-af-vsp-on = <3>;
		hw,lcdkit-delay-af-vsn-on = <16>;
		hw,lcdkit-delay-af-display-on = <0>;
		hw,lcdkit-delay-af-display-off = <0>;
		hw,lcdkit-delay-af-display-off-second = <0>;
		hw,lcdkit-delay-af-lp11 = <12>;
		hw,lcdkit-delay-af-tp-reset = <0>;
		hw,lcdkit-delay-af-vsn-off = <11>;
		hw,lcdkit-delay-af-vsp-off = <11>;
		hw,lcdkit-delay-af-bias-off = <0>;
		hw,lcdkit-delay-af-iovcc-off = <10>;
		hw,lcdkit-delay-af-vci-off = <0>;
    };
};