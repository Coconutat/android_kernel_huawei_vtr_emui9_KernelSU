/*---------------------------------------------------------------------------
 * This file is autogenerated file using huawei LCD parser. Please do not edit it.
 * Update input XML file to add a new entry or update variable in this file
 * Parser location: vendor/huawei/chipset_common/devkit/lcdkit/tools 
 *---------------------------------------------------------------------------*/


/include/ "cmr_v2_boe_nt35523_10p7_1600p_video.dtsi"
/include/ "cmr_v2_boedvt2_nt35523_10p7_1600p_video.dtsi"