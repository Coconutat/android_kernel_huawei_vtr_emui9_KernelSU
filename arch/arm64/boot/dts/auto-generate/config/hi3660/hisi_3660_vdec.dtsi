/*
 * Hisilicon Ltd. Hi3660 SoC
 *
 * Copyright (C) 2014- Hisilicon Ltd.
 *
 * This program is free software; you can redistribute it and/or modify
 * it under the terms of the GNU General Public License version 2 as
 * publishhed by the Free Software Foundation.
 */

/ {
  vdec{
        compatible = "hisi,kirin960-vdec";
        reg = <0x0 0xe8800000 0x0 0x20000>;
        interrupts = <0 290 4>, <0 291 4>, <0 292 4>, <0 293 4>, <0 294 4>, <0 295 4>, <0 296 4>, <0 297 4>;
        clocks = <&clk_gate_vdec>;
        clock-names = "clk_vdec";
        dec_clk_rate = <480000000>, <200000000>;
        ldo_vdec-supply = <&vdec>;
        vdec_qos_mode = <0x2>;
        status = "ok";
        iommu_info {
            start-addr = <0x40000>;
            size = <0xE0000000>;
        };
      };
};
