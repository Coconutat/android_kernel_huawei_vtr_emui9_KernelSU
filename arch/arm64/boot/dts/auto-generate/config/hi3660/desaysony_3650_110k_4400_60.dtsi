/* DO NOT EDIT - Automatically generated by python */
/ {
		desaysony_3650_110k_4400_60:desaysony_3650_110k_4400_60 {
			fcc = <3650>;
			default_rbatt_mohm = <100>;
			identify_type = "id_volt";
			id_identify_min = <2281>;
			id_identify_max = <2786>;
			id_voltage_min = <2426>;
			id_voltage_max = <2631>;
			vbat_max = <4400>;
			temp_para = 
						"-32767","0","-1","0","4100","0",
						"0","5","-1","365","4400","0",
						"5","10","-1","1095","4400","3",
						"10","45","-1","-1","4400","3",
						"45","50","-1","1277","4100","3",
						"50","32767","-1","0","4100","0";
			vbat_para = 
						"-32767","3400","-1","820","0",
						"3400","32767","-1","-1","0";
			segment_para = 
						"-32767","4150","3650","4208","50",
						"4150","4450","2555","4400","0";
			batt_brand = "desaysony";
			fcc_temp = <3628 3614 3613 3640 3628 3608>;
			fcc_sf_x = <0 100 200 300 400 500 600 700 800 1000 1500>;
			fcc_sf_y = <100 96 94 92 90 88 87 84 81 75 50>;
			fcc_sf_cols = <11>;
			pc_sf_rows = <1>;
			pc_sf_cols = <1>;
			pc_sf_row_entries = <0>;
			pc_sf_percent = <100>;
			pc_sf_sf = <100>;
			rbatt_sf_rows = <28>;
			rbatt_sf_cols = <6>;
			rbatt_sf_percent = <100 95 90 85 80 75 70 65 60 55 50 45 40 35 30 25 20 15 10 9 8 7 6 5 4 3 2 1>;
			rbatt_sf_sf = <
			               1496 731 397 144 112 101
			               1505 746 405 146 112 102
			               1491 760 413 150 115 103
			               1492 768 412 154 117 104
			               1457 791 436 159 119 106
			               1415 761 435 166 123 108
			               1405 748 422 176 129 111
			               1404 750 411 180 136 116
			               1409 745 406 158 122 109
			               1428 752 401 148 114 104
			               1467 776 402 148 113 103
			               1517 814 407 152 115 103
			               1573 865 426 158 118 105
			               1639 921 456 162 123 109
			               1726 985 486 163 118 105
			               1842 1064 519 159 116 104
			               2014 1176 562 161 119 105
			               2351 1410 645 164 120 106
			               4325 1700 629 160 119 107
			               4908 1871 663 162 120 108
			               5747 2097 713 165 121 108
			               6809 2413 760 174 126 111
			               8361 2911 836 188 126 109
			               11218 3555 968 213 127 109
			               20231 4687 1188 259 153 129
			               37535 6803 1413 233 170 120
			               64064 11085 1910 257 158 144
			               99151 24280 3157 224 175 121
			              >;
			pc_temp_ocv_rows = <29>;
			pc_temp_ocv_cols = <6>;
			pc_temp_ocv_percent = <100 95 90 85 80 75 70 65 60 55 50 45 40 35 30 25 20 15 10 9 8 7 6 5 4 3 2 1>;
			pc_temp_ocv_ocv = <
			                   4321 4320 4317 4310 4305 4299
			                   4244 4255 4255 4251 4246 4241
			                   4177 4196 4198 4194 4190 4185
			                   4125 4139 4138 4139 4135 4130
			                   4064 4090 4089 4086 4083 4079
			                   3999 4027 4037 4037 4035 4032
			                   3944 3970 3984 3992 3991 3988
			                   3898 3923 3935 3949 3950 3947
			                   3857 3878 3893 3900 3902 3901
			                   3824 3840 3856 3862 3864 3862
			                   3799 3811 3825 3835 3836 3834
			                   3777 3789 3800 3813 3815 3812
			                   3756 3771 3782 3796 3797 3794
			                   3738 3755 3768 3781 3782 3779
			                   3721 3739 3755 3764 3761 3753
			                   3703 3720 3738 3744 3738 3727
			                   3683 3693 3713 3723 3718 3706
			                   3658 3663 3680 3693 3690 3678
			                   3616 3630 3648 3665 3661 3650
			                   3601 3619 3643 3660 3657 3646
			                   3587 3608 3637 3653 3651 3641
			                   3571 3594 3628 3646 3644 3634
			                   3551 3580 3615 3633 3630 3619
			                   3526 3557 3595 3608 3603 3590
			                   3492 3525 3564 3571 3563 3551
			                   3457 3484 3511 3518 3512 3500
			                   3391 3411 3438 3451 3444 3434
			                   3307 3318 3344 3354 3351 3342
			                   3200 3200 3200 3200 3200 3200
			                  >;
		};
};
