/* DO NOT EDIT - Automatically generated by python */
/ {
		scudatl_4980_39k_4400:scudatl_4980_39k_4400 {
			fcc = <4980>;
			default_rbatt_mohm = <100>;
			identify_type = "id_volt";
			id_identify_min = <1235>;
			id_identify_max = <1759>;
			id_voltage_min = <1420>;
			id_voltage_max = <1562>;
			vbat_max = <4400>;
			temp_para = 
						"-32767","0","-1","0","4100","0",
						"0","5","-1","498","4400","0",
						"5","10","-1","1494","4400","3",
						"10","45","-1","-1","4400","3",
						"45","50","-1","1743","4100","3",
						"50","32767","-1","0","4100","0";
			vbat_para = 
						"-32767","3400","-1","820","0",
						"3400","32767","-1","-1","0";
			segment_para = 
						"-32767","4150","4980","4208","50",
						"4150","4450","3486","4400","0";
			batt_brand = "scudatl";
			fcc_temp = <5052 5056 5060 5080 5067 5028>;
			fcc_sf_x = <0 100 200 300 400 500 600 700 800 1000 1500>;
			fcc_sf_y = <100 96 94 92 90 88 87 84 81 75 50>;
			fcc_sf_cols = <11>;
			pc_sf_rows = <1>;
			pc_sf_cols = <1>;
			pc_sf_row_entries = <0>;
			pc_sf_percent = <100>;
			pc_sf_sf = <100>;
			rbatt_sf_rows = <28>;
			rbatt_sf_cols = <6>;
			rbatt_sf_percent = <100 95 90 85 80 75 70 65 60 55 50 45 40 35 30 25 20 15 10 9 8 7 6 5 4 3 2 1>;
			rbatt_sf_sf = <
			               1602 929 379 101 82 75
			               1600 929 379 101 82 75
			               1487 923 377 102 82 76
			               1383 891 373 103 84 76
			               1319 858 376 106 85 77
			               1266 850 381 110 88 78
			               1156 772 389 116 91 80
			               1146 740 346 124 95 83
			               1131 729 331 129 102 87
			               1122 721 321 105 89 80
			               1143 716 316 98 82 76
			               1172 749 321 98 82 76
			               1212 793 327 100 84 78
			               1242 833 353 103 87 80
			               1290 884 388 104 88 81
			               1345 946 426 102 84 77
			               1417 1008 470 100 82 77
			               1511 1084 537 101 83 77
			               2178 1040 452 100 84 77
			               2345 1115 471 100 84 78
			               2531 1220 504 100 85 79
			               2744 1349 543 101 84 80
			               2942 1480 597 102 85 79
			               3164 1614 662 102 85 78
			               3406 1787 738 101 84 78
			               3774 1976 809 102 85 78
			               4242 2282 958 109 86 80
			               4955 2719 1219 141 94 83
			              >;
			pc_temp_ocv_rows = <29>;
			pc_temp_ocv_cols = <6>;
			pc_temp_ocv_percent = <100 95 90 85 80 75 70 65 60 55 50 45 40 35 30 25 20 15 10 9 8 7 6 5 4 3 2 1>;
			pc_temp_ocv_ocv = <
			                   4390 4388 4385 4378 4373 4366
			                   4288 4302 4312 4316 4313 4307
			                   4216 4236 4249 4257 4255 4250
			                   4153 4175 4191 4199 4197 4193
			                   4100 4116 4137 4143 4141 4137
			                   4047 4068 4086 4089 4088 4084
			                   3961 3992 4032 4040 4038 4034
			                   3920 3938 3964 3990 3990 3989
			                   3881 3899 3919 3946 3948 3947
			                   3845 3861 3879 3892 3895 3893
			                   3824 3827 3845 3856 3856 3856
			                   3807 3809 3818 3830 3831 3830
			                   3792 3796 3798 3809 3810 3809
			                   3778 3785 3786 3791 3793 3791
			                   3763 3773 3777 3776 3776 3772
			                   3749 3758 3765 3760 3754 3742
			                   3734 3739 3746 3741 3732 3719
			                   3715 3717 3719 3714 3708 3694
			                   3691 3695 3691 3690 3683 3671
			                   3684 3689 3687 3689 3682 3670
			                   3674 3683 3684 3687 3681 3668
			                   3665 3678 3680 3685 3678 3666
			                   3652 3672 3674 3680 3674 3661
			                   3635 3657 3663 3668 3662 3645
			                   3605 3630 3636 3633 3628 3608
			                   3562 3582 3587 3580 3577 3557
			                   3499 3513 3517 3509 3509 3489
			                   3398 3407 3414 3404 3409 3390
			                   3200 3200 3200 3200 3200 3200
			                  >;
		};
};
