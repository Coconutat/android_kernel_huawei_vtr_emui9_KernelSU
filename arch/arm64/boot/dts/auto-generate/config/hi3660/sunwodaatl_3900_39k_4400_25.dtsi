/* DO NOT EDIT - Automatically generated by python */
/ {
		sunwodaatl_3900_39k_4400_25:sunwodaatl_3900_39k_4400_25 {
			fcc = <3900>;
			default_rbatt_mohm = <100>;
			identify_type = "id_volt";
			id_identify_min = <1235>;
			id_identify_max = <1759>;
			id_voltage_min = <1420>;
			id_voltage_max = <1562>;
			vbat_max = <4400>;
			temp_para = 
						"-32767","0","-1","0","4100","0",
						"0","5","-1","390","4400","0",
						"5","10","-1","1170","4400","3",
						"10","45","-1","-1","4400","3",
						"45","50","-1","1365","4100","3",
						"50","32767","-1","0","4100","0";
			vbat_para = 
						"-32767","3400","-1","820","0",
						"3400","32767","-1","-1","0";
			segment_para = 
						"-32767","4150","3900","4208","50",
						"4150","4450","2730","4400","0";
			batt_brand = "sunwodaatl";
			fcc_temp = <3775 3854 3848 3879 3863 3835>;
			fcc_sf_x = <0 100 200 300 400 500 600 700 800 1000 1500>;
			fcc_sf_y = <100 96 94 92 90 88 87 84 81 75 50>;
			fcc_sf_cols = <11>;
			pc_sf_rows = <1>;
			pc_sf_cols = <1>;
			pc_sf_row_entries = <0>;
			pc_sf_percent = <100>;
			pc_sf_sf = <100>;
			rbatt_sf_rows = <28>;
			rbatt_sf_cols = <6>;
			rbatt_sf_percent = <100 95 90 85 80 75 70 65 60 55 50 45 40 35 30 25 20 15 10 9 8 7 6 5 4 3 2 1>;
			rbatt_sf_sf = <
			               1749 1028 422 117 92 84
			               1649 1022 421 117 93 84
			               1523 986 420 118 93 85
			               1433 945 416 119 95 86
			               1347 944 420 122 96 87
			               1247 903 440 127 99 90
			               1198 821 430 136 103 91
			               1189 794 396 148 111 96
			               1183 781 381 141 111 97
			               1190 769 366 116 96 87
			               1216 779 364 112 92 86
			               1255 808 369 113 93 86
			               1302 850 386 116 95 87
			               1360 902 415 119 99 91
			               1431 968 454 120 99 92
			               1513 1047 503 116 93 86
			               1615 1141 568 114 91 86
			               1757 1246 660 116 92 87
			               2417 1106 600 116 93 88
			               2726 1217 575 117 94 89
			               3054 1356 624 118 95 90
			               3421 1541 694 121 94 91
			               3833 1735 770 123 96 89
			               4300 1996 882 122 94 88
			               4830 2227 987 123 94 88
			               5505 2580 1120 133 94 89
			               6400 3117 1383 145 98 91
			               7747 4001 1907 255 108 93
			              >;
			pc_temp_ocv_rows = <29>;
			pc_temp_ocv_cols = <6>;
			pc_temp_ocv_percent = <100 95 90 85 80 75 70 65 60 55 50 45 40 35 30 25 20 15 10 9 8 7 6 5 4 3 2 1>;
			pc_temp_ocv_ocv = <
			                   4312 4343 4350 4355 4349 4342
			                   4241 4282 4290 4298 4292 4286
			                   4185 4220 4233 4241 4235 4229
			                   4135 4161 4177 4184 4179 4174
			                   4079 4118 4124 4129 4124 4120
			                   4006 4063 4076 4078 4073 4069
			                   3947 3988 4016 4029 4025 4022
			                   3907 3936 3956 3981 3980 3978
			                   3870 3896 3914 3933 3933 3932
			                   3840 3857 3873 3883 3884 3882
			                   3819 3828 3840 3851 3851 3850
			                   3803 3810 3815 3827 3827 3826
			                   3790 3797 3797 3807 3808 3806
			                   3778 3786 3786 3790 3791 3789
			                   3765 3776 3777 3774 3773 3769
			                   3751 3763 3766 3757 3750 3740
			                   3737 3746 3749 3736 3729 3718
			                   3720 3722 3722 3711 3705 3694
			                   3697 3699 3694 3689 3682 3672
			                   3689 3694 3690 3688 3681 3671
			                   3681 3690 3687 3686 3680 3669
			                   3670 3685 3682 3683 3677 3666
			                   3657 3676 3675 3675 3672 3661
			                   3637 3661 3660 3651 3654 3640
			                   3607 3630 3630 3608 3617 3603
			                   3563 3582 3580 3550 3566 3554
			                   3498 3513 3510 3472 3497 3487
			                   3400 3409 3408 3353 3396 3390
			                   3200 3200 3200 3200 3200 3200
			                  >;
			vol_dec1=  <50>;
			pc_temp_ocv_ocv1 = <
			                   4288 4318 4325 4330 4324 4317
			                   4201 4259 4268 4274 4268 4262
			                   4147 4195 4213 4218 4212 4207
			                   4089 4145 4157 4163 4158 4153
			                   4031 4105 4110 4111 4105 4102
			                   3975 4036 4059 4062 4057 4053
			                   3925 3971 3997 4013 4010 4008
			                   3887 3926 3945 3969 3969 3966
			                   3856 3885 3903 3917 3918 3917
			                   3831 3850 3865 3875 3875 3874
			                   3812 3824 3835 3846 3846 3845
			                   3798 3807 3811 3823 3823 3822
			                   3786 3795 3795 3804 3805 3803
			                   3774 3785 3785 3788 3789 3786
			                   3761 3774 3776 3772 3770 3765
			                   3748 3761 3764 3755 3748 3737
			                   3735 3743 3746 3734 3727 3716
			                   3718 3721 3721 3709 3703 3692
			                   3694 3698 3694 3689 3682 3672
			                   3686 3694 3690 3688 3681 3670
			                   3677 3689 3686 3686 3679 3669
			                   3666 3684 3682 3682 3677 3666
			                   3652 3674 3673 3673 3671 3659
			                   3631 3658 3658 3647 3651 3638
			                   3600 3627 3626 3603 3613 3600
			                   3554 3579 3576 3545 3562 3550
			                   3490 3509 3507 3468 3494 3484
			                   3394 3406 3405 3349 3393 3388
			                   3200 3200 3200 3200 3200 3200
			                  >;
			vol_dec2=  <200>;
			pc_temp_ocv_ocv2 = <
			                   4137 4168 4175 4180 4174 4167
			                   3986 4129 4139 4132 4128 4123
			                   3964 4083 4101 4088 4084 4080
			                   3932 4026 4054 4047 4043 4038
			                   3891 3970 4000 4004 4003 4001
			                   3863 3929 3952 3968 3968 3965
			                   3841 3895 3915 3922 3924 3923
			                   3821 3861 3879 3882 3883 3882
			                   3803 3835 3849 3855 3855 3855
			                   3789 3817 3825 3833 3834 3833
			                   3778 3803 3807 3815 3816 3815
			                   3769 3794 3794 3800 3801 3799
			                   3759 3785 3785 3786 3788 3785
			                   3750 3776 3777 3773 3771 3766
			                   3739 3765 3768 3758 3752 3741
			                   3728 3751 3755 3742 3734 3723
			                   3714 3732 3734 3722 3715 3703
			                   3694 3713 3711 3697 3691 3682
			                   3661 3692 3689 3687 3681 3670
			                   3650 3688 3685 3685 3679 3668
			                   3637 3683 3682 3682 3676 3666
			                   3621 3675 3675 3674 3671 3660
			                   3602 3663 3663 3653 3656 3642
			                   3576 3639 3641 3618 3628 3613
			                   3543 3603 3605 3573 3588 3574
			                   3497 3553 3554 3518 3538 3526
			                   3440 3485 3485 3441 3471 3463
			                   3345 3386 3387 3328 3375 3372
			                   3200 3200 3200 3200 3200 3200
			                  >;
		};
};
