/*
 * Hisilicon Ltd. SoC
 *
 * Copyright (C) 2012-2013 Hisilicon Ltd.
 *
 * This program is free software; you can redistribute it and/or modify
 * it under the terms of the GNU General Public License version 2 as
 * publishhed by the Free Software Foundation.
 */

  /{
        syscounter:syscounter@0xFFF08000 {
            compatible = "hisilicon,syscounter-driver";
            reg = <0x0 0xFFF08000 0x0 0x2000>;
            clock-rate = <0 1920000>;
            sync-interval = <3600000>;
        };
  };
