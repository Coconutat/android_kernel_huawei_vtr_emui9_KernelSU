/* DO NOT EDIT - Automatically generated by python */
/ {
		desaysony_4200_110k_4450:desaysony_4200_110k_4450 {
			fcc = <4200>;
			default_rbatt_mohm = <100>;
			identify_type = "id_volt";
			id_identify_min = <2281>;
			id_identify_max = <2786>;
			id_voltage_min = <2426>;
			id_voltage_max = <2631>;
			vbat_max = <4450>;
			temp_para = 
						"-32767","0","-1","0","4100","0",
						"0","5","-1","420","4450","0",
						"5","10","-1","1260","4450","3",
						"10","45","-1","-1","4450","3",
						"45","50","-1","1470","4100","3",
						"50","32767","-1","0","4100","0";
			vbat_para = 
						"-32767","3400","-1","820","0",
						"3400","32767","-1","-1","0";
			segment_para = 
						"-32767","4150","4200","4208","50",
						"4150","4450","2940","4450","0";
			batt_brand = "desaysony";
			fcc_temp = <4023 4081 4132 4287 4235 4156>;
			fcc_sf_x = <0 100 200 300 400 500 600 700 800 1000 1500>;
			fcc_sf_y = <100 96 94 92 90 88 87 84 81 75 50>;
			fcc_sf_cols = <11>;
			pc_sf_rows = <1>;
			pc_sf_cols = <1>;
			pc_sf_row_entries = <0>;
			pc_sf_percent = <100>;
			pc_sf_sf = <100>;
			rbatt_sf_rows = <28>;
			rbatt_sf_cols = <6>;
			rbatt_sf_percent = <100 95 90 85 80 75 70 65 60 55 50 45 40 35 30 25 20 15 10 9 8 7 6 5 4 3 2 1>;
			rbatt_sf_sf = <
			               1711 934 472 148 113 102
			               1711 934 472 148 113 102
			               1650 939 481 151 116 103
			               1593 923 475 156 119 105
			               1541 914 469 165 124 108
			               1514 898 461 175 133 113
			               1483 885 456 173 141 120
			               1463 871 449 150 123 110
			               1458 863 445 144 113 103
			               1463 860 445 147 114 103
			               1473 858 449 152 119 106
			               1487 859 451 156 123 111
			               1513 860 449 152 116 105
			               1561 881 434 147 117 108
			               1629 920 424 144 117 110
			               1712 975 445 153 123 114
			               1820 1044 494 177 152 140
			               1968 1120 518 200 170 159
			               2277 1242 611 350 311 184
			               2391 1272 641 368 338 262
			               2506 1303 803 390 357 341
			               2620 1573 860 414 367 359
			               3284 1700 914 442 391 373
			               3671 1849 1005 470 414 401
			               3881 2052 1113 512 462 439
			               4292 2325 1242 566 515 479
			               4893 2672 1449 625 571 569
			               5718 3206 1732 710 691 698
			              >;
			pc_temp_ocv_rows = <29>;
			pc_temp_ocv_cols = <6>;
			pc_temp_ocv_percent = <100 95 90 85 80 75 70 65 60 55 50 45 40 35 30 25 20 15 10 9 8 7 6 5 4 3 2 1>;
			pc_temp_ocv_ocv = <
			                   4426 4425 4424 4416 4408 4398
			                   4299 4325 4336 4345 4339 4332
			                   4222 4259 4277 4287 4283 4277
			                   4160 4196 4217 4229 4226 4221
			                   4098 4138 4157 4171 4169 4165
			                   4044 4081 4098 4113 4114 4112
			                   3987 4025 4042 4053 4058 4058
			                   3934 3969 3985 3990 3994 3995
			                   3888 3921 3936 3940 3943 3945
			                   3849 3879 3895 3901 3904 3907
			                   3815 3842 3860 3867 3871 3874
			                   3784 3808 3827 3834 3839 3842
			                   3758 3777 3795 3798 3798 3791
			                   3737 3753 3761 3758 3758 3753
			                   3716 3732 3729 3718 3717 3710
			                   3692 3711 3705 3685 3685 3682
			                   3663 3684 3681 3646 3648 3642
			                   3624 3633 3618 3582 3584 3578
			                   3558 3531 3517 3494 3495 3498
			                   3539 3505 3495 3477 3478 3477
			                   3520 3479 3471 3459 3460 3455
			                   3502 3448 3449 3441 3441 3436
			                   3473 3420 3427 3420 3420 3415
			                   3430 3393 3403 3396 3396 3391
			                   3378 3365 3375 3369 3369 3364
			                   3331 3334 3341 3338 3337 3332
			                   3289 3295 3303 3300 3299 3297
			                   3246 3253 3255 3254 3254 3254
			                   3200 3200 3200 3200 3200 3200
			                  >;
		};
};
