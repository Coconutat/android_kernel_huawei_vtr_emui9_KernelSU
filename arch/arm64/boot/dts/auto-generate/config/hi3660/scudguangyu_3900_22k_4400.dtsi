/* DO NOT EDIT - Automatically generated by python */
/ {
		scudguangyu_3900_22k_4400:scudguangyu_3900_22k_4400 {
			fcc = <3900>;
			default_rbatt_mohm = <100>;
			identify_type = "id_volt";
			id_identify_min = <751>;
			id_identify_max = <1235>;
			id_voltage_min = <939>;
			id_voltage_max = <1059>;
			vbat_max = <4400>;
			temp_para = 
						"-32767","0","-1","0","4100","0",
						"0","5","-1","390","4400","0",
						"5","10","-1","1170","4400","3",
						"10","45","-1","-1","4400","3",
						"45","50","-1","1365","4100","3",
						"50","32767","-1","0","4100","0";
			vbat_para = 
						"-32767","3400","-1","820","0",
						"3400","32767","-1","-1","0";
			segment_para = 
						"-32767","4150","3900","4208","50",
						"4150","4450","2730","4400","0";
			batt_brand = "scudguangyu";
			fcc_temp = <3974 3976 3974 4005 3968 3942>;
			fcc_sf_x = <0 100 200 300 400 500 600 700 800 1000 1500>;
			fcc_sf_y = <100 96 94 92 90 88 87 84 81 75 50>;
			fcc_sf_cols = <11>;
			pc_sf_rows = <1>;
			pc_sf_cols = <1>;
			pc_sf_row_entries = <0>;
			pc_sf_percent = <100>;
			pc_sf_sf = <100>;
			rbatt_sf_rows = <28>;
			rbatt_sf_cols = <6>;
			rbatt_sf_percent = <100 95 90 85 80 75 70 65 60 55 50 45 40 35 30 25 20 15 10 9 8 7 6 5 4 3 2 1>;
			rbatt_sf_sf = <
			               1904 1174 564 117 73 59
			               1903 1174 564 117 73 59
			               1799 1152 567 117 73 59
			               1715 1069 567 118 74 60
			               1676 1120 573 120 77 62
			               1446 1072 614 125 79 63
			               1414 910 501 134 82 65
			               1380 900 493 144 88 68
			               1377 874 478 147 97 73
			               1404 861 449 120 90 73
			               1467 894 437 105 72 60
			               1561 964 456 105 72 61
			               1676 1070 510 108 75 62
			               1790 1195 602 110 79 66
			               1888 1311 727 110 80 67
			               1969 1392 864 111 72 60
			               2055 1451 989 116 71 60
			               2169 1519 1110 129 73 60
			               3540 1615 854 117 77 63
			               3792 1765 952 121 75 62
			               4036 1937 1064 125 74 60
			               4309 2085 1151 131 76 61
			               4599 2296 1307 137 75 64
			               4887 2459 1437 135 74 62
			               5218 2657 1541 149 76 63
			               5634 2864 1658 164 80 65
			               6167 3169 1929 254 83 64
			               6914 3709 2331 894 100 79
			              >;
			pc_temp_ocv_rows = <29>;
			pc_temp_ocv_cols = <6>;
			pc_temp_ocv_percent = <100 95 90 85 80 75 70 65 60 55 50 45 40 35 30 25 20 15 10 9 8 7 6 5 4 3 2 1>;
			pc_temp_ocv_ocv = <
			                   4380 4378 4376 4372 4362 4359
			                   4239 4262 4278 4294 4286 4284
			                   4167 4193 4212 4234 4226 4224
			                   4114 4118 4156 4177 4169 4168
			                   4079 4094 4100 4122 4115 4113
			                   3973 4048 4063 4071 4063 4062
			                   3928 3955 3980 4017 4012 4015
			                   3880 3913 3937 3971 3973 3972
			                   3845 3868 3894 3933 3933 3933
			                   3824 3831 3852 3883 3886 3888
			                   3811 3813 3819 3846 3846 3846
			                   3800 3802 3801 3821 3822 3822
			                   3788 3793 3791 3801 3803 3802
			                   3775 3782 3783 3786 3788 3786
			                   3761 3771 3773 3773 3773 3770
			                   3746 3757 3760 3760 3753 3742
			                   3731 3741 3743 3740 3733 3721
			                   3712 3723 3722 3712 3707 3697
			                   3688 3702 3694 3689 3682 3671
			                   3681 3696 3689 3688 3681 3670
			                   3673 3691 3685 3686 3680 3669
			                   3663 3685 3678 3682 3678 3667
			                   3652 3678 3671 3675 3673 3662
			                   3635 3664 3659 3650 3658 3648
			                   3608 3638 3634 3606 3621 3613
			                   3569 3592 3591 3546 3570 3565
			                   3508 3524 3525 3469 3501 3499
			                   3408 3418 3428 3389 3397 3401
			                   3200 3200 3200 3200 3200 3200
			                  >;
		};
};
