/* DO NOT EDIT - Automatically generated by python */
/ {
		scudlgc_3100_200k_4400_25:scudlgc_3100_200k_4400_25 {
			fcc = <3100>;
			default_rbatt_mohm = <100>;
			identify_type = "id_volt";
			id_identify_min = <2786>;
			id_identify_max = <3312>;
			id_voltage_min = <2941>;
			id_voltage_max = <3167>;
			vbat_max = <4400>;
			temp_para = 
						"-32767","0","-1","0","4100","0",
						"0","5","-1","310","4400","0",
						"5","10","-1","930","4400","3",
						"10","45","-1","-1","4400","3",
						"45","50","-1","1085","4100","3",
						"50","32767","-1","0","4100","0";
			vbat_para = 
						"-32767","3400","-1","820","0",
						"3400","32767","-1","-1","0";
			segment_para = 
						"-32767","4150","3100","4208","50",
						"4150","4450","2170","4400","0";
			batt_brand = "scudlgc";
			fcc_temp = <3064 3063 3053 3098 3038 3025>;
			fcc_sf_x = <0 100 200 300 400 500 600 700 800 1000 1500>;
			fcc_sf_y = <100 96 94 92 90 88 87 84 81 75 50>;
			fcc_sf_cols = <11>;
			pc_sf_rows = <1>;
			pc_sf_cols = <1>;
			pc_sf_row_entries = <0>;
			pc_sf_percent = <100>;
			pc_sf_sf = <100>;
			rbatt_sf_rows = <28>;
			rbatt_sf_cols = <6>;
			rbatt_sf_percent = <100 95 90 85 80 75 70 65 60 55 50 45 40 35 30 25 20 15 10 9 8 7 6 5 4 3 2 1>;
			rbatt_sf_sf = <
			               2303 1316 559 138 85 70
			               2269 1306 561 138 85 70
			               2108 1264 567 137 86 71
			               2017 1245 577 140 89 72
			               1949 1237 610 146 93 75
			               1760 1126 657 157 98 77
			               1720 1069 535 170 103 81
			               1705 1057 526 178 113 86
			               1705 1044 515 165 117 90
			               1719 1043 496 133 93 77
			               1780 1068 492 123 85 71
			               1881 1141 493 123 87 72
			               2010 1259 527 127 90 75
			               2162 1414 590 131 95 80
			               2318 1578 696 131 95 80
			               2473 1740 840 126 86 72
			               2620 1877 1016 126 85 72
			               2787 2004 1235 132 87 74
			               3374 2080 1328 124 89 73
			               4626 2085 929 128 91 77
			               5156 2362 1094 131 90 71
			               5573 2661 1233 139 89 75
			               5989 2913 1393 139 87 72
			               6471 3193 1559 144 87 77
			               6947 3465 1713 150 90 78
			               7489 3754 1920 170 95 79
			               8090 4070 2200 236 99 78
			               8983 4670 2632 575 107 87
			              >;
			pc_temp_ocv_rows = <29>;
			pc_temp_ocv_cols = <6>;
			pc_temp_ocv_percent = <100 95 90 85 80 75 70 65 60 55 50 45 40 35 30 25 20 15 10 9 8 7 6 5 4 3 2 1>;
			pc_temp_ocv_ocv = <
			                   4354 4353 4349 4351 4331 4327
			                   4239 4254 4265 4288 4271 4267
			                   4161 4179 4200 4231 4214 4211
			                   4104 4120 4142 4175 4159 4157
			                   4052 4071 4093 4121 4107 4104
			                   3966 3995 4048 4072 4057 4054
			                   3919 3941 3970 4021 4010 4009
			                   3877 3899 3929 3970 3969 3967
			                   3842 3860 3888 3927 3926 3925
			                   3815 3828 3850 3880 3877 3877
			                   3799 3806 3820 3847 3844 3844
			                   3786 3793 3799 3822 3821 3821
			                   3775 3783 3788 3803 3802 3801
			                   3763 3774 3779 3786 3787 3785
			                   3751 3763 3770 3772 3770 3767
			                   3739 3752 3759 3758 3751 3739
			                   3724 3737 3741 3738 3731 3718
			                   3705 3721 3719 3710 3705 3691
			                   3678 3701 3697 3688 3681 3670
			                   3670 3693 3688 3687 3680 3669
			                   3663 3685 3683 3685 3679 3668
			                   3653 3679 3677 3682 3677 3665
			                   3639 3669 3668 3673 3671 3659
			                   3622 3655 3653 3649 3655 3639
			                   3598 3630 3626 3605 3620 3601
			                   3561 3588 3585 3547 3571 3551
			                   3501 3520 3524 3471 3505 3482
			                   3404 3418 3429 3365 3407 3381
			                   3200 3200 3200 3200 3200 3200
			                  >;
		};
};
