/* DO NOT EDIT - Automatically generated by python */
/ {
		scudatl_3650_39k_4400:scudatl_3650_39k_4400 {
			fcc = <3650>;
			default_rbatt_mohm = <100>;
			identify_type = "id_volt";
			id_identify_min = <1235>;
			id_identify_max = <1759>;
			id_voltage_min = <1420>;
			id_voltage_max = <1562>;
			vbat_max = <4400>;
			temp_para = 
						"-32767","0","-1","0","4100","0",
						"0","5","-1","365","4400","0",
						"5","10","-1","1095","4400","3",
						"10","45","-1","-1","4400","3",
						"45","50","-1","1277","4100","3",
						"50","32767","-1","0","4100","0";
			vbat_para = 
						"-32767","3400","-1","820","0",
						"3400","32767","-1","-1","0";
			segment_para = 
						"-32767","4150","3650","4208","50",
						"4150","4450","2555","4400","0";
			batt_brand = "scudatl";
			fcc_temp = <3708 3717 3713 3728 3722 3694>;
			fcc_sf_x = <0 100 200 300 400 500 600 700 800 1000 1500>;
			fcc_sf_y = <100 96 94 92 90 88 87 84 81 75 50>;
			fcc_sf_cols = <11>;
			pc_sf_rows = <1>;
			pc_sf_cols = <1>;
			pc_sf_row_entries = <0>;
			pc_sf_percent = <100>;
			pc_sf_sf = <100>;
			rbatt_sf_rows = <28>;
			rbatt_sf_cols = <6>;
			rbatt_sf_percent = <100 95 90 85 80 75 70 65 60 55 50 45 40 35 30 25 20 15 10 9 8 7 6 5 4 3 2 1>;
			rbatt_sf_sf = <
			               1899 1122 511 138 109 101
			               1896 1122 512 138 109 101
			               1719 1089 513 138 110 102
			               1568 1049 509 139 111 102
			               1517 1014 499 142 114 104
			               1418 1013 528 146 116 105
			               1322 895 502 155 120 109
			               1313 865 459 167 127 112
			               1298 853 440 173 134 116
			               1298 834 424 137 114 104
			               1312 842 416 131 109 102
			               1347 872 419 133 110 102
			               1397 914 431 137 113 105
			               1465 978 458 141 117 108
			               1554 1063 499 140 117 109
			               1657 1164 555 135 110 102
			               1772 1269 630 133 109 102
			               1914 1375 733 135 110 102
			               2717 1251 601 135 107 104
			               3035 1365 623 137 111 103
			               3353 1500 667 138 112 105
			               3720 1676 712 140 114 107
			               4127 1884 775 142 116 108
			               4550 2172 843 141 113 103
			               5041 2428 921 151 112 103
			               5651 2756 1064 189 118 105
			               6539 3363 1309 283 152 126
			               7519 3994 1585 322 201 130
			              >;
			pc_temp_ocv_rows = <29>;
			pc_temp_ocv_cols = <6>;
			pc_temp_ocv_percent = <100 95 90 85 80 75 70 65 60 55 50 45 40 35 30 25 20 15 10 9 8 7 6 5 4 3 2 1>;
			pc_temp_ocv_ocv = <
			                   4372 4384 4382 4376 4371 4365
			                   4284 4306 4311 4316 4312 4305
			                   4218 4239 4249 4257 4253 4247
			                   4155 4180 4190 4199 4195 4189
			                   4112 4125 4131 4142 4138 4133
			                   4044 4083 4087 4088 4084 4079
			                   3966 4001 4027 4038 4034 4030
			                   3922 3945 3964 3990 3988 3984
			                   3880 3901 3918 3943 3943 3940
			                   3847 3859 3877 3888 3888 3886
			                   3822 3828 3843 3853 3853 3852
			                   3806 3810 3817 3828 3828 3826
			                   3793 3796 3798 3807 3807 3805
			                   3780 3786 3786 3790 3790 3788
			                   3767 3776 3777 3774 3772 3768
			                   3754 3762 3765 3756 3749 3738
			                   3739 3744 3747 3736 3728 3716
			                   3722 3720 3721 3710 3704 3692
			                   3698 3697 3692 3688 3680 3669
			                   3692 3692 3689 3686 3679 3668
			                   3683 3688 3686 3685 3678 3666
			                   3675 3683 3683 3682 3675 3664
			                   3664 3674 3678 3676 3670 3658
			                   3645 3661 3664 3656 3654 3638
			                   3616 3632 3634 3615 3617 3600
			                   3571 3582 3584 3563 3565 3548
			                   3513 3518 3517 3497 3498 3481
			                   3412 3417 3410 3393 3400 3381
			                   3200 3200 3200 3200 3200 3200
			                  >;
		};
};
