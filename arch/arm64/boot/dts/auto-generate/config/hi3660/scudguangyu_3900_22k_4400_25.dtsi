/* DO NOT EDIT - Automatically generated by python */
/ {
		scudguangyu_3900_22k_4400_25:scudguangyu_3900_22k_4400_25 {
			fcc = <3900>;
			default_rbatt_mohm = <100>;
			identify_type = "id_volt";
			id_identify_min = <751>;
			id_identify_max = <1235>;
			id_voltage_min = <939>;
			id_voltage_max = <1059>;
			vbat_max = <4400>;
			temp_para = 
						"-32767","0","-1","0","4100","0",
						"0","5","-1","390","4400","0",
						"5","10","-1","1170","4400","3",
						"10","45","-1","-1","4400","3",
						"45","50","-1","1365","4100","3",
						"50","32767","-1","0","4100","0";
			vbat_para = 
						"-32767","3400","-1","820","0",
						"3400","32767","-1","-1","0";
			segment_para = 
						"-32767","4150","3900","4208","50",
						"4150","4450","2730","4400","0";
			batt_brand = "scudguangyu";
			fcc_temp = <3939 3934 3923 3941 3903 3877>;
			fcc_sf_x = <0 100 200 300 400 500 600 700 800 1000 1500>;
			fcc_sf_y = <100 96 94 92 90 88 87 84 81 75 50>;
			fcc_sf_cols = <11>;
			pc_sf_rows = <1>;
			pc_sf_cols = <1>;
			pc_sf_row_entries = <0>;
			pc_sf_percent = <100>;
			pc_sf_sf = <100>;
			rbatt_sf_rows = <28>;
			rbatt_sf_cols = <6>;
			rbatt_sf_percent = <100 95 90 85 80 75 70 65 60 55 50 45 40 35 30 25 20 15 10 9 8 7 6 5 4 3 2 1>;
			rbatt_sf_sf = <
			               1904 1174 564 117 73 59
			               1885 1170 565 117 73 59
			               1785 1134 567 117 74 59
			               1712 1079 567 119 75 61
			               1641 1114 585 122 77 62
			               1442 1043 590 127 79 64
			               1410 909 499 136 83 66
			               1379 896 491 147 91 69
			               1379 871 473 141 96 74
			               1410 864 446 116 86 70
			               1475 901 439 105 72 60
			               1570 973 461 106 72 61
			               1684 1080 518 108 75 63
			               1797 1205 612 109 80 66
			               1892 1317 738 110 79 66
			               1973 1395 872 111 72 60
			               2058 1454 995 117 72 60
			               2173 1522 1116 129 73 60
			               3564 1631 864 117 78 63
			               3812 1779 964 122 74 62
			               4054 1951 1075 126 74 60
			               4327 2098 1160 132 76 62
			               4614 2308 1318 137 75 63
			               4900 2469 1444 134 74 61
			               5231 2665 1546 150 76 63
			               5647 2873 1665 165 80 65
			               6178 3179 1938 258 83 64
			               6924 3723 2338 906 103 80
			              >;
			pc_temp_ocv_rows = <29>;
			pc_temp_ocv_cols = <6>;
			pc_temp_ocv_percent = <100 95 90 85 80 75 70 65 60 55 50 45 40 35 30 25 20 15 10 9 8 7 6 5 4 3 2 1>;
			pc_temp_ocv_ocv = <
			                   4355 4353 4350 4347 4337 4334
			                   4227 4248 4262 4275 4267 4265
			                   4158 4178 4199 4217 4209 4207
			                   4109 4114 4144 4162 4154 4153
			                   4063 4087 4094 4109 4101 4100
			                   3967 4032 4046 4058 4050 4050
			                   3922 3949 3973 4006 4003 4005
			                   3875 3906 3930 3964 3965 3964
			                   3843 3863 3888 3923 3924 3924
			                   3823 3829 3847 3876 3878 3880
			                   3810 3812 3816 3842 3842 3842
			                   3800 3801 3800 3818 3819 3819
			                   3787 3792 3791 3799 3801 3800
			                   3774 3782 3782 3784 3786 3785
			                   3760 3770 3772 3772 3771 3767
			                   3745 3756 3759 3758 3751 3740
			                   3731 3740 3742 3739 3731 3719
			                   3712 3722 3721 3710 3705 3695
			                   3687 3701 3693 3689 3682 3671
			                   3680 3695 3688 3687 3681 3670
			                   3672 3691 3684 3685 3680 3669
			                   3663 3685 3678 3682 3677 3667
			                   3651 3678 3671 3674 3672 3661
			                   3634 3663 3657 3648 3656 3645
			                   3607 3636 3633 3603 3619 3610
			                   3567 3590 3589 3543 3567 3562
			                   3507 3521 3523 3466 3498 3496
			                   3407 3417 3426 3386 3395 3399
			                   3200 3200 3200 3200 3200 3200
			                  >;
			vol_dec1=  <50>;
			pc_temp_ocv_ocv1 = <
			                   4330 4328 4326 4322 4312 4309
			                   4215 4234 4246 4257 4249 4246
			                   4150 4163 4187 4201 4193 4191
			                   4105 4110 4131 4147 4139 4137
			                   4047 4080 4087 4096 4088 4086
			                   3961 4016 4030 4045 4038 4039
			                   3915 3943 3965 3996 3994 3995
			                   3871 3900 3923 3957 3957 3956
			                   3840 3857 3881 3913 3915 3915
			                   3822 3826 3842 3869 3871 3872
			                   3810 3811 3814 3838 3838 3838
			                   3799 3801 3799 3815 3816 3816
			                   3786 3791 3790 3797 3799 3798
			                   3773 3781 3781 3782 3785 3783
			                   3759 3769 3771 3771 3769 3764
			                   3745 3755 3758 3757 3750 3738
			                   3730 3739 3741 3738 3730 3718
			                   3711 3722 3720 3709 3704 3694
			                   3687 3700 3692 3689 3682 3671
			                   3680 3695 3688 3687 3681 3670
			                   3672 3690 3684 3685 3679 3669
			                   3662 3684 3677 3682 3677 3666
			                   3650 3677 3670 3673 3672 3660
			                   3633 3662 3656 3645 3654 3643
			                   3606 3634 3631 3600 3615 3607
			                   3566 3588 3587 3540 3564 3559
			                   3505 3519 3521 3464 3495 3493
			                   3406 3415 3424 3384 3392 3396
			                   3200 3200 3200 3200 3200 3200
			                  >;
			vol_dec2=  <200>;
			pc_temp_ocv_ocv2 = <
			                   4180 4178 4176 4172 4162 4159
			                   4149 4135 4160 4143 4134 4131
			                   4106 4106 4108 4107 4097 4094
			                   4057 4076 4077 4062 4052 4051
			                   3968 4011 4008 4016 4009 4010
			                   3925 3943 3958 3975 3975 3973
			                   3880 3904 3919 3945 3941 3939
			                   3847 3863 3880 3898 3900 3901
			                   3826 3831 3844 3861 3861 3862
			                   3814 3814 3817 3835 3835 3835
			                   3804 3804 3801 3815 3816 3815
			                   3793 3795 3792 3799 3800 3799
			                   3781 3786 3785 3785 3787 3785
			                   3768 3776 3776 3774 3774 3772
			                   3754 3764 3766 3764 3757 3747
			                   3741 3750 3753 3748 3740 3728
			                   3726 3735 3734 3729 3721 3709
			                   3707 3718 3715 3699 3693 3684
			                   3683 3697 3689 3687 3681 3670
			                   3676 3692 3685 3685 3680 3669
			                   3668 3687 3680 3682 3677 3667
			                   3658 3681 3673 3676 3673 3663
			                   3645 3671 3664 3658 3662 3654
			                   3626 3653 3647 3624 3635 3627
			                   3597 3623 3617 3577 3595 3590
			                   3557 3576 3572 3519 3545 3541
			                   3495 3507 3507 3449 3478 3476
			                   3397 3405 3409 3371 3378 3383
			                   3200 3200 3200 3200 3200 3200
			                  >;
		};
};
