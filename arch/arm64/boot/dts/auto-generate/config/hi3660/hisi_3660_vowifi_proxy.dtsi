        /* Copyright (c) 2012, Code Aurora Forum. All rights reserved.
 *
 * This program is free software; you can redistribute it and/or modify
 * it under the terms of the GNU General Public License version 2 and
 * only version 2 as published by the Free Software Foundation.
 *
 * This program is distributed in the hope that it will be useful,
 * but WITHOUT ANY WARRANTY; without even the implied warranty of
 * MERCHANTABILITY or FITNESS FOR A PARTICULAR PURPOSE.  See the
 * GNU General Public License for more details.
 */
/ {
	hifi_voice_proxy {
		compatible = "hisilicon,voice_proxy";
		status = "ok";

		voice_proxy_volte {
			compatible = "hisilicon,voice_proxy_volte";
			status = "ok";
		};

		voice_proxy_vowifi {
		compatible = "hisilicon,voice_proxy_vowifi";
			status = "ok";
		};
	};
};
