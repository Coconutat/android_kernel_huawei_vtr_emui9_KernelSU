/* DO NOT EDIT - Automatically generated by python */
/ {
		sunwodalg_3650_200k_4400:sunwodalg_3650_200k_4400 {
			fcc = <3650>;
			default_rbatt_mohm = <100>;
			identify_type = "id_volt";
			id_identify_min = <2786>;
			id_identify_max = <3312>;
			id_voltage_min = <2941>;
			id_voltage_max = <3167>;
			vbat_max = <4400>;
			temp_para = 
						"-32767","0","-1","0","4100","0",
						"0","5","-1","365","4400","0",
						"5","10","-1","1095","4400","3",
						"10","45","-1","-1","4400","3",
						"45","50","-1","1277","4100","3",
						"50","32767","-1","0","4100","0";
			vbat_para = 
						"-32767","3400","-1","820","0",
						"3400","32767","-1","-1","0";
			segment_para = 
						"-32767","4150","3650","4208","50",
						"4150","4450","2555","4400","0";
			batt_brand = "sunwodalg";
			fcc_temp = <3634 3639 3629 3656 3638 3619>;
			fcc_sf_x = <0 100 200 300 400 500 600 700 800 1000 1500>;
			fcc_sf_y = <100 96 94 92 90 88 87 84 81 75 50>;
			fcc_sf_cols = <11>;
			pc_sf_rows = <1>;
			pc_sf_cols = <1>;
			pc_sf_row_entries = <0>;
			pc_sf_percent = <100>;
			pc_sf_sf = <100>;
			rbatt_sf_rows = <28>;
			rbatt_sf_cols = <6>;
			rbatt_sf_percent = <100 95 90 85 80 75 70 65 60 55 50 45 40 35 30 25 20 15 10 9 8 7 6 5 4 3 2 1>;
			rbatt_sf_sf = <
			               2010 1191 578 120 80 66
			               2010 1191 578 120 80 66
			               1891 1169 586 121 80 67
			               1817 1156 585 123 82 68
			               1815 1170 570 128 85 69
			               1546 1160 659 133 87 71
			               1524 965 522 144 92 73
			               1497 955 499 153 98 77
			               1488 933 481 156 109 84
			               1515 918 464 120 87 72
			               1574 956 449 111 79 67
			               1672 1024 453 112 80 68
			               1794 1137 490 117 82 70
			               1922 1274 569 121 88 74
			               2041 1401 691 120 90 74
			               2155 1509 825 116 79 69
			               2261 1599 965 117 79 67
			               2389 1696 1125 125 80 68
			               2553 1808 1326 132 83 70
			               3670 1821 1061 128 83 70
			               4267 1946 961 124 83 69
			               4592 2173 1084 126 81 69
			               4926 2381 1213 128 83 70
			               5343 2577 1376 126 82 69
			               5634 2769 1475 133 84 70
			               6072 3005 1580 147 87 70
			               6571 3276 1811 197 89 70
			               7279 3737 2207 503 106 74
			              >;
			pc_temp_ocv_rows = <29>;
			pc_temp_ocv_cols = <6>;
			pc_temp_ocv_percent = <100 95 90 85 80 75 70 65 60 55 50 45 40 35 30 25 20 15 10 9 8 7 6 5 4 3 2 1>;
			pc_temp_ocv_ocv = <
			                   4387 4385 4380 4373 4365 4361
			                   4255 4278 4288 4308 4302 4298
			                   4173 4201 4222 4249 4244 4241
			                   4113 4140 4165 4192 4187 4184
			                   4083 4097 4101 4137 4132 4129
			                   3966 4051 4073 4084 4079 4077
			                   3924 3950 3987 4037 4030 4028
			                   3879 3906 3939 3981 3985 3984
			                   3842 3864 3894 3942 3943 3942
			                   3820 3827 3855 3888 3889 3890
			                   3804 3809 3821 3853 3853 3853
			                   3790 3796 3799 3827 3828 3827
			                   3777 3784 3787 3806 3807 3806
			                   3762 3772 3779 3789 3791 3789
			                   3748 3759 3770 3773 3774 3770
			                   3736 3746 3756 3758 3751 3742
			                   3718 3734 3737 3739 3731 3719
			                   3700 3719 3717 3711 3705 3692
			                   3670 3695 3697 3687 3681 3671
			                   3666 3690 3691 3686 3679 3668
			                   3657 3681 3683 3684 3678 3666
			                   3644 3673 3674 3680 3675 3664
			                   3629 3662 3663 3671 3669 3657
			                   3615 3645 3647 3646 3651 3637
			                   3587 3617 3619 3602 3614 3601
			                   3550 3574 3575 3544 3564 3551
			                   3491 3507 3510 3467 3496 3483
			                   3396 3406 3410 3364 3394 3382
			                   3200 3200 3200 3200 3200 3200
			                  >;
		};
};
