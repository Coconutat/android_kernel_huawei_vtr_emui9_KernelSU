/*
 * Hisilicon Ltd. SoC
 *
 * Copyright (C) 2012-2013 Hisilicon Ltd.
 * Author: nobody
 *
 * This program is free software; you can redistribute it and/or modify
 * it under the terms of the GNU General Public License version 2 as
 * publishhed by the Free Software Foundation.
 */

/{
	modem_pinctrl:modem_pinctrl {
		compatible = "arm,modem_pinctrl";
			pinctrl-names = "init","default","idle";
			/*table: gpio_group gpio_pin mux_addr mux_value cfg_addr cfg_value gpio_dir gpio_value*/
			pinctrl-0 = <
					 9         4      0x128           3        0x134      1     0xffff     0xffff
					 9         5      0x12C           3        0x138      0     0xffff     0xffff
					 9         7      0x134           1        0x140      0     0xffff     0xffff
					10         0      0x138           1        0x144      0     0xffff     0xffff
					10         1      0x13C           1        0x148      0     0xffff     0xffff
					10         2      0x140           1        0x14C      0     0xffff     0xffff
					10         3      0x144           1        0x150      0     0xffff     0xffff
					10         4      0x148           1        0x154      0     0xffff     0xffff
					10         5      0x14C           1        0x158      0     0xffff     0xffff
					10         6      0x150           1        0x15C      0     0xffff     0xffff
					11         2      0x160           2        0x16C      0     0xffff     0xffff
					11         3      0x164           2        0x170      0     0xffff     0xffff
					11         4      0x168           1        0x174      0     0xffff     0xffff
					11         5      0x16C           1        0x178      0     0xffff     0xffff
					11         6      0x170           1        0x17C      0     0xffff     0xffff
					11         7      0x174           1        0x180      0     0xffff     0xffff
					12         0      0x178           1        0x184      0     0xffff     0xffff
					12         1      0x17C           1        0x188      0     0xffff     0xffff
					12         2      0x180           1        0x18C      0     0xffff     0xffff
					12         7      0x194           1        0x1A0      0     0xffff     0xffff
					13         0      0x198           1        0x1A4      0     0xffff     0xffff
					13         1      0x19C           1        0x1A8      0     0xffff     0xffff
					13         2      0x1A0           1        0x1AC      0     0xffff     0xffff
					13         3      0x1A4           1        0x1B0      0     0xffff     0xffff
					13         4      0x1A8           1        0x1B4      0     0xffff     0xffff
					13         5      0x1AC           1        0x1B8      0     0xffff     0xffff
					13         6      0x1B0           1        0x1BC      0     0xffff     0xffff
					13         7      0x1B4           1        0x1C0      0     0xffff     0xffff
					14         0      0x1B8           1        0x1C4      0     0xffff     0xffff
					14         1      0x1BC           1        0x1C8      0     0xffff     0xffff
					14         2      0x1C0           1        0x1CC      0     0xffff     0xffff
					14         3      0x1C4           1        0x1D0      0     0xffff     0xffff
					14         4      0x1C8           1        0x1D4      0     0xffff     0xffff
					14         5      0x1CC           1        0x1D8      0     0xffff     0xffff
					14         6      0x1D0           1        0x1DC      0     0xffff     0xffff
					14         7      0x1D4           2        0x1E0      0     0xffff     0xffff
					15         0      0x1D8           2        0x1E4      2     0xffff     0xffff
					15         1      0x1DC           1        0x1E8      0     0xffff     0xffff
					15         2      0x1E0           1        0x1EC      2     0xffff     0xffff
					15         3      0x1E4           0        0x1F0      0          1          0
					15         4      0x1E8           0        0x1F4      0          1          0
					19         0      0x020           2        0x020      0     0xffff     0xffff
					19         1      0x024           2        0x024      0     0xffff     0xffff
					19         2      0x028           2        0x028      0     0xffff     0xffff
					19         3      0x02C           2        0x02C      0     0xffff     0xffff
					>;
			pinctrl-1 = <
					 9         4      0x128           3        0x134      1     0xffff     0xffff
					 9         5      0x12C           3        0x138      0     0xffff     0xffff
					 9         7      0x134           1        0x140      0     0xffff     0xffff
					10         0      0x138           1        0x144      0     0xffff     0xffff
					10         1      0x13C           1        0x148      0     0xffff     0xffff
					10         2      0x140           1        0x14C      0     0xffff     0xffff
					10         3      0x144           1        0x150      0     0xffff     0xffff
					10         4      0x148           1        0x154      0     0xffff     0xffff
					10         5      0x14C           1        0x158      0     0xffff     0xffff
					10         6      0x150           1        0x15C      0     0xffff     0xffff
					11         2      0x160           2        0x16C      0     0xffff     0xffff
					11         3      0x164           2        0x170      0     0xffff     0xffff
					11         4      0x168           1        0x174      0     0xffff     0xffff
					11         5      0x16C           1        0x178      0     0xffff     0xffff
					11         6      0x170           1        0x17C      0     0xffff     0xffff
					11         7      0x174           1        0x180      0     0xffff     0xffff
					12         0      0x178           1        0x184      0     0xffff     0xffff
					12         1      0x17C           1        0x188      0     0xffff     0xffff
					12         2      0x180           1        0x18C      0     0xffff     0xffff
					12         7      0x194           1        0x1A0      0     0xffff     0xffff
					13         0      0x198           1        0x1A4      0     0xffff     0xffff
					13         1      0x19C           1        0x1A8      0     0xffff     0xffff
					13         2      0x1A0           1        0x1AC      0     0xffff     0xffff
					13         3      0x1A4           1        0x1B0      0     0xffff     0xffff
					13         4      0x1A8           1        0x1B4      0     0xffff     0xffff
					13         5      0x1AC           1        0x1B8      0     0xffff     0xffff
					13         6      0x1B0           1        0x1BC      0     0xffff     0xffff
					13         7      0x1B4           1        0x1C0      0     0xffff     0xffff
					14         0      0x1B8           1        0x1C4      0     0xffff     0xffff
					14         1      0x1BC           1        0x1C8      0     0xffff     0xffff
					14         2      0x1C0           1        0x1CC      0     0xffff     0xffff
					14         3      0x1C4           1        0x1D0      0     0xffff     0xffff
					14         4      0x1C8           1        0x1D4      0     0xffff     0xffff
					14         5      0x1CC           1        0x1D8      0     0xffff     0xffff
					14         6      0x1D0           1        0x1DC      0     0xffff     0xffff
					14         7      0x1D4           2        0x1E0      0     0xffff     0xffff
					15         0      0x1D8           2        0x1E4      2     0xffff     0xffff
					15         1      0x1DC           1        0x1E8      0     0xffff     0xffff
					15         2      0x1E0           1        0x1EC      2     0xffff     0xffff
					15         3      0x1E4           0        0x1F0      0          1     0xffff
					15         4      0x1E8           0        0x1F4      0          1     0xffff
					19         0      0x020           2        0x020      0     0xffff     0xffff
					19         1      0x024           2        0x024      0     0xffff     0xffff
					19         2      0x028           2        0x028      0     0xffff     0xffff
					19         3      0x02C           2        0x02C      0     0xffff     0xffff
					>;
			pinctrl-2 = <
					 9         4      0x128           3        0x134      1     0xffff     0xffff
					 9         5      0x12C           3        0x138      0     0xffff     0xffff
					 9         7      0x134           1        0x140      0     0xffff     0xffff
					10         0      0x138           1        0x144      0     0xffff     0xffff
					10         1      0x13C           1        0x148      0     0xffff     0xffff
					10         2      0x140           1        0x14C      0     0xffff     0xffff
					10         3      0x144           1        0x150      0     0xffff     0xffff
					10         4      0x148           1        0x154      0     0xffff     0xffff
					10         5      0x14C           1        0x158      0     0xffff     0xffff
					10         6      0x150           1        0x15C      0     0xffff     0xffff
					11         2      0x160           2        0x16C      0     0xffff     0xffff
					11         3      0x164           2        0x170      0     0xffff     0xffff
					11         4      0x168           1        0x174      0     0xffff     0xffff
					11         5      0x16C           1        0x178      0     0xffff     0xffff
					11         6      0x170           1        0x17C      0     0xffff     0xffff
					11         7      0x174           1        0x180      0     0xffff     0xffff
					12         0      0x178           1        0x184      0     0xffff     0xffff
					12         1      0x17C           1        0x188      0     0xffff     0xffff
					12         2      0x180           1        0x18C      0     0xffff     0xffff
					12         7      0x194           1        0x1A0      0     0xffff     0xffff
					13         0      0x198           1        0x1A4      0     0xffff     0xffff
					13         1      0x19C           1        0x1A8      0     0xffff     0xffff
					13         2      0x1A0           1        0x1AC      0     0xffff     0xffff
					13         3      0x1A4           1        0x1B0      0     0xffff     0xffff
					13         4      0x1A8           1        0x1B4      0     0xffff     0xffff
					13         5      0x1AC           1        0x1B8      0     0xffff     0xffff
					13         6      0x1B0           1        0x1BC      0     0xffff     0xffff
					13         7      0x1B4           1        0x1C0      0     0xffff     0xffff
					14         0      0x1B8           1        0x1C4      0     0xffff     0xffff
					14         1      0x1BC           1        0x1C8      0     0xffff     0xffff
					14         2      0x1C0           1        0x1CC      0     0xffff     0xffff
					14         3      0x1C4           1        0x1D0      0     0xffff     0xffff
					14         4      0x1C8           1        0x1D4      0     0xffff     0xffff
					14         5      0x1CC           1        0x1D8      0     0xffff     0xffff
					14         6      0x1D0           1        0x1DC      0     0xffff     0xffff
					14         7      0x1D4           2        0x1E0      0     0xffff     0xffff
					15         0      0x1D8           2        0x1E4      2     0xffff     0xffff
					15         1      0x1DC           1        0x1E8      0     0xffff     0xffff
					15         2      0x1E0           1        0x1EC      2     0xffff     0xffff
					15         3      0x1E4           0        0x1F0      0          1     0xffff
					15         4      0x1E8           0        0x1F4      0          1     0xffff
					19         0      0x020           2        0x020      0     0xffff     0xffff
					19         1      0x024           2        0x024      0     0xffff     0xffff
					19         2      0x028           2        0x028      0     0xffff     0xffff
					19         3      0x02C           2        0x02C      0     0xffff     0xffff
					>;
			pinctrl-num   = <45 45 45>;
			status = "ok";
	};
};
