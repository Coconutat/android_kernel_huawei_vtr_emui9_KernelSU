/* DO NOT EDIT - Automatically generated by python */
/ {
		desaysony_3900_110k_4400_25:desaysony_3900_110k_4400_25 {
			fcc = <3900>;
			default_rbatt_mohm = <100>;
			identify_type = "id_volt";
			id_identify_min = <2281>;
			id_identify_max = <2786>;
			id_voltage_min = <2426>;
			id_voltage_max = <2631>;
			vbat_max = <4400>;
			temp_para = 
						"-32767","0","-1","0","4100","0",
						"0","5","-1","390","4400","0",
						"5","10","-1","1170","4400","3",
						"10","45","-1","-1","4400","3",
						"45","50","-1","1365","4100","3",
						"50","32767","-1","0","4100","0";
			vbat_para = 
						"-32767","3400","-1","820","0",
						"3400","32767","-1","-1","0";
			segment_para = 
						"-32767","4150","3900","4208","50",
						"4150","4450","2730","4400","0";
			batt_brand = "desaysony";
			fcc_temp = <3907 3911 3919 3963 3947 3922>;
			fcc_sf_x = <0 100 200 300 400 500 600 700 800 1000 1500>;
			fcc_sf_y = <100 96 94 92 90 88 87 84 81 75 50>;
			fcc_sf_cols = <11>;
			pc_sf_rows = <1>;
			pc_sf_cols = <1>;
			pc_sf_row_entries = <0>;
			pc_sf_percent = <100>;
			pc_sf_sf = <100>;
			rbatt_sf_rows = <28>;
			rbatt_sf_cols = <6>;
			rbatt_sf_percent = <100 95 90 85 80 75 70 65 60 55 50 45 40 35 30 25 20 15 10 9 8 7 6 5 4 3 2 1>;
			rbatt_sf_sf = <
			               1408 709 370 130 97 87
			               1415 714 372 131 98 87
			               1426 717 380 133 99 87
			               1405 713 385 136 101 88
			               1393 741 394 140 103 90
			               1334 737 409 146 105 91
			               1317 709 404 154 110 93
			               1311 706 395 161 117 98
			               1318 704 386 152 115 98
			               1333 705 378 136 103 91
			               1369 722 380 132 98 88
			               1417 752 389 134 99 88
			               1473 796 406 138 102 89
			               1541 849 434 144 106 93
			               1629 911 470 145 105 92
			               1746 993 511 142 101 89
			               1921 1117 562 144 102 91
			               2257 1356 655 148 103 91
			               4154 1723 653 144 101 90
			               4770 1909 702 148 103 91
			               5568 2202 767 153 105 93
			               6652 2533 849 158 105 94
			               8213 3090 997 160 108 94
			               11292 3812 1179 164 106 93
			               20265 5053 1429 170 106 94
			               39041 7119 1859 199 112 96
			               69506 13108 2862 354 144 114
			               121071 32907 5189 485 271 155
			              >;
			pc_temp_ocv_rows = <29>;
			pc_temp_ocv_cols = <6>;
			pc_temp_ocv_percent = <100 95 90 85 80 75 70 65 60 55 50 45 40 35 30 25 20 15 10 9 8 7 6 5 4 3 2 1>;
			pc_temp_ocv_ocv = <
			                   4357 4356 4355 4350 4345 4340
			                   4269 4284 4286 4284 4280 4275
			                   4203 4219 4225 4225 4221 4216
			                   4141 4156 4166 4166 4164 4159
			                   4087 4107 4110 4111 4109 4105
			                   4019 4052 4059 4059 4057 4054
			                   3960 3989 4004 4011 4010 4007
			                   3909 3937 3953 3965 3966 3964
			                   3867 3891 3906 3917 3920 3919
			                   3831 3850 3865 3874 3876 3875
			                   3804 3819 3831 3842 3844 3843
			                   3781 3795 3805 3818 3820 3818
			                   3760 3777 3785 3799 3801 3799
			                   3740 3760 3770 3782 3785 3782
			                   3721 3744 3756 3766 3765 3759
			                   3702 3726 3741 3746 3742 3731
			                   3681 3702 3718 3724 3720 3709
			                   3656 3667 3682 3694 3692 3682
			                   3619 3630 3642 3664 3663 3653
			                   3606 3618 3635 3659 3658 3648
			                   3590 3607 3628 3653 3653 3643
			                   3574 3594 3618 3645 3646 3637
			                   3557 3581 3606 3632 3635 3625
			                   3533 3561 3588 3606 3610 3599
			                   3501 3532 3556 3563 3568 3559
			                   3455 3484 3503 3507 3514 3507
			                   3410 3410 3434 3443 3446 3441
			                   3296 3326 3342 3356 3359 3351
			                   3200 3200 3200 3200 3200 3200
			                  >;
			vol_dec1=  <50>;
			pc_temp_ocv_ocv1 = <
			                   4332 4331 4330 4325 4320 4315
			                   4253 4265 4266 4263 4259 4254
			                   4187 4199 4207 4205 4202 4197
			                   4130 4142 4148 4148 4146 4142
			                   4073 4094 4096 4095 4093 4090
			                   4007 4036 4045 4045 4044 4041
			                   3950 3977 3991 3999 3999 3996
			                   3901 3927 3942 3954 3956 3954
			                   3861 3882 3897 3906 3909 3908
			                   3827 3844 3858 3867 3868 3867
			                   3801 3815 3826 3837 3839 3838
			                   3778 3792 3801 3815 3816 3815
			                   3757 3774 3783 3796 3798 3796
			                   3738 3759 3768 3780 3783 3780
			                   3719 3743 3755 3764 3763 3755
			                   3700 3725 3739 3744 3740 3729
			                   3680 3700 3716 3722 3718 3707
			                   3655 3666 3680 3692 3690 3680
			                   3617 3628 3641 3663 3662 3652
			                   3604 3617 3634 3658 3657 3648
			                   3589 3606 3626 3652 3652 3643
			                   3573 3592 3617 3644 3644 3636
			                   3555 3579 3605 3630 3632 3623
			                   3532 3559 3586 3603 3606 3596
			                   3499 3530 3553 3559 3564 3556
			                   3453 3481 3500 3504 3510 3504
			                   3409 3406 3432 3441 3443 3438
			                   3295 3325 3339 3354 3357 3349
			                   3200 3200 3200 3200 3200 3200
			                  >;
			vol_dec2=  <200>;
			pc_temp_ocv_ocv2 = <
			                   4182 4181 4180 4175 4170 4165
			                   4153 4149 4141 4139 4136 4131
			                   4111 4106 4100 4095 4091 4087
			                   4048 4059 4055 4050 4047 4044
			                   3991 4000 4007 4009 4007 4004
			                   3940 3953 3961 3969 3968 3966
			                   3897 3910 3919 3928 3929 3928
			                   3860 3870 3880 3887 3888 3887
			                   3828 3838 3848 3855 3855 3854
			                   3804 3813 3821 3831 3832 3831
			                   3782 3793 3800 3812 3814 3812
			                   3763 3776 3783 3796 3798 3796
			                   3745 3762 3770 3782 3785 3781
			                   3728 3748 3758 3768 3768 3762
			                   3710 3733 3746 3751 3747 3736
			                   3693 3715 3729 3732 3727 3716
			                   3673 3687 3703 3711 3708 3698
			                   3647 3655 3667 3680 3679 3669
			                   3607 3617 3634 3657 3657 3647
			                   3593 3607 3627 3652 3652 3642
			                   3579 3595 3618 3645 3645 3636
			                   3563 3584 3608 3634 3636 3626
			                   3545 3568 3595 3614 3617 3607
			                   3521 3545 3573 3581 3584 3575
			                   3486 3511 3534 3537 3541 3535
			                   3440 3460 3479 3484 3488 3485
			                   3392 3388 3416 3426 3426 3422
			                   3287 3319 3326 3343 3342 3338
			                   3200 3200 3200 3200 3200 3200
			                  >;
		};
};
