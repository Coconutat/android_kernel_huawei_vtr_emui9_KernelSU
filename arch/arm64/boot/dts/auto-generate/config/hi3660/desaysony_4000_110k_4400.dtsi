/* DO NOT EDIT - Automatically generated by python */
/ {
		desaysony_4000_110k_4400:desaysony_4000_110k_4400 {
			fcc = <4000>;
			default_rbatt_mohm = <100>;
			identify_type = "id_volt";
			id_identify_min = <2281>;
			id_identify_max = <2786>;
			id_voltage_min = <2426>;
			id_voltage_max = <2631>;
			vbat_max = <4400>;
			temp_para = 
						"-32767","0","-1","0","4100","0",
						"0","5","-1","400","4400","0",
						"5","10","-1","1200","4400","3",
						"10","45","-1","-1","4400","3",
						"45","50","-1","1400","4100","3",
						"50","32767","-1","0","4100","0";
			vbat_para = 
						"-32767","3400","-1","820","0",
						"3400","32767","-1","-1","0";
			segment_para = 
						"-32767","4150","4000","4208","50",
						"4150","4450","2800","4400","0";
			batt_brand = "desaysony";
			fcc_temp = <4141 4152 4167 4231 4210 4182>;
			fcc_sf_x = <0 100 200 300 400 500 600 700 800 1000 1500>;
			fcc_sf_y = <100 96 94 92 90 88 87 84 81 75 50>;
			fcc_sf_cols = <11>;
			pc_sf_rows = <1>;
			pc_sf_cols = <1>;
			pc_sf_row_entries = <0>;
			pc_sf_percent = <100>;
			pc_sf_sf = <100>;
			rbatt_sf_rows = <28>;
			rbatt_sf_cols = <6>;
			rbatt_sf_percent = <100 95 90 85 80 75 70 65 60 55 50 45 40 35 30 25 20 15 10 9 8 7 6 5 4 3 2 1>;
			rbatt_sf_sf = <
			               1382 711 397 153 114 102
			               1382 711 397 153 114 102
			               1388 725 409 156 116 103
			               1368 730 412 160 117 104
			               1349 730 418 164 120 105
			               1340 743 425 168 123 107
			               1283 715 428 176 128 110
			               1293 711 409 183 134 114
			               1291 714 397 176 134 114
			               1306 719 394 160 122 108
			               1337 733 396 154 116 104
			               1383 766 402 156 117 105
			               1445 816 420 161 121 107
			               1526 877 452 167 125 110
			               1634 957 493 170 123 109
			               1782 1072 548 167 120 107
			               2009 1241 622 172 122 110
			               2468 1512 762 179 124 112
			               5188 2368 849 177 123 109
			               5954 2683 937 181 126 110
			               6946 3106 1064 187 130 111
			               8237 3654 1251 196 129 114
			               10662 4386 1459 207 131 115
			               18192 5440 1771 222 131 113
			               37004 7072 2213 277 143 114
			               73612 11303 3026 380 198 137
			               133041 28505 4673 417 220 158
			               229287 53592 8782 299 205 138
			              >;
			pc_temp_ocv_rows = <29>;
			pc_temp_ocv_cols = <6>;
			pc_temp_ocv_percent = <100 95 90 85 80 75 70 65 60 55 50 45 40 35 30 25 20 15 10 9 8 7 6 5 4 3 2 1>;
			pc_temp_ocv_ocv = <
			                   4386 4384 4381 4374 4369 4364
			                   4292 4302 4303 4304 4301 4297
			                   4218 4236 4241 4243 4241 4238
			                   4151 4173 4180 4184 4183 4180
			                   4090 4112 4122 4127 4127 4124
			                   4037 4060 4068 4073 4074 4072
			                   3968 3996 4016 4024 4025 4023
			                   3921 3943 3961 3976 3979 3978
			                   3876 3898 3912 3928 3933 3933
			                   3841 3858 3871 3883 3887 3887
			                   3814 3825 3837 3848 3851 3851
			                   3792 3801 3809 3822 3826 3825
			                   3771 3784 3789 3801 3805 3804
			                   3751 3768 3775 3784 3788 3787
			                   3731 3750 3760 3768 3768 3762
			                   3711 3731 3744 3748 3743 3734
			                   3691 3705 3718 3726 3721 3711
			                   3666 3669 3681 3694 3694 3684
			                   3627 3629 3640 3664 3665 3655
			                   3614 3617 3631 3659 3661 3651
			                   3603 3607 3623 3652 3655 3646
			                   3589 3596 3615 3644 3648 3640
			                   3569 3583 3603 3633 3637 3627
			                   3547 3566 3585 3612 3612 3601
			                   3516 3542 3554 3575 3571 3560
			                   3481 3496 3504 3530 3521 3509
			                   3387 3425 3440 3470 3456 3443
			                   3289 3328 3347 3371 3361 3350
			                   3200 3200 3200 3200 3200 3200
			                  >;
		};
};
