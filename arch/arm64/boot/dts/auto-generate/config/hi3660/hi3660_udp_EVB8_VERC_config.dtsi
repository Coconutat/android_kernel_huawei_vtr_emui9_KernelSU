/**
 * Copyright (C) 2014 Hisilicon Ltd.
 *
 *  This program is free software; you can redistribute it and/or modify
 *  it under the terms of the GNU General Public License version 2 as
 *  publishhed by the Free Software Foundation.
 */

/include/ "hi3660_udp_default_config.dtsi"
/ {
	hisi,boardid = <5 0 0 8>;
	hisi,boardname = "hi3660_udp_EVB8_VERC";
	hisi,product_id = <0x3AF5FC08>;
};
