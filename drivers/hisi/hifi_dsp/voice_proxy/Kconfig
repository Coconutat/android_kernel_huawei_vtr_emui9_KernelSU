## drivers/hisi/hifi_dsp/voice_proxy/Kconfig
```kconfig
menu "voice proxy driver"

config VOICE_PROXY
     bool "pass through voice data between AP and hifi"

config VOICE_PROXY_VOLTE
     bool "volte voice encrypt device support"

config VOICE_PROXY_VOWIFI
     bool "vowifi voice device support"

config VOICE_PROXY_RTT
     bool "rtt voice device support"
endmenu
```

## drivers/hisi/hisee/Kconfig
```kconfig
config HISI_HISEE
	depends on HISI_MAILBOX
	bool "Hisilicon hisee "
	default n
	help
	  Hisi hisee driver

config HISEE_POWER_MANAGE_COUNT
	depends on HISI_HISEE
	bool "Hisilicon hisee power manage counter"
	default n
	help
	  Hisi hisee driver

config HISI_HISEE_SHUTDOWN_SWIPE
	depends on HISI_HISEE
	bool "Hisilicon hisee shutdown swipe"
	default n
	help
	  whether to support hisee shutdown swipe

config FAKE_HISEE_SHUTDOWN_SWIPE_SUPPORT
	depends on HISI_HISEE_SHUTDOWN_SWIPE
	bool "Hisilicon fake hisee shutdown swipe"
	default n
	help
	  whether to support fake hisee shutdown swipe

config HISEE_APPLET_APDU_TEST_OPTIMIZATION
	depends on HISI_HISEE
	bool "Hisilicon hisee applet apdu test optimize"
	default n
	help
	  Hisi hisee driver used to optimize the apdu
	  test cmd.It's orginal name is CONFIG_HISEE_
	  CHIPTEST_SUPPORT_APPLET_OPTIMIZATION.

config HICOS_MISCIMG_PATCH
	depends on HISI_HISEE
	bool "Hisilicon hisee msic patch driver"
	default n
	help
	  Hisi hisee driver used to upgrade misc patch.
	  It's orginal name is CFG_HICOS_MISCIMG_PATCH, the
	  name used in cos is also named CFG_HICOS_MISCIMG_PATCH.

config MISCIMG_SECUPGRADE
	depends on HISI_HISEE
	bool "Hisilicon hisee misc upgrade"
	default n
	help
	  Hisi hisee driver used to upgrade misc image.

config HISEE_SUPPORT_MULTI_COS
	depends on HISI_HISEE
	bool "Hisilicon hisee support multi cos"
	default n
	help
	  Hisi hisee driver used to support multi cos.
	  It's orginal name is HISEE_SUPPORT_MULTI_COS.

config HISEE_NEW_COS_VERSION_HEADER
	depends on HISI_HISEE
	bool "Hisilicon hisee has new cos version format"
	default n
	help
	  Hisi hisee driver used to support new cos version format.

config HISEE_NEW_COSID_HEADER
	depends on HISEE_SUPPORT_MULTI_COS
	bool "Hisilicon hisee has new cos id format"
	default n
	help
	  Hisi hisee driver used to support new cos id format.

config HISEE_SUPPORT_8_COS
	depends on HISEE_SUPPORT_MULTI_COS
	bool "Hisilicon hisee can support 8 cos"
	default n
	help
	  Hisi hisee driver used to support 8 cos.

config HISI_HISEE_SUPPORT_CASDKEY
	depends on HISI_HISEE
	bool "Hisilicon hisee support CASD key"
	default n
	help
	  whether hisee support CASD key

config HISEE_SUPPORT_INSE_ENCRYPT
	depends on HISI_HISEE
	bool "Hisilicon hisee support inse encryption for bio, pin code and fingerprint."
	default n
	help
	  whether hisee support inse encryption

config HISEE_FACTORY_SECURITY_CHECK
	depends on HISI_HISEE
	bool "Hisilicon hisee support factory security check."
	default n
	help
	  whether hisee support factory security check

config HISEE_NFC_IRQ_SWITCH
	depends on HISI_HISEE
	bool "Hisilicon hisee support nfc irq switch."
	default n
	help
	  whether hisee support nfc irq switch

config HISEE_SUPPORT_OVERSEA
	depends on HISI_HISEE
	bool "Hisilicon hisee support oversea feature."
	default n
	help
	  whether hisee support oversea feature

config HISI_HISEE_MNTN_RESET_IRQ_SEPARATE
	depends on HISI_HISEE
	bool "Hisilicon hisee reset use separate interrupts."
	default n
	help
	  whether hisee reset support separate interrupts feature
```

## drivers/hisi/hisi_cma/Kconfig
```kconfig
config HISI_CMA
	bool "HISI CMA Multi-pool"
	default n
	depends on OF && CMA
	help
		This Options Enable the Multiple cma pool for different device Allocator
```

## drivers/hisi/hisi_lmk/Kconfig
```kconfig
menu "Hisi lowmem killer"

config HISI_LOWMEM
	bool "Hisilicon Low Memory Killer"
	default n
	depends on ANDROID_LOW_MEMORY_KILLER
	help
	  Enables hisi lowmem killer parameter tuning

config HISI_LOWMEM_DBG
	bool "Hisilicon Low Memory Killer debug"
	default n
	depends on ANDROID_LOW_MEMORY_KILLER
	help
	  print processes info when lmk happen per several seconds

config HISI_MULTI_KILL
	bool "Enable lmk multi kill"
	default n
	depends on ANDROID_LOW_MEMORY_KILLER
	help
	  When enabled, lmk will kill multi thread at once.

endmenu
```

## drivers/hisi/hisi_page_ext/Kconfig
```kconfig
config HISI_PAGE_EXT
	bool "Page ext api on HISI Plat."
	depends on FLATMEM
	---help---
	  This function enable will free the unused page ext memory.
```

## drivers/hisi/hisi_page_tracker/Kconfig
```kconfig
config HISI_PAGE_TRACKER
	bool "Page tracker on HISI Plat."
	depends on FLATMEM
	---help---
	  This function record the owner of a page, the module which allocs page and
	  the order of page on alloction. It will help to find bare alloc_page(s) leaks.
	  Even if you include this feature on your build, it is disabled in default.
```

## drivers/hisi/hw_vote/Kconfig
```kconfig
menu "Hisi HW Vote options"

config HISI_HW_VOTE
    tristate "Hisilicon Hardware Vote Driver"
    default n
    help
      This enables the hisilicon Hardware Vote driver.

config HISI_HW_VOTE_DEBUG
    tristate "Hisilicon Hardware Vote Driver Debug"
    depends on HISI_HW_VOTE && HISI_DEBUG_FS
    default n
    help
      This enables the hisilicon Hardware Vote Driver Debug.

endmenu
```

## drivers/hisi/isp/Kconfig
```kconfig
config HISI_ISP_DEBUG
	bool "hisi isp debug"
	default n
	help
		Say yes here to support hisi isp debug.
```

## drivers/hisi/jpu/Kconfig
```kconfig
config HISI_JPU_SUPPORT
    tristate "Support for Hisilicon JPEG processing unit"
    default n
    help
        The decode device provides decode function for JPEG.
```

## drivers/hisi/kernel_harden_test/Kconfig
```kconfig
config HISI_KERNEL_HARDEN_DEBUG
	bool "HISI kernel harden test support"
	default n
	help
	  Say yes here to support the HISI kernel harden debug
```

## drivers/hisi/mailbox/hisi_mailbox/Kconfig
```kconfig
comment "hisi ipc MailBox driver"
config HISI_MAILBOX
	bool "hisi ipc MailBox driver"
	default n
	help
	  hisi ipc MailBox driver
	  
comment "hisi ipc mailboxes debugfs user"
config HISI_MAILBOX_DEBUGFS
	bool "hisi ipc mailboxes debugfs user"
	depends on (HISI_MAILBOX) && DEBUG_FS
	default n
	help
	  HiIPCV230 ipc mailboxes debugfs user

comment "hisi ipc MailBox driver performance debug"
config HISI_MAILBOX_PERFORMANCE_DEBUG
	bool "hisi ipc MailBox driver performance debug"
	depends on (HISI_MAILBOX)
	default n
	help
	  Print tts of sending task, if config is set y

comment "hisi kernel API about remote processor communication"
config HISI_RPROC
	bool "hisi ipc kernel API"
	default n
	help
	  hisi kernel API about remote processor communication
	  
comment "hisi rproc kernel API debugfs"
config HISI_RPROC_TESTFILE
	bool "hisi rproc kernel API test file"
	depends on HISI_RPROC
	default n
	help
	  debug for hisi_rproc

comment "bsp_reset_core_notify to support modem compile"
config BSP_RESET_CORE_NOTIFY
	bool "bsp_reset_core_notify"
	default n
	help
	  to support modem compile
```

## drivers/hisi/mntn/blackbox/platform_ap/Kconfig
```kconfig
config HISI_IRQ_REGISTER
	bool "record irq register"
	depends on HISI_BB
	default n
	help
	  This module can record irq register.

config HISI_REENTRANT_EXCEPTION
	bool "reentrant exception"
	depends on HISI_BB
	default n
	help
	  this module deal with reentrant exception.

config HISI_TIME_HOOK
	bool "support print time call trace "
	depends on HISI_BB
	default n
	help
	  Say 'Y' here if you want to print time call trace.
```

## drivers/hisi/mntn/subpmu/Kconfig
```kconfig
config HISI_SUBPMU
    bool "subpmu module support"
    default n
    help
      Say yes here to support the subpmu module.
```

## drivers/hisi/noc/Kconfig
```kconfig
config HISI_NOC
	depends on HISI_BB
	bool "Support HiSilicon NOC"
	default n
	help
	  This driver supports HiSilicon HiXXX NOC,
	  including hisilicon noc driver

config HISI_NOC_DBG
	depends on HISI_NOC && HISI_DEBUG_FS
	bool "Support HiSilicon NOC Dbg node"
	default n
	help
	  Support HiSilicon NOC Dbg node
```

## drivers/hisi/ocbc/Kconfig
```kconfig
menu "Hisi OCBC options"

config HISI_OCBC
	bool "support hi3660 send msg to ocbc"
	default n
	help
	   support hi3xxx send msg to ocbc

endmenu
```

## drivers/hisi/perf_ctrl/Kconfig
```kconfig
menu "Hisilicon Performace Control"

config HISI_PERF_CTRL
        tristate "Hisilicon Performance Control Drivers"
	default n
        help
                Hisilicon Performance Control Drivers

config HISI_DDR_PERF_CTRL
        tristate "Hisilicon DDR Performance Control Function"
        depends on HISI_PERF_CTRL
        default n
        help
                Hisilicon DDR Performance Control Function

endmenu
```

## drivers/hisi/secs_power_ctrl/Kconfig
```kconfig
config HISI_SECS_CTRL
	bool "HISI SECS_CTRL support"
	default n
	help
	  Say yes here to support the HISI SECS CTRL
```

## drivers/hisi/slimbus/Kconfig
```kconfig
menu "hisilicon slimbus driver"

config HISILICON_PLATFORM_SLIMBUS
     bool "slimbus device support"
     default n
     help
          slimbus driver.

endmenu
```

## drivers/hisi/tzdriver/Kconfig
```kconfig
menu "TEE OS"

config SECURE_EXTENSION
	bool "security extension support"
	default n
	help
	  Include Security Extension.

config  TZDRIVER
	tristate "Secure Execution Communicator driver"
	default n
	depends on SECURE_EXTENSION
	help
	  Provides a communication interface between userspace and
	  TrustZone Operating Environment.

config TEELOG
	tristate "Secure Execution Log driver"
	default n
	depends on TZDRIVER
	help
	  TEEOS log

config TEE_TUI
	tristate "Trusted user interface driver"
	default n
	depends on TZDRIVER
	help
	  Trusted user interface diver

config TEE_TUI_ION
	tristate "Trusted user interface driver for ION"
	default n
	depends on TZDRIVER
	help
	  Trusted user interface diver

config TEE_TUI_ION_ADD
	tristate "Trusted user interface driver for add ION memory"
	default n
	depends on TZDRIVER
	help
	  Trusted user interface diver
config TEE_TUI_FP
	tristate "Trusted user interface driver for FP"
	default n
	depends on TZDRIVER
	help
	  Trusted user interface diver

config TEE_CPU_MIGRATION
	tristate "TEE cpu core migration"
	default n
	depends on TZDRIVER
	help
	  TEE cpu core migration

config HISI_SPI_SMC
	bool "hisi spi smc"
	default n

config HISI_SPI1_SMC
	bool "hisi spi1 smc"
	default n

config SECS_POWER_CTRL
	bool "secs power ctrl"
	default n

config TEE_CFC
	bool "Enable CFC to protect TEE"
	select PID_IN_CONTEXTIDR
	select TEE_CFC_ABI
	depends on ((!CORESIGHT) && (!CORESIGHT_SOURCE_ETM4X) && (!CORESIGHT_LINK_AND_SINK_TMC) && (!CONFIG_CORESIGHT_SINK_TPIU) && (!CONFIG_CORESIGHT_SINK_ETBV10) && (!CONFIG_CORESIGHT_LINKS_AND_SINKS) && (!CONFIG_HISI_CORESIGHT_TRACE))
	default y
	help
	  Code in TZDriver in a continuous text section and use smc call
	  to let TEEOS protect these code using DMSS. CoreSight based control
	  flow certification should be applied.

config TEE_CFC_ABI
	bool "Enable CFC ABI"
	default y
	help
	  TC_NS_SMC_CMD depends on TEEOS. If TEEOS selects FEATURE_CFC,
	  TEE_CFC_ABI should be selected even if TEE_CFC is off.

config TZDRIVER_CODE_ALIGN_SHIFT
	int "Alignment of code in tzdriver"
	range 16 19
	default 19
	depends on TEE_CFC
	help
	  Code of TZDriver should be aligned due to DMSS limitation.
	  There are two DMSS. In Hi3660, we need align tzdriver in
	  512kB physical memory boundry. In Hi3670 the limitation
	  reduced to 64kB.

config HISI_SECBOOT_IMG
    bool "tzdriver split secboot img into modem and ap"
    default n
    help
      Macro defined for splitting modem and ap img

source drivers/hisi/tzdriver/libhwsecurec/Kconfig

endmenu
```

## drivers/huawei_platform/Kconfig
```kconfig
menu "Huawei Platform Drivers"

menuconfig HUAWEI_PLATFORM
       bool "Huawei platform drivers support"
       default n
       help
       Say yes here to support the huawei platform

if HUAWEI_PLATFORM

source "drivers/huawei_platform/antenna_board_match/Kconfig"
#source "drivers/huawei_platform/antenna_fpga/Kconfig"
source "drivers/huawei_platform/audio/Kconfig"
source "drivers/huawei_platform/chr/Kconfig"
source "drivers/huawei_platform/riltcp/Kconfig"
source "drivers/huawei_platform/connectivity/Kconfig"
source "drivers/huawei_platform/devdetect/Kconfig"
source "drivers/huawei_platform/dev_selfcheck/Kconfig"
#source "drivers/huawei_platform/dsm/Kconfig"
source "drivers/huawei_platform/iotrace/Kconfig"
source "drivers/huawei_platform/ext_modem/Kconfig"
source "drivers/huawei_platform/inputhub/Kconfig"
source "drivers/huawei_platform/irda/Kconfig"
source "drivers/huawei_platform/lcd/Kconfig"
#source "drivers/huawei_platform/log/Kconfig"
source "drivers/huawei_platform/mm/Kconfig"
source "drivers/huawei_platform/net/Kconfig"
source "drivers/huawei_platform/nfc/Kconfig"
source "drivers/huawei_platform/power/Kconfig"
source "drivers/huawei_platform/sensor/Kconfig"
source "drivers/huawei_platform/storage/Kconfig"
source "drivers/huawei_platform/touthscreen/Kconfig"
source "drivers/huawei_platform/touch_key/Kconfig"
source "drivers/huawei_platform/uid_iostats/Kconfig"
source "drivers/huawei_platform/usb/Kconfig"
source "drivers/huawei_platform/voltage_detection/Kconfig"
source "drivers/huawei_platform/antenna_board_gpio_match/Kconfig"
source "drivers/huawei_platform/vibrator/Kconfig"
source "drivers/huawei_platform/ocp/Kconfig"
source "drivers/huawei_platform/madapt/Kconfig"
source "drivers/huawei_platform/dome_key/Kconfig"
source "drivers/huawei_platform/handpress_switch/Kconfig"
source "drivers/huawei_platform/led_alwayson/Kconfig"
source "drivers/huawei_platform/boottime/Kconfig"
source "drivers/huawei_platform/hw_led/Kconfig"
source "drivers/huawei_platform/emcom/Kconfig"
source "drivers/huawei_platform/mm_tuner/Kconfig"
source "drivers/huawei_platform/dp_aux_switch/Kconfig"
source "drivers/huawei_platform/oases/Kconfig"
source "drivers/huawei_platform/dp_source/Kconfig"
source "drivers/huawei_platform/rilsim/Kconfig"
source "drivers/huawei_platform/sw/Kconfig"
source "drivers/huawei_platform/kirin_chipsets/Kconfig"
source "drivers/huawei_platform/vendor_exception/Kconfig"
endif #HUAWEI_PLATFORM

endmenu
```

## drivers/huawei_platform/antenna_board_match/antenna_board_adc_match/Kconfig
```kconfig
menuconfig HW_ANTENNA_BOARD_ADC_MATCH
	bool "antenna_board_adc_match support"
	default n
	help
	Say yes here to support antenna boardid adc detection
```

## drivers/huawei_platform/audio/ak4376-kernel-4-1/Kconfig
```kconfig
config AK4376_KERNEL_4_1
	tristate "AK4376 Driver in kernel 4.1 for headset hifi"
	default n
	help
		Say Y to enable AK4376 Driver Support For headset hifi kernel 4.1
```

## drivers/huawei_platform/audio/hifi_vir_dai/Kconfig
```kconfig
config HIFI_VIR_DAI
    tristate "HIFI_VIR_DAI Driver for extern hifi DAC"
	default n
	help
		Say Y to enable HIFI_VIR_DAI Driver Support For extern hifi DAC
```

## drivers/huawei_platform/audio/tfa98xx/Kconfig
```kconfig
config TFA9872
	tristate "TFA9872 i2c driver"
	default n
	help
		Say Y to enable tfa9872 i2c driver support

config TFA98XX
	tristate "tfa98xx ioctl driver"
	default n
	help
		Say Y to enable maxim driver support
```

## drivers/huawei_platform/audio/usb_analog_hs_module/Kconfig
```kconfig
menuconfig USB_ANALOG_HS_MODULE
	bool "USB ANALOG headset drivers support"
	default n
	help
	Say yes here to support the USB ANALOG headset module

if USB_ANALOG_HS_MODULE
config USB_ANALOG_HS_INTERFACE
	tristate "Support for USB_ANALOG_HS_INTERFACE"
	default n
	---help---
	 Say Y here if you want to support USB_ANALOG_HS_INTERFACE
config USB_ANALOG_HS_ISL54405
	tristate "Support for USB ANALOG headset with ISL54405 switch"
	default n
	---help---
	 Say Y here if you want to support  USB ANALOG headset with ISL54405 switch
config USB_ANALOG_HS_FSA4476
	tristate "Support for USB ANALOG headset with FSA4476 switch"
	default n
	---help---
	 Say Y here if you want to support USB ANALOG headset with FSA4476 switch
endif #USB_ANALOG_HS_MODULE
```
