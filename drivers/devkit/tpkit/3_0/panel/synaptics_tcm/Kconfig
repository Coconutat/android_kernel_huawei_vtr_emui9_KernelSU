## drivers/devkit/tpkit/3_0/panel/synaptics_tcm/Kconfig
```kconfig
#
# Synaptics TCM touchscreen driver configuration
#
menuconfig SYNAPTICS_TCM_TS_KIT_3_0
	tristate "SYNAPTICS_TCM_TS_KIT_3_0 touchscreen"
	default n
	help
	  Say Y here if you have a Synaptics TCM touchscreen connected
	  to your system.

	  If unsure, say N.
```

## drivers/devkit/tpkit/Kconfig
```kconfig
#
# huawei touchscreen driver configuration
#

menuconfig HUAWEI_HOST_TS_KIT
	tristate "huawei HOST_TS_KIT touchscreen"
	default n
	help
	  If you say yes here you get support for hostprocessing touchscreen.
menuconfig HUAWEI_TS_KIT
	tristate "huawei TS_KIT drivers"
	default n
	help
	  If you say yes here you get support for huawei touchscreen.
menuconfig HUAWEI_TS_KIT_TEST
	bool "huawei TS_KIT test"
	default n
	help
	  If you say yes here you get support for huawei touchscreen.
menuconfig HUAWEI_TS_KIT_COMMON
	bool "huawei TS_KIT common"
	default n
	help
	  If you say yes here you get support for huawei touchscreen.
menuconfig HUAWEI_DEVKIT_HISI
	tristate "huawei CONFIG_DEVKIT_HISI"
	default n
	help
	  If you say yes here you get support for huawei touchscreen.
menuconfig HUAWEI_DEVKIT_QCOM
	tristate "huawei CONFIG_DEVKIT_QCOM"
	default n
	help
	  If you say yes here you get support for huawei touchscreen.

source "drivers/devkit/tpkit/hostprocessing/Kconfig"
source "drivers/devkit/tpkit/panel/Kconfig"
source "drivers/devkit/tpkit/3_0/Kconfig"

#sensor unification for differ platform
menuconfig HUAWEI_TP_KIT_COLOR_INFO
	tristate "huawei TS_KIT tp color info"
	default n
	help
		get the huawei TS_KIT tp color information.
```

## drivers/devkit/tpkit/panel/atmel/Kconfig
```kconfig
#
# huawei touchscreen driver configuration
#

menuconfig ATMEL_TS_KIT
	tristate "huawei  ts kit atmel drivers"
	default n
	help
	  If you say yes here you get support for huawei touchscreen.
```

## drivers/devkit/tpkit/panel/goodix/Kconfig
```kconfig
#
# huawei touchscreen driver configuration
#

menuconfig GOODIX_TS_KIT
	bool "TS_KIT goodix drivers"
	default n
	help
	  If you say yes here you get support for huawei touchscreen.
```

## drivers/devkit/tpkit/panel/ilitek/Kconfig
```kconfig
#
# huawei touchscreen driver configuration
#

menuconfig ILITEK_TS_KIT
	bool "TS_KIT ilitek drivers"
	default n
	help
	  If you say yes here you get support for huawei touchscreen.
```

## drivers/devkit/tpkit/panel/ilitek_tddi/Kconfig
```kconfig
#
# huawei touchscreen driver configuration
#

menuconfig ILITEK_TDDI_TS_KIT
	bool "TS_KIT ilitek tddi drivers"
	default n
	help
	If you say yes here you get support for huawei touchscreen.
```

## drivers/devkit/tpkit/panel/mstar/Kconfig
```kconfig
#
# huawei touchscreen driver configuration
#

menuconfig MSTAR_TS_KIT
	bool "TS_KIT mstar drivers"
	default n
	help
	  If you say yes here you get support for huawei touchscreen.
```

## drivers/devkit/tpkit/panel/novatek_hybrid/Kconfig
```kconfig
#
# huawei touchscreen driver configuration
#

menuconfig  NOVATEK_HYBRID_TS_KIT
	tristate "TS_KIT novatek_hybrid drivers"
	default n
	help
	  If you say yes here you get support for huawei touchscreen.
```

## drivers/devkit/tpkit/panel/parade/Kconfig
```kconfig
#
# huawei touchscreen driver configuration
#
menuconfig PARADE_TS_KIT
	tristate "huawei  ts kit parade drivers"
	default n
	help
	  If you say yes here you get support for huawei touchscreen.
```

## drivers/devkit/tpkit/panel/st/Kconfig
```kconfig
#
# huawei touchscreen driver configuration
#

menuconfig ST_TS_KIT
	tristate "TS_KIT ST touch drivers"
	default n
	help
	  If you say yes here you get support for huawei touchscreen.
```

## drivers/devkit/tpkit/panel/synaptics_tcm/Kconfig
```kconfig
#
# Synaptics TCM touchscreen driver configuration
#
menuconfig SYNAPTICS_TCM_TS_KIT
	tristate "Synaptics TCM touchscreen"
	default n
	help
	  Say Y here if you have a Synaptics TCM touchscreen connected
	  to your system.

	  If unsure, say N.
```

## drivers/gpu/arm/Kconfig
```kconfig
#
# (C) COPYRIGHT 2012 ARM Limited. All rights reserved.
#
# This program is free software and is provided to you under the terms of the
# GNU General Public License version 2 as published by the Free Software
# Foundation, and any use by you of this program is subject to the terms
# of such GNU licence.
#
# A copy of the licence is included with the program, and can also be obtained
# from Free Software Foundation, Inc., 51 Franklin Street, Fifth Floor,
# Boston, MA  02110-1301, USA.
#
#



config MALI_T830
        tristate "Mali t83x configs"
        default n

config MALI_MIMIR
        tristate "Mali tMix configs"
        default n

config MALI_HEIMDALL
        tristate "Mali tHEx configs"
        default n

config MALI_SIGURD
        tristate "Mali tSIx configs"
        default n

config MALI_NORR
        tristate "Mali tNOx configs"
        default n

config MALI_TRYM
        tristate "Mali TRYM configs"
        default n

config MALI_GONDUL
        tristate "Mali tGOx configs"
        default n
menu "ARM GPU Configuration"

if MALI_T830
endif

if MALI_MIMIR
#source "drivers/gpu/arm/bifrost-r2p0-02dev0/Kconfig"
#source "drivers/gpu/arm/bifrost-r5p0-01rel0/Kconfig"
#source "drivers/gpu/arm/bifrost-r6p0-cet/Kconfig"
#source "drivers/gpu/arm/bifrost-r7p0-00cet0/Kconfig"
#source "drivers/gpu/arm/bifrost-r8p0-00cet0/Kconfig"
source "drivers/gpu/arm/bifrost-r14p0-00cet0/Kconfig"
endif

if MALI_HEIMDALL
#source "drivers/gpu/arm/bifrost-r2p0-03rel0/Kconfig"
#source "drivers/gpu/arm/bifrost-r4p0-01rel0/Kconfig"
#source "drivers/gpu/arm/bifrost-r6p0-cet/Kconfig"
#source "drivers/gpu/arm/bifrost-r7p0-00cet0/Kconfig"
#source "drivers/gpu/arm/bifrost-r8p0-00cet0/Kconfig"
source "drivers/gpu/arm/bifrost-r14p0-00cet0/Kconfig"
endif

if MALI_SIGURD
#source "drivers/gpu/arm/bifrost-r7p0-00cet0/Kconfig"
#source "drivers/gpu/arm/bifrost-r8p0-01rel0/Kconfig"
source "drivers/gpu/arm/bifrost-r14p0-00cet0/Kconfig"
endif

if MALI_NORR
#source "drivers/gpu/arm/bifrost-r6p0-cet/Kconfig"
#source "drivers/gpu/arm/bifrost-r7p0-00cet0/Kconfig"
#source "drivers/gpu/arm/bifrost-r8p0-00cet0/Kconfig"
#source "drivers/gpu/arm/bifrost-r9p0-00cet0/Kconfig"
source "drivers/gpu/arm/bifrost-r14p0-00cet0/Kconfig"
endif

if MALI_TRYM
source "drivers/gpu/arm/bifrost-r14p0-00cet0/Kconfig"
endif

if MALI_GONDUL
source "drivers/gpu/arm/bifrost-r14p0-00cet0/Kconfig"
endif

endmenu
```

## drivers/gpu/arm/bifrost-r14p0-00cet0/platform/hisilicon/Kconfig
```kconfig
#
# (C) COPYRIGHT 2012 ARM Limited. All rights reserved.
#
# This program is free software and is provided to you under the terms of the
# GNU General Public License version 2 as published by the Free Software
# Foundation, and any use by you of this program is subject to the terms
# of such GNU licence.
#
# A copy of the licence is included with the program, and can also be obtained
# from Free Software Foundation, Inc., 51 Franklin Street, Fifth Floor,
# Boston, MA  02110-1301, USA.
#
#

config MALI_PM_DEMAND
        bool "Switch power policy"
        depends on MALI_MIDGARD && MALI_EXPERT
        default n
        help
          switch policy for different platform, fpga or chip

config REPORT_VSYNC
        bool "Enabel REPORT_VSYNC"
        depends on MALI_MIDGARD && MALI_EXPERT
        default y
        help
          Enable REPORT_VSYNC

config MALI_IDLE_AUTO_CLK_DIV
        bool "Idle auto clock divide"
        depends on MALI_MIDGARD && MALI_EXPERT
        default y
        help
          when GPU in IDLE state, auto decrease the clock rate

config MALI_GPU_DRM_HI3660
	bool "Enable gpu drm feature for hi3660"
	depends on MALI_MIDGARD && MALI_EXPERT
	default n
	help
	  enable mali gpu drm feature

config HISI_HW_VOTE_GPU_FREQ
	bool "Enable hardware vote gpu freq feature"
	depends on PM_DEVFREQ && HISI_HW_VOTE
	default n
	help
	  enable hardware vote gpu freq feature

config HISI_GPU_CORESWITCH
	bool "Enable core switch feature in gpu low frequency"
	depends on MALI_MIDGARD && MALI_EXPERT
	default n
	help
		enable cores shutdown when low utilisation at low frequency to save power

config HISI_LAST_BUFFER
	bool "Last buffer"
	depends on MALI_MIDGARD && MALI_EXPERT && MALI_PLATFORM_HISILICON && HISI_LB
	default n
	help
	  Select  this option to enable last buffer support.
```

## drivers/hisi/Kconfig
```kconfig
menu "Hisilicon platform"

menuconfig HISILICON_PLATFORM
	bool "Hisilicon platform support"
	default n
	help
	  Say yes here to support the hisilicon platform

if HISILICON_PLATFORM

source "drivers/hisi/adc/Kconfig"
source "drivers/hisi/cci_extra/Kconfig"
source "drivers/hisi/cmdline/Kconfig"
source "drivers/hisi/irq_affinity/Kconfig"
source "drivers/hisi/mailbox/Kconfig"
source "drivers/hisi/mntn/Kconfig"
source "drivers/hisi/noc/Kconfig"
source "drivers/hisi/hisi_syscounter/Kconfig"
source "drivers/hisi/soundtrigger/Kconfig"
source "drivers/hisi/memory_dump/Kconfig"
source "drivers/hisi/hmpthresholds/Kconfig"
source "drivers/hisi/drmdriver/Kconfig"
source "drivers/hisi/efuse/Kconfig"
source "drivers/hisi/hi6xxx/Kconfig"
source "drivers/hisi/hi64xx/Kconfig"
source "drivers/hisi/hi64xx_dsp/Kconfig"
source "drivers/hisi/slimbus/Kconfig"
source "drivers/hisi/hifi_dsp/Kconfig"
source "drivers/hisi/hifi_mailbox/Kconfig"
source "drivers/hisi/ddrc/Kconfig"
source "drivers/hisi/hisi_cma/Kconfig"
source "drivers/hisi/hisi_lb/Kconfig"
source "drivers/hisi/tzdriver/Kconfig"
source "drivers/hisi/hisee/Kconfig"
source "drivers/hisi/load_image/Kconfig"
source "drivers/hisi/perfhub/Kconfig"
source "drivers/hisi/jpu/Kconfig"
source "drivers/hisi/l3cache/Kconfig"
source "drivers/hisi/pm/Kconfig"
source "drivers/hisi/ocbc/Kconfig"
source "drivers/hisi/hw_vote/Kconfig"
source "drivers/hisi/gpufreq/Kconfig"
source "drivers/hisi/modem/Kconfig"
source "drivers/hisi/axi/Kconfig"
source "drivers/hisi/ivp/Kconfig"
source "drivers/hisi/hisi_page_tracker/Kconfig"
source "drivers/hisi/hisi_page_ext/Kconfig"
source "drivers/hisi/timekeeper/Kconfig"
source "drivers/hisi/tlb_conflict/Kconfig"
source "drivers/hisi/hisi_lmk/Kconfig"
source "drivers/hisi/test_spinlock/Kconfig"
source "drivers/hisi/hhee/Kconfig"
source "drivers/hisi/ics/Kconfig"
source "drivers/hisi/dieid/Kconfig"
source "drivers/hisi/kernel_harden_test/Kconfig"
source "drivers/hisi/secs_power_ctrl/Kconfig"
source "drivers/hisi/hitest/Kconfig"
source "drivers/hisi/ipp/Kconfig"
source "drivers/hisi/isp/Kconfig"
source "drivers/hisi/tlb_conflict/Kconfig"
source "drivers/hisi/accurate_delay/Kconfig"
source "drivers/hisi/hispfd/Kconfig"
source "drivers/hisi/engineer_mode/Kconfig"
source "drivers/hisi/perf_ctrl/Kconfig"
source "drivers/hisi/hisi_drg/Kconfig"
source "drivers/hisi/hisi_dummy_ko/Kconfig"
source "drivers/hisi/bl31_log/Kconfig"
endif #HISILICON_PLATFORM

endmenu
```

## drivers/hisi/accurate_delay/Kconfig
```kconfig
config HISI_ACCURATE_DELAY
	bool "Hisilicon Accurate Delay Lib"
	default n
	help
	Say yes here if you want to use Accurate Delay lib
```

## drivers/hisi/adc/Kconfig
```kconfig
config HISI_HKADC
	bool "HISI ADC support"
	depends on HISI_MAILBOX
	default n
	help
	  Say yes here to support the HISI ADC device

config HISI_HKADC_DEBUG
	tristate "HISI ADC DEBUG"
	help
	  Say yes here to support this lock
```

## drivers/hisi/bl31_log/Kconfig
```kconfig
config HISI_KERNEL_BL31_LOG
	bool "HISI kernel dump bl31 log support"
	default n
	help
	  Say yes here to support dump bl31 log in kernel
```

## drivers/hisi/ddrc/Kconfig
```kconfig
config HISILICON_PLATFORM_DDRC
	bool "Hisilicon platform ddr controller support"
	default n
	help
	  Say yes here to support the hisilicon platform ddr controller

config HI3650_DDRC_FLUX
	bool "Hi3650 ddr bandwith statstic "
	default n

config HI6250_DDRC_FLUX
	bool "Hi6250 ddr bandwith statstic "
	default n

config HISI_DDR_TRACKING
        tristate "Hisilicon DDR Tracking Function"
        default n
        help
                Hisilicon DDR Tracking Function

config HISI_DDRC_FLUX
	bool "Hisi ddr bandwith statstic "
	default n

config HISI_DDRC_SEC
	bool "hisi ddr secprotect"
	default n

config HI3660_DDR_AUTO_FSGT
       bool "hi3660 ddr autofs/autogt"
       default n

config KIRIN970_DDR_AUTO_FSGT
       bool "kirin970 ddr autofs/autogt"
       default n

config DDR_AUTO_FSGT
       bool "ddr autofs/autogt"
       default n

config HISI_DDR_CETUS
       bool "Hisi ddr cetus platform"
       default n

config HISI_DDR_PERSEUS
       bool "Hisi ddr perseus platform"
       default n

config HISI_DDR_URSA
       bool "Hisi ddr ursa platform"
       default n
```

## drivers/hisi/drmdriver/Kconfig
```kconfig
config DRMDRIVER
    tristate "hisi drm module driver"
    default n
    help
      Provides a secure configuration between kernel and BL31,
	  and drm module driver
```

## drivers/hisi/efuse/Kconfig
```kconfig
config HI3XXX_EFUSE
	bool "Support Hisilicon Hi3XXX efuse"
	default n
	help
	Hi3XXX efuse driver support
```

## drivers/hisi/gpufreq/Kconfig
```kconfig
menu "HISI GPUFREQ Options"

config HISI_GPUFREQ
    tristate "Hisilicon GPUFREQ Driver"
    depends on ARCH_HISI && PM_DEVFREQ
    select PM_OPP
    help
      This enables the hisilicon gpufreq driver.

config HISI_GPU_FHSS
    tristate "Hisilicon GPU Frequency-Hopping Spread Spectrum Driver"
    depends on HISI_GPUFREQ
    select PM_OPP
    help
      This enables the hisilicon Frequency-Hopping Spread Spectrum of GPU feature.

endmenu
```

## drivers/hisi/hhee/Kconfig
```kconfig
config HISI_HHEE
	bool "HISI HHEE support"
	select DEBUG_RODATA
	default n
	help
	  Say yes here to support the HISI HHEE

config HISI_HHEE_TOKEN
	bool "HISI TOKEN for hhee"
	depends on HISI_HHEE
	default n
	help
	  Say yes when token needed

config HISI_HHEE_DEBUG
	bool "HISI HHEE test support"
	depends on !UBSAN && !KCOV && !KASAN
	depends on HISI_HHEE
	depends on HISI_DEBUG_FS
	default n
	help
	  Say yes here to support the HISI HHEE debug
```

## drivers/hisi/hi64xx/Kconfig
```kconfig
config HI6402_CODEC
	tristate "Support HiSilicon Hi6402 Codec IC"
	default n
        help
          Enables the HI6402 core driver.

config HI6403_CODEC
	tristate "Support HiSilicon Hi6403 Codec IC"
	default n
	help
          Enables the HI6403 core driver.

config HI6402_MBHC_ANC
	tristate "Support ANC for Hi6402 Codec"
        default n
        help
          Enables support of ANC for Hi6402.

config HAC_SUPPORT
	bool "Support HAC for Hi6403 Codec"
	depends on HI6403_CODEC
	default n
	help
          Enables hac for HI6403 Codec.

config RCV_TDD_SUPPORT
	bool "Support RCV TDD for Hi6403 Codec"
	depends on HI6403_CODEC
	default n
	help
          Enables rcv tdd for HI6403 Codec.
```

## drivers/hisi/hifi_dsp/Kconfig
```kconfig
menu "Hifimisc driver serve HIFI dsp"

config HIFI_DSP_ONE_TRACK
     bool "hifi low power play device support"
     help
          hifi lpp device provide service for HIFI and AP, in case of HIFI ultra-low power audio play.
config HIFI_MEMORY_21M
    bool "hifi memory is 21M"
    help
         hifi memory is 21M
config HISI_AUDIO_DEBUG
    bool "support audio debug function"
    help
        support audio debug function
source drivers/hisi/hifi_dsp/voice_proxy/Kconfig
endmenu
```
