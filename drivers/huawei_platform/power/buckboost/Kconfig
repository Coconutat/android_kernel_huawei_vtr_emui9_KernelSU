## drivers/huawei_platform/power/charger/Kconfig
```kconfig
source "drivers/huawei_platform/power/charger/charger_ap/Kconfig"
source "drivers/huawei_platform/power/charger/charger_sensorhub/Kconfig"

config HUAWEI_CHARGER
	bool "huawei charger"
	default n
```

## drivers/huawei_platform/power/charger/charger_ap/Kconfig
```kconfig
source "drivers/huawei_platform/power/charger/charger_ap/direct_charger/Kconfig"
source "drivers/huawei_platform/power/charger/charger_ap/wireless_charger/Kconfig"
source "drivers/huawei_platform/power/charger/charger_ap/wired_channel_switch/Kconfig"
config HUAWEI_CHARGER_AP
	bool "huawei charger ap"
	default n
config BQ2419X_CHARGER
	bool "bq2419x charger"
	default n
config BQ2560X_CHARGER
	bool "bq2560x charger"
	default n
config BQ2429X_CHARGER
	bool "bq2429x charger"
	default n
config BQ25892_CHARGER
	bool "bq25892 charger"
	default n
config RT9466_CHARGER
	bool "rt9466 charger"
	default n
config DUAL_CHARGER
	bool "dual charger"
	default n
config DIRECT_CHARGER
	bool "direct charger"
	default n
config WIRELESS_CHARGER
	bool "wireless charger"
	default n
config WIRED_CHANNEL_SWITCH
	bool "wired channel switch"
	default n
config BQ25882_CHARGER
	bool "bq25882 charger"
	default n
```

## drivers/huawei_platform/power/charger/charger_ap/direct_charger/loadswitch/Kconfig
```kconfig
source "drivers/huawei_platform/power/charger/charger_ap/direct_charger/loadswitch/dual_loadswitch/Kconfig"
#source "drivers/huawei_platform/power/charger/direct_charger/loadswitch/fan54151/Kconfig"
#source "drivers/huawei_platform/power/charger/direct_charger/loadswitch/rt9748/Kconfig"
config DUAL_LOADSWITCH
	bool "dual_loadswitch"
	default n
config FAN54151
	bool "fan54151"
	default n
config RT9748
	bool "rt9748"
	default n
```

## drivers/huawei_platform/power/charger/charger_ap/direct_charger/switchcap/Kconfig
```kconfig
config BQ25970
	bool "bq25970"
	default n

config LTC7820
	bool "ltc7820"
	default n
```

## drivers/huawei_platform/power/charger/charger_ap/wired_channel_switch/Kconfig
```kconfig
config WIRED_CHANNEL_OVP_SWITCH
	bool "wired channel ovp switch"
	default n
config WIRED_CHANNEL_NCP3902_SWITCH
	bool "wired channel ncp3902 switch"
	default n
```

## drivers/huawei_platform/power/power_thermalzone/Kconfig
```kconfig
config	HUAWEI_POWER_THERMALZONE
	bool "huawei power thermalzone temp"
	default n
```

## drivers/huawei_platform/power/usb_short_circuit_protect/Kconfig
```kconfig
config HUAWEI_USB_SHORT_CIRCUIT_PROTECT
	bool "huawei usb short circuit protect"
	default n

config HUAWEI_USB_SHORT_CIRCUIT_PROTECT_SENSORHUB
	bool "huawei sensorhub usb short circuit protect"
	depends on INPUTHUB
	default n
```

## drivers/huawei_platform/riltcp/Kconfig
```kconfig
config RIL_NETLINK_MODULE
	tristate "kernel space communicate with user space rild use netlink socket."
    default n
    help
	  This module adds support for data speed slow detecting funtion based on
	  Balong V3R3 chipset.
```

## drivers/huawei_platform/sensor/Kconfig
```kconfig
#sensor unification for differ platform
menuconfig HUAWEI_SENSORS_INPUT_INFO
	bool "huawei sensor input info"
	default n
	help
	Say yes here to support the huawei sensor input information.

source "drivers/huawei_platform/sensor/fingerprint/Kconfig"
source "drivers/huawei_platform/sensor/hall/Kconfig"
source "drivers/huawei_platform/sensor/touch_key/Kconfig"
source "drivers/huawei_platform/sensor/color_sensor/Kconfig"
source "drivers/huawei_platform/sensor/step_motor/Kconfig"
source "drivers/huawei_platform/sensor/pos_hall/Kconfig"
```

## drivers/huawei_platform/sensor/color_sensor/Kconfig
```kconfig
config SENSORS_COLOR_AP
	tristate "XYZ Color sensor"
	depends on I2C && SYSFS


config TCS3430_AMS_DEBUG_LOG
    bool "Enable debug logging"
    depends on SENSORS_COLOR_AP
    default n
```

## drivers/huawei_platform/storage/Kconfig
```kconfig
source "drivers/huawei_platform/storage/ddrinfo/Kconfig"
source "drivers/huawei_platform/storage/appinfo/Kconfig"
source "drivers/huawei_platform/storage/postfsdata/Kconfig"
source "drivers/huawei_platform/storage/ioinfo/Kconfig"
```

## drivers/huawei_platform/storage/appinfo/Kconfig
```kconfig
config PROC_APP_INFO
	bool "/proc/app_info support"
	default n
	help
	support charge when machine power off & recovery.
```

## drivers/huawei_platform/storage/ioinfo/Kconfig
```kconfig
config PROC_IO_INFO
	bool "/proc/ioinfo support"
	depends on PROC_FS
	default n
	help
	  get IO information, include disk io stat, io top, io wait.
	  
```

## drivers/huawei_platform/storage/postfsdata/Kconfig
```kconfig
config PROC_POSTFSDATA
	bool "/proc/post-fs-data support"
	default n
	help
	   set data ready flag to kernel.
```

## drivers/huawei_platform/touch_key/Kconfig
```kconfig
#
# touch key driver configuration
#
menuconfig HW_RL_TOUCH_KEY
	bool "huawei touch key driver"
	default n
	help
	Say yes here to support for touch key.
menuconfig HW_PLAY_KEY
	bool "huawei play key driver"
	default n
	help
	Say yes here to support for touch key.
```

## drivers/huawei_platform/touthscreen/panel/Kconfig
```kconfig
#
# huawei touchscreen driver configuration
#

config SYNAPTICS_TS
	bool "synaptics touchscreen"
	default n
	help
	  If you say yes here you get support for synaptics touchscreen.
config SYNAPTICS_LCD_TYPE
	bool "synaptics lcd type"
	default n
	help
	  If you say yes here you get support for synaptics touchscreen.
config ATMEL_TS
	bool "atmel touchscreen"
	default n
	help
	  If you say yes here you get support for atmel touchscreen.
menuconfig HW_NOVATEK_TS
	bool "novatek touchscreen"
	default n
	help
	  If you say yes here you get support for novatek touchscreen.
menuconfig ST_TS
	bool "st touchscreen"
	default n
	help
	  If you say yes here you get support for st touchscreen.
```

## drivers/huawei_platform/usb/Kconfig
```kconfig
source "drivers/huawei_platform/usb/switch/Kconfig"
source "drivers/huawei_platform/usb/otg_gpio_switch/Kconfig"
source "drivers/huawei_platform/usb/typec/Kconfig"
source "drivers/huawei_platform/usb/pd/Kconfig"
source "drivers/huawei_platform/usb/otg_gpio_id/Kconfig"
source "drivers/huawei_platform/usb/superswitch/Kconfig"
source "drivers/huawei_platform/usb/otg_dual_role/Kconfig"
source "drivers/huawei_platform/usb/pogopin/Kconfig"
source "drivers/huawei_platform/usb/hw_usb/Kconfig"
config SUPERSWITCH
	tristate "superswitch support"
	help
	  Say Y here to enable superswitch support.
```

## drivers/huawei_platform/usb/otg_dual_role/Kconfig
```kconfig
menuconfig OTG_DUAL_ROLE
	bool "OTG_DUAL_ROLE support"
	default n
	help
	Say Y here to enable dummy otg dual role driver.
```

## drivers/huawei_platform/usb/pd/ti/Kconfig
```kconfig
config TUSB422
	bool "Enable TUSB422 USB Power Delivery"
	default n

config TUSB422_PAL
	bool "Enable TUSB422 Platform Abstraction Layer"
	default n
	depends on TUSB422
```

## drivers/huawei_platform/usb/switch/Kconfig
```kconfig
source "drivers/huawei_platform/usb/switch/switch_ap/Kconfig" 
source "drivers/huawei_platform/usb/switch/switch_sensorhub/Kconfig" 
```

## drivers/huawei_platform/vibrator/Kconfig
```kconfig
menuconfig HUAWEI_VIBRATOR
	bool "huawei vibrator driver"
	default n
	help
	Say yes here to support the huawei vibrator driver.

source "drivers/huawei_platform/vibrator/drv2605/Kconfig"
source "drivers/huawei_platform/vibrator/classd_vibrator/Kconfig"
```

## drivers/huawei_platform/vibrator/drv2605/Kconfig
```kconfig
#
#vibator TI2605 driver configuration
#
menuconfig DRV2605
	tristate "vibator drv2605 driver"
	default n
	help
	Say yes here to support for vibator drv2605 driver.
```

## drivers/huawei_platform/voltage_detection/Kconfig
```kconfig
menuconfig HW_VOLTAGE_DETECTION
	bool "huawei voltage detection"
	default n
	help
		Say yes here to support the voltage detection function
```
