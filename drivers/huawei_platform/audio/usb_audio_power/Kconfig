## drivers/huawei_platform/audio/usb_audio_power/Kconfig
```kconfig
config USB_AUDIO_POWER
	tristate "Support for usb audio power control"
	default n
	---help---
	 Say Y here if you want to support usb audio power control
```

## drivers/huawei_platform/connectivity/bcm/Kconfig
```kconfig
menuconfig BCMCONNECTIVITY
       bool "Broadcom  connectivity drivers support"
       default n
       help
       Say yes here to support the BCM chip connectivity

if BCMCONNECTIVITY

source "drivers/huawei_platform/connectivity/bcm/bluetooth/Kconfig"
source "drivers/huawei_platform/connectivity/bcm/gps/Kconfig"
source "drivers/huawei_platform/connectivity/bcm/wifi/Kconfig"

endif #BCM
```

## drivers/huawei_platform/connectivity/bcm/gps/Kconfig
```kconfig
menuconfig BCMGPS
    tristate "Bcm gps support"
    default n
    help
      Say Y here to enable bcm gps support. This allows
      ap to control this module.
if BCMGPS
source "drivers/huawei_platform/connectivity/bcm/gps/bcm4752/Kconfig"
source "drivers/huawei_platform/connectivity/bcm/gps/bcm47531/Kconfig"
source "drivers/huawei_platform/connectivity/bcm/gps/bcm4774/Kconfig"
source "drivers/huawei_platform/connectivity/bcm/gps/bcm4775/Kconfig"
source "drivers/huawei_platform/connectivity/bcm/gps/lhd/Kconfig"
endif #BCM
```

## drivers/huawei_platform/connectivity/bcm/gps/lhd/Kconfig
```kconfig
menuconfig BCMGPS4774LHD
	tristate "Bcm4774 gps lhd support"
	default n
	help
	  Say Y here to enable bcm4774 gps support. This allows
	  ap to control this module.
```

## drivers/huawei_platform/connectivity/hw_gps/Kconfig
```kconfig
menuconfig HWGPS
    tristate "Huawei gps common driver"
    default n
    help
      Say Y here to enable Huawei gps common driver. This allows
      ap to control this module.
```

## drivers/huawei_platform/dev_selfcheck/Kconfig
```kconfig
#
# device detect devices
#

menuconfig HUAWEI_DEV_SELFCHECK
    bool "Huawei device selfcheck support"
    default n
    help
      Say yes if you want device detect driver.
      This is for device connected version. If unsure, say N here.
```

## drivers/huawei_platform/emcom/Kconfig
```kconfig
menuconfig HUAWEI_EMCOM
    bool "Huawei emcom feature support"
    default n
    help
    Say yes here to support emcom feature

if HUAWEI_EMCOM
source "drivers/huawei_platform/emcom/argo/Kconfig"
source "drivers/huawei_platform/emcom/xengine/Kconfig"
source "drivers/huawei_platform/emcom/smartcare/Kconfig"
source "drivers/huawei_platform/emcom/nweval/Kconfig"
endif # if HUAWEI_EMCOM
```

## drivers/huawei_platform/emcom/argo/Kconfig
```kconfig
config TCP_ARGO
	bool "TCP ARGO (Anti Retransmission Gap Optimization)"
	default n
```

## drivers/huawei_platform/emcom/smartcare/Kconfig
```kconfig
menuconfig HW_NETWORK_MEASUREMENT
	bool "Huawei Network Measurement System"
	depends on HUAWEI_EMCOM
	default n

if HW_NETWORK_MEASUREMENT
source "drivers/huawei_platform/emcom/smartcare/fi/Kconfig"
endif # if HW_NETWORK_MEASUREMENT
```

## drivers/huawei_platform/emcom/smartcare/fi/Kconfig
```kconfig
config HW_SMARTCARE_FI
	bool "Huawei Smartcare FI"
	depends on HW_NETWORK_MEASUREMENT
	default n
```

## drivers/huawei_platform/hw_led/Kconfig
```kconfig
#
#led config driver configuration
#
menuconfig HW_LED_CONFIG
	bool "led config driver"
	default n
	help
	Say yes here to support for led config driver.
```

## drivers/huawei_platform/irda/Kconfig
```kconfig
menuconfig MAXQ616_POWER_SWITCH
	bool "irda MAXQ616 feature driver"
	default n
	help
	Say yes here to support Infrared remote control feature.
```

## drivers/huawei_platform/kirin_chipsets/Kconfig
```kconfig
###################################################
#                                                 #
# huawei device state monitor audio configuration #
#                                                 #
###################################################

config HUAWEI_DSM_KIRIN_CHIPSETS
	bool "huawei dsm kirin chipsets"
	default n
	depends on HUAWEI_DSM
	help
	  If you say yes here you get support for huawei dsm audio.
```

## drivers/huawei_platform/led_alwayson/Kconfig
```kconfig
#
#led alwayson driver configuration
#
menuconfig HW_LED_ALWAYSON
	bool "led alwayson driver"
	default n
	help
	Say yes here to support for led alwayson driver.
```

## drivers/huawei_platform/mm/Kconfig
```kconfig
config HW_STAT_MM
	bool "memory dmd"
	depends on HUAWEI_DSM
	default n
	help
	  memory dmd
```

## drivers/huawei_platform/mm_tuner/Kconfig
```kconfig
menuconfig HUAWEI_DTV_MMTUNER
	bool "Panasonic mm_tuner driver support"
	default n
	help
	This module adds support for wireless adapters based on
	Panasonic MN8855x chipset.
```

## drivers/huawei_platform/net/ipv4/Kconfig
```kconfig
config HW_CROSSLAYER_OPT
	bool "Huawei network crosslayer optimization"
	default n

config HW_CROSSLAYER_OPT_DBG
	tristate "Huawei network crosslayer information collection"
	depends on HW_CROSSLAYER_OPT && m
	default n


config HW_WIFI
	bool "Huawei wifi tcp monitor support"
	default n

config HW_WIFI_MSS
    bool "Huawei WLAN MIMO SISO switch support"
    default n

config HW_WIFI_RSSI
    bool "Huawei TAS RSSI report support"
    default n

config HUAWEI_MSS_AUTO_CHANGE
        bool "Huawei MSS auto change function support"
        default n

config HW_SYN_LINEAR_RETRY
        bool "Huawei tcp syn sent linear retry support"
        default n
```

## drivers/huawei_platform/net/netbooster/Kconfig
```kconfig
config HW_NETBOOSTER_MODULE
    tristate "netbooster:video acceleration and net ai change"
    default n
    help
    This module adds netbooster kernel suport for kirin chipset.

config APP_QOE_AI_PREDICT
    tristate "hidata app qoe"
    default n
    help
    This module add app qoe function suport for kirin chipset.
```

## drivers/huawei_platform/net/qtaguid_pid/Kconfig
```kconfig
config HW_QTAGUID_PID
	tristate "pid stats support for qtaguid"
    default n
    help
	  pid stats support for qtaguid
```

## drivers/huawei_platform/nfc/NXP_PN547_64/Kconfig
```kconfig
#
# Near Field Communication (NFC) devices
#
config PN547_NFC_64
	tristate "PN547 NFC driver"
	depends on I2C
	select CRC_CCITT
	default n
	---help---
	  Say yes if you want PN547/PN548 Near Field Communication driver.
	  This is for i2c connected version. If unsure, say N here.

	  To compile this driver as a module, choose m here. The module will
	  be called pn547/pn548.
```

## drivers/huawei_platform/oases/Kconfig
```kconfig
#
# OASES device configuration
#

config OASES
	bool "OASES device"
	default y
	depends on ARM || ARM64
	help
	  Enable OASES

config OASES_SIGNATURE_SUPPORT
	bool "OASES patch signature verification"
	default y
	depends on OASES
	help
	  Enable OASES patch signature verification

config OASES_STATIC_PLTS
	bool "OASES static PLTs"
	default y
	depends on OASES
	help
	  Enable static PLT allocation
```

## drivers/huawei_platform/power/battery/battery_ct/MAXIM/Kconfig
```kconfig
config CERTIFICATION_IC_DS28EL15
	bool
	prompt "Support ds28el15 as certification IC."
	depends on HUAWEI_BATTERY_INFORMATION
	default n
	help
		It needs a onewire physical controller to work.

config ONEWIRE_PHY_PL061_GPIO
	bool
	prompt "Onewire physical controller: pl061(GPIO)."
	depends on HUAWEI_BATTERY_INFORMATION
	depends on GPIO_PL061
	default n
	help
		It's an onewire physical controller.
```

## drivers/huawei_platform/power/battery_temp_fitting/Kconfig
```kconfig
config	HUAWEI_BATTERY_TEMP_FITTING
	bool "huawei battery temperature fitting"
	default n
```
