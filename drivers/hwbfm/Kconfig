## drivers/hwbfm/Kconfig
```kconfig
#
# huawei device state monitor configuration
#

config HUAWEI_BFM
	bool "huawei BFM"
	default n
	help
	  If you say yes here you get support for huawei boot fail monitor solution.

config HW_BFMR_HISI
	bool "bfmr for hisi"
	default n
	help
	  If you say yes here you get support for huawei bfmr solution on hisi.

config HW_BFMR_QCOM
	bool "bfmr for qcom"
	default n
	help
	  If you say yes here you get support for huawei bfmr solution on qcom.

config HW_BFMR_MTK
	bool "bfmr for mtk"
	default n
	help
	  If you say yes here you get support for huawei bfmr solution on mtk.

config USE_BOOTFAIL_RECOVERY_SOLUTION
    bool "use bootfail recovery solution"
    default n
    help
      If you say yes here you get support for huawei bfmr solution
      
source "drivers/hwbfm/hwbfr/Kconfig"
```

## drivers/iommu/hisi/Kconfig
```kconfig
# Hisilicon IOMMU support

config HISI_IODOMAIN_API
	bool

config HISI_IOMMU
	bool "Hisilicon IOMMU Support"
	select IOMMU_API
	select HISI_IODOMAIN_API
	help
	  Hisilicon IOMMU Support.

config HISI_IOMMU_LPAE
	bool "Hisilicon IOMMU LPAE Support"
	select IOMMU_API
	depends on HISI_IOMMU
	help
	  Hisilicon IOMMU Support.

config HISI_IOMMU_LEGACY
	bool "Hisilicon IOMMU SECOND LEVEL PAGE TABLE Support"
	select IOMMU_API
	depends on HISI_IOMMU && !HISI_IOMMU_LPAE
	help
	  Hisilicon IOMMU Support.

config HISI_IOMMU_COMPACT
	bool "Hisilicon IOMMU compact linux4.1"
	help
	  On linux4.1, IOMMU framework has some change point,
	  you need compact it.If you build on linux4.1 and need
	  hisilicon iommu,you should select this 'y'.
	  Then, you should select this 'n'.

config HISI_IOMMU_TEST
	bool "Hisilicon IOMMU TEST Support"
	depends on HISI_IOMMU_LPAE
	select IOMMU_API
	help
	  Hisilicon IOMMU Support.

config HISI_IOMMU_IOVA_DEBUG
        bool "Hisilicon IOMMU IOVA DEBUG Support"
	depends on HISI_IOMMU
	default n
	help
	  Hisilicon IOMMU IOVA DEBUG Support

config HISI_SVM
	tristate "HISI SVM driver"
	select MMU_NOTIFIER
	---help---
	  This option enables support for the hisi svm features base on the ARM
	  smmu v3 hardware. Select this option if you want to use devices by ssid
	  and asid interface.
```

## drivers/media/huawei/camera/fd/Kconfig
```kconfig
comment "FNFaceDetection"

config USE_FNFD
    tristate "Support FNFaceDetection driver"
    depends on HUAWEI_CAMERA
    default n
    ---help---
        Hisilicon FNFaceDetection.
```

## drivers/media/huawei/camera/hisp/hisp160/Kconfig
```kconfig
comment "HISI ISP"

choice
	prompt "HISP Version"
	default HUAWEI_CAMERA_USE_HISP160
	depends on HUAWEI_CAMERA
	help
        Select ISP version.

config HUAWEI_CAMERA_USE_HISP160
	bool "HISP160"
	depends on HUAWEI_CAMERA

endchoice
```

## drivers/media/huawei/camera/hisp/hisp200/Kconfig
```kconfig
comment "HISI ISP"

choice
	prompt "HISP Version"
	default HUAWEI_CAMERA_USE_HISP200
	depends on HUAWEI_CAMERA
	help
        Select ISP version.

config HUAWEI_CAMERA_USE_HISP200
	bool "HISP200"
	depends on HUAWEI_CAMERA

endchoice
```

## drivers/media/huawei/camera/hisp/hisp210/Kconfig
```kconfig
comment "HISI ISP"

choice
	prompt "HISP Version"
	default HUAWEI_CAMERA_USE_HISP210
	depends on HUAWEI_CAMERA
	help
        Select ISP version.

config HUAWEI_CAMERA_USE_HISP210
	bool "HISP210"
	depends on HUAWEI_CAMERA

endchoice
```

## drivers/media/huawei/camera/laser/Kconfig
```kconfig
if HISI_CAMERA_LASER

menu "st camera laser driver support"

config HISI_CAMERA_VL53L0
    tristate "vl53l0 camera laser driver"
    depends on HISI_CAMERA_LASER
    default n
    ---help---
        vl53l0 camera laser driver

config HISI_CAMERA_VL53L0_ML
    tristate "vl53l0_ml camera laser driver"
    depends on HISI_CAMERA_LASER
    default n
    ---help---
        vl53l0 camera laser driver for MHA/LON

config HISI_CAMERA_VL53L0_KNT
    tristate "vl53l0_knt camera laser driver"
    depends on HISI_CAMERA_LASER
    default n
    ---help---
        vl53l0 camera laser driver for KNIGHT

config HISI_CAMERA_VL53L0_GAL
    tristate "vl53l0_gal camera laser driver"
    depends on HISI_CAMERA_LASER
    default n
    ---help---
        vl53l0 camera laser driver for GAL

config HISI_CAMERA_VL53L0_CMB
    tristate "vl53l0_cmb camera laser driver"
    depends on HISI_CAMERA_LASER
    default n
    ---help---
        vl53l0 camera laser driver for CMB

config HISI_CAMERA_VL53L0_DUKE
    tristate "vl53l0_duke camera laser driver"
    depends on HISI_CAMERA_LASER
    default n
    ---help---
        vl53l0 camera laser driver for DUKE

config HISI_CAMERA_VL53L0_STF
    tristate "vl53l0_stf camera laser driver"
    depends on HISI_CAMERA_LASER
    default n
    ---help---
        vl53l0 camera laser driver for STF

config HISI_CAMERA_VL53L0_970
    tristate "st vl53lx & sharp 970 camera laser driver"
    depends on HISI_CAMERA_LASER
    default n
    ---help---
        vl53lx 970 camera laser driver
endmenu

menu "sharp camera laser driver support"

config HISI_CAMERA_GP2AP0XVT_STF
    tristate "gp2ap0xvt_stf camera laser driver"
    depends on HISI_CAMERA_LASER
    default n
    ---help---
        gp2ap0xvt camera laser driver for STF

endmenu

endif
```

## drivers/media/huawei/camera/pmic/Kconfig
```kconfig
if HUAWEI_CAMERA_PMIC
menu "Camera PMIC"
    config HUAWEI_CAMERA_PMIC_RT5112
        tristate "Richtek RT5112"
        depends on HUAWEI_CAMERA_PMIC
        default n
        ---help---
            Richtek RT5112 pmic chip

    config HUAWEI_CAMERA_PMIC_FAN53880
        tristate "On Semiconductor Fan53880"
        depends on HUAWEI_CAMERA_PMIC
        default n
        ---help---
            On Semiconductor pmic chip

endmenu
endif
```

## drivers/mmc/core/Kconfig
```kconfig
#
# MMC core configuration
#
config PWRSEQ_EMMC
	tristate "HW reset support for eMMC"
	default y
	depends on OF
	help
	  This selects Hardware reset support aka pwrseq-emmc for eMMC
	  devices. By default this option is set to y.

	  This driver can also be built as a module. If so, the module
	  will be called pwrseq_emmc.

config PWRSEQ_SIMPLE
	tristate "Simple HW reset support for MMC"
	default y
	depends on OF
	help
	  This selects simple hardware reset support aka pwrseq-simple for MMC
	  devices. By default this option is set to y.

	  This driver can also be built as a module. If so, the module
	  will be called pwrseq_simple.

config MMC_EMBEDDED_SDIO
	boolean "MMC embedded SDIO device support (EXPERIMENTAL)"
	help
	  If you say Y here, support will be added for embedded SDIO
	  devices which do not contain the necessary enumeration
	  support in hardware to be properly detected.

config MMC_PARANOID_SD_INIT
	bool "Enable paranoid SD card initialization (EXPERIMENTAL)"
	help
	  If you say Y here, the MMC layer will be extra paranoid
	  about re-trying SD init requests. This can be a useful
	  work-around for buggy controllers and hardware. Enable
	  if you are experiencing issues with SD detection.
config MMC_PASSWORDS
        boolean "MMC card lock/unlock passwords (EXPERIMENTAL)"
        select KEYS
        default y
        help
          Say Y here to enable the use of passwords to lock and unlock
          MMC cards.  This uses the access key retention support, using
          request_key to look up the key associated with each card.
          For example, if you have an MMC card that was locked using
          Symbian OS on your cell phone, you won't be able to read it
          on Linux without this support.
```

## drivers/mmonitor/Kconfig
```kconfig
config HW_MEMORY_MONITOR
	bool "memory monitor"
	default n
	help
	  memory monitor
```

## drivers/power/hisi/coul/Kconfig
```kconfig
config HISI_COUL
        bool "hisi coul"
        default n
config HISI_COUL_HI6421V500
        bool "hisi hi6421v500 coul"
        default n
config HISI_COUL_HI6421V600
	bool "hisi hi6421v600 coul"
	default n
config HISI_COUL_HI6421V600_SPMI
	bool "hisi hi6421v600_spmi coul"
	default n
config HISI_COUL_HI6555V100
        bool "hisi hi6555v100 coul"
        default n
config HISI_COUL_HI6555V200
        bool "hisi hi6555v200 coul"
        default n
config HISI_COUL_HI6421V700
	bool "hisi hi6421v700 coul"
	default n
config HISI_COUL_HI6XXX
	bool "hisi hi6XXX coul"
	default n
config HISI_COUL_TEST
        bool "hisi coul test"
        default n
config HISI_COUL_POLAR
        bool "hisi coul polar"
        default n
```
