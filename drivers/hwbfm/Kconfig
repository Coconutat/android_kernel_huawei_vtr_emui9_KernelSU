## drivers/video/fbdev/hisi/Kconfig
```kconfig
config HISI_FB_FAKE
	tristate "HISI Framebuffer Fake support"
	depends on FB
	select FB_CFB_FILLRECT
	select FB_CFB_COPYAREA
	select FB_CFB_IMAGEBLIT
	select REGMAP
	help
	  This framebuffer driver supports HISI FB Fake.

config HISI_FB_3650
	tristate "HISI FB 3650 Framebuffer support"
	depends on FB
	select FB_CFB_FILLRECT
	select FB_CFB_COPYAREA
	select FB_CFB_IMAGEBLIT
	select REGMAP
	help
	  This framebuffer driver supports HISI3650 FB.

config HISI_FB_6250
	tristate "HISI FB 6250 Framebuffer support"
	depends on FB
	select FB_CFB_FILLRECT
	select FB_CFB_COPYAREA
	select FB_CFB_IMAGEBLIT
	select REGMAP
	help
	  This framebuffer driver supports HISI6250 FB.

config HISI_FB_3660
	tristate "HISI FB 3660 Framebuffer support"
	depends on FB
	select FB_CFB_FILLRECT
	select FB_CFB_COPYAREA
	select FB_CFB_IMAGEBLIT
	select REGMAP
	help
	  This framebuffer driver supports HISI3660 FB.

config HISI_FB_970
	tristate "HISI FB 970 Framebuffer support"
	depends on FB
	select FB_CFB_FILLRECT
	select FB_CFB_COPYAREA
	select FB_CFB_IMAGEBLIT
	select REGMAP
	help
	  This framebuffer driver supports HISI970 FB.

config HISI_FB_V501
	tristate "HISI FB V501 Framebuffer support"
	depends on FB
	select FB_CFB_FILLRECT
	select FB_CFB_COPYAREA
	select FB_CFB_IMAGEBLIT
	select REGMAP
	help
	  This framebuffer driver supports HISI V501 FB.

config HISI_FB_V510
	tristate "HISI FB V510 Framebuffer support"
	depends on FB
	select FB_CFB_FILLRECT
	select FB_CFB_COPYAREA
	select FB_CFB_IMAGEBLIT
	select REGMAP
	help
	  This framebuffer driver supports HISI V510 FB.

config HISI_FB_V320
	tristate "HISI FB V320 Framebuffer support"
	depends on FB
	select FB_CFB_FILLRECT
	select FB_CFB_COPYAREA
	select FB_CFB_IMAGEBLIT
	select REGMAP
	help
	  This framebuffer driver supports HISI V320 FB.
  
config HISI_FB_V330
	tristate "HISI FB V330 Framebuffer support"
	depends on FB
	select FB_CFB_FILLRECT
	select FB_CFB_COPYAREA
	select FB_CFB_IMAGEBLIT
	select REGMAP
	help
	  This framebuffer driver supports HISI V330 FB.


config HISI_FB_ENG_DBG
	tristate "HISI FB ENG DEBUG support"
	depends on FB
	help
	  This config only used in eng version.

config FASTBOOT_DISP_ENABLE
	tristate "HISI fastboot display enable support"
	depends on FB
	help
	  Display system have already initialized in fastboot.
```

## drivers/wpa_dmd/Kconfig
```kconfig
#
# WPA DMD configuration
#
config  HUAWEI_WPA_DMD
	bool "huawei log module"
	default n
	depends on HUAWEI_DSM
	help
          huawei wpa_dmd_client module control
```

## fs/proc/hisi/Kconfig
```kconfig
if PROC_FS=y

menuconfig HISI_PROC
	bool "hisilicon proc support"
	depends on PROC_FS
	help
	  select hisilicon proc.

config HISI_PROC_HARDWARE
	bool "/proc/hardware support"
	depends on HISI_PROC && OF
	help
	  read the /proc/hardware to get hardware info.

config HISI_PROC_MEMORYINFO_FAST
	bool "/proc/meminfo_lite support"
	depends on HISI_PROC && OF
	default n
	help
	  offer a fast way to get system memory info(free and aviliable)

endif # PROC_FS
```

## kernel/livepatch/Kconfig
```kconfig
config HAVE_LIVEPATCH
	bool
	help
	  Arch supports kernel live patching

if HAVE_LIVEPATCH
menu "Enable Livepatch"

config LIVEPATCH
	bool "Kernel Live Patching"
	depends on MODULES
	depends on SYSFS

	depends on KALLSYMS_ALL
	depends on HAVE_LIVEPATCH
	help
	  Say Y here if you want to support kernel live patching.
	  This option has no runtime impact until a kernel "patch"
	  module uses the interface provided by this option to register
	  a patch, causing calls to patched functions to be redirected
	  to new function code contained in the patch module.

config LIVEPATCH_STACK
	bool "Enforcing the patch stacking principle"
	depends on LIVEPATCH
	default y
	help
	  Say N here if you want to remove the patch stacking principle.

endmenu
endif
```

## kernel/sched/Kconfig
```kconfig
config SCHED_HISI_WALT_WINDOW_SIZE_TUNABLE
	bool "Make WALT window size tunable"
	depends on SCHED_WALT
	default n
	help
	  Make walt_ravg_window tunable in early param.

config SCHED_HISI_DOWNMIGRATE_LOWER_LOAD
	bool "Schedutil governor use lower load when task downmigrate"
	depends on SCHED_WALT
	depends on CPU_FREQ_GOV_SCHEDUTIL
	default n
	help
	  Schedutil governor migrate cpu busy time when task migrate. This
	  option will recaculate a lower load for task downmigrate to
	  prevent little core's frequency increase too much.

config SCHED_HISI_CALC_CUM_WINDOW_DEMAND
	bool "WALT calculate cum window demand"
	depends on SCHED_HISI_USE_WALT
	default n
	help
	  This option caculates WALT's cum_window_demand, which is not used
	  currently.

config SCHED_HISI_CHECK_IRQLOAD
	bool "Scheduler check irqload when select task's cpu"
	depends on SCHED_WALT
	default n
	help
	  WALT caculates an irqload for each cpu and scheduler will avoid
	  placing task on a high irqload cpu (if WALT enabled).
	  Default disabled because we haven't tested to find out which
	  threshold is the best.

config SCHED_HISI_TOP_TASK
	bool "Maintain the top task load of each cpu"
	depends on SCHED_WALT
	default n
	help
	  Hisi schedutil governor may use the top task load as a guide to
	  frequency evaluation.

config SCHED_HISI_USE_WALT
	bool "Scheduler use WALT for cpu util and task util"
	depends on SCHED_WALT
	default n
	help
	  This option enables calculation of WALT's task_util/cpu_util
	  signal, and sets sysctl_sched_use_walt_[cpu/task]_util to 1.

	  When enabled, you can still change the sysctl node to
	  enable or disable walt signal for debug purpose.

config SCHED_HISI_MIGRATE_SPREAD_LOAD
	bool "Spread task's load when inter-cluster migration"
	depends on SCHED_WALT
	default n
	help
	  In inter-cluster migration, this option will spread task's
	  prev_window/curr_window to all cpus that the task has been
	  running on before in a window. If disabled, task's whole load
	  will move to dest cpu and that will make dest cpu's cpu load
	  very high in same cases.

config SCHED_HISI_TOP_TASK_SKIP_HISPEED_LOGIC
	bool "Let top task ignore above_hipeed_delay"
	depends on SCHED_HISI_TOP_TASK
	default n
	help
	  For schedutil governor, this option skips hispeed logic when
	  ADD_TOP_TASK event triggers freq update.

config SCHED_HISI_FORCE_CMP_BACKUP
	bool "Always consider backup cpu in non-preferidle case"
	depends on HISI_EAS_SCHED
	default n
	help
	  This option compares backup_cpu if target_cpu == prev_cpu.
	  In other words, for non-prefer idle tasks it may chose an idle
	  cpu even if prev_cpu is the best active cpu.
	  Not recommended because it will make all tasks spread.
```

## net/network_aware/Kconfig
```kconfig
config HW_NETWORK_AWARE
    bool "network aware"
    default n
    help
      if set, the network connections of background apps will be limited
      when foreground apps connecting to network
```

## security/kernel_harden/Kconfig
```kconfig
#
# Huawei Kernel Harden
#

menu "Huawei Kernel Harden"

config HUAWEI_KERNEL_STACK_RANDOMIZE
    bool "stack randomize"
    depends on ARM64 && !KASAN
    default n
    help
    Randomizes the base address of process's kernel stack.

config HUAWEI_KERNEL_STACK_RANDOMIZE_STRONG
    bool "stack randomize strong"
    depends on ARM64 && !KASAN
    default n
    help
    Randomizes the base address of process's thread_info struct.

config HUAWEI_KERNEL_STACK_NX
    bool "stack non executeable"
    depends on ARM64
    default n
    help
    Set process's kernel stack with non execution.

config HUAWEI_KERNEL_MODULE_RANDOMIZE
    bool "module randomize"
    depends on ARM64
    default n
    help
    Randomizes the base address of loaded kernel module.

config HUAWEI_KASLR_DEBUGFS
	bool "kaslr debugfs interface"
	depends on DEBUG_FS
	default n
	help
	The debugfs interface for kaslr feature.

config HUAWEI_HIDESYMS
	bool "hide symbols"
	default n
	help
	Hide some sensitive kernel symbols

config HUAWEI_HIDESYMS_DEBUGFS
	bool "hide symbols debugfs interface"
	depends on HUAWEI_HIDESYMS && DEBUG_FS
	default n
	help
	Turn on the debugfs interface for hide symbols

config HW_SLUB_SANITIZE
	bool "Sanitize Slub allocations"
	depends on SLUB
	default n
	help
         Zero fill slab allocations on free, reducing the lifetime of
         sensitive data and helping to mitigate use-after-free bugs.
         For slabs with debug poisoning enabling, this has no impact.

config HUAWEI_DOUBLE_FREE_CHECK_DEBUGFS
	bool "double free check debugfs interface"
	depends on DEBUG_FS
	default n
	help
	The debugfs interface for double free check feature.

config HUAWEI_HARDEN_DOUBLE_FREE_CHECK_DEBUGFS
	bool "harden double free check debugfs interface"
	depends on DEBUG_FS
	default n
	help
	The debugfs interface for harden double free check feature.

config HUAWEI_FREELIST_RANDOM_DEBUGFS
	bool "freelist random debugfs interface"
	depends on DEBUG_FS
	default n
	help
	The debugfs interface for freelist random feature.
endmenu
#a blank line must be existed
```

## sound/usb/hifi/Kconfig
```kconfig
menuconfig USB_AUDIO_DTSI_PROPERTY
	bool "USB audio dtsi property drivers support"
	depends on SND_USB_AUDIO
	default n
	help
	Say yes here to support the USB audio dtsi property module
```
